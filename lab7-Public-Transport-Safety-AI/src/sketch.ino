#include <WiFi.h>                                                 // підключення бібліотеки бездротового зв'язку вайфай
#include <HTTPClient.h>                                           // підключення клієнта протоколу передачі гіпертексту
#include <DHT.h>                                                  // підключення бібліотеки датчика температури та вологості
#include <EEPROM.h>                                               // підключення бібліотеки енергонезалежної пам'яті
#include "ai_logic.h"                                             // підключення власного модуля штучного інтелекту

const char *ssid = "Wokwi-GUEST";                                 // ім'я віртуальної бездротової мережі симулятора
const char *password = "";                                        // порожній пароль доступу до віртуальної точки
const char *thingSpeakApiKey = "BP5ABTDS19CG598I";                // персональний ключ запису каналу хмарної платформи
const char *thingSpeakUrl = "http://api.thingspeak.com/update";   // адреса мережевого шлюзу для надсилання телеметрії

const int pirPin = 4;                                             // номер цифрового виводу сенсора присутності людей
const int ledPin = 2;                                             // номер цифрового виводу світлодіода тривоги
const int co2PotPin = 34;                                         // номер аналогового виводу регулятора вуглекислого газу
const int vocPotPin = 35;                                         // номер аналогового виводу регулятора летких сполук
const int dhtPin = 16;                                            // номер цифрового виводу передачі даних кліматичного сенсора
#define DHT_TYPE DHT22                                            // вибір апаратної моделі датчика мікроклімату
DHT dht(dhtPin, DHT_TYPE);                                        // створення програмного об'єкта кліматичного сенсора

int peopleCount = 0;                                              // змінна обліку зафіксованих входів людей
unsigned long lastPirTime = 0;                                    // часова мітка останнього спрацювання датчика руху
const unsigned long pirDebounce = 2000;                           // інтервал у мілісекундах для захисту від повторних спрацювань
unsigned long lastSendTime = 0;                                   // часова мітка останньої передачі даних у хмару
const unsigned long sendInterval = 16000;                         // інтервал надсилання даних для безкоштовного тарифу сервісу
unsigned long lastPrintTime = 0;                                  // часова мітка останнього виведення даних у термінал
const unsigned long printInterval = 1500;                         // інтервал виведення поточних показників у монітор порту

int readAnalogAverage(int pin)                                    // заголовок функції усереднення аналогового сигналу
{                                                                 // функція усереднення аналогового сигналу для усунення завад
  long sum = 0;                                                   // змінна для накопичення суми вимірювань
  for (int i = 0; i < 8; i++)                                     // початок циклу зчитування восьми послідовних зразків
  {                                                               // цикл зчитування восьми послідовних зразків
    sum += analogRead(pin);                                       // додавання значення поточного зразка до загальної суми
    delayMicroseconds(50);                                        // коротка пауза між вимірами для стабілізації перетворювача
  }                                                               // завершення циклу зняття зразків
  return (int)(sum / 8);                                          // повернення обчисленого середнього арифметичного значення
}                                                                 // завершення функції усереднення

float mapPotToCO2(int raw)                                        // заголовок функції перетворення коду на рівень газу
{                                                                 // функція перетворення коду перетворювача у концентрацію газу
  return 400.0f + (raw / 4095.0f) * 4600.0f;                      // масштабування діапазону від 400 до 5000 частин на мільйон
}                                                                 // завершення функції масштабування газу  

float mapPotToVOC(int raw)                                        // заголовок функції перетворення коду на рівень сполук
{                                                                 // функція перетворення коду перетворювача у концентрацію летких речовин
  return (raw / 4095.0f) * 1000.0f;                                                                                                 // масштабування діапазону від нуля до тисячі частин на мільярд
}                                                                                                                                   // завершення функції масштабування летких сполук

void sendToThingSpeak(float co2, float voc, int people, float pred, float temp, float hum, int risk, float conf, String payload)    // заголовок функції відправки даних у хмару
{                                                                                                                                   // функція надсилання даних
  if (WiFi.status() == WL_CONNECTED)                                        // перевірка підключення мікроконтролера до мережі вайфай
  {                                                                         // перевірка наявності активного зв'язку з бездротовою мережею
    Serial.println("Sending data to ThingSpeak...");                        // виведення повідомлення про початок трансляції
    HTTPClient http;                                                        // створення екземпляра мережевого клієнта
    http.begin(thingSpeakUrl);                                              // встановлення з'єднання з цільовою мережевою адресою

    http.addHeader("Content-Type", "application/x-www-form-urlencoded");    // додавання заголовка типу переданих даних
    String postData = "api_key=" + String(thingSpeakApiKey);                // формування тіла запиту з ключем доступу
    postData += "&field1=" + String(co2, 1);                                // додавання концентрації вуглекислого газу у перше поле
    postData += "&field2=" + String(voc, 1);                                // додавання рівня летких сполук у друге поле
    postData += "&field3=" + String(people);                                // додавання фізичного лічильника людей у третє поле
    postData += "&field4=" + String(pred, 1);                               // додавання результату предиктивної моделі у четверте поле
    postData += "&field5=" + String(temp, 1);                               // додавання температури повітря у п'яте поле
    postData += "&field6=" + String(hum, 1);                                // додавання вологості повітря у шосте поле
    postData += "&field7=" + String(risk);                                  // додавання індексу загрози у сьоме поле
    postData += "&field8=" + String(conf, 2);                               // додавання коефіцієнта достовірності у восьме поле
    postData += "&status=" + payload;                                       // прикріплення структурованого пакета у поле статусу
    int code = http.POST(postData);                                         // надсилання сформованого мережевого запиту методом пост
    if (code == 200)                                                        // перевірка успішного коду відповіді сервера
    {                                                                       // обробка успішного отримання відповіді від сервера
      String resp = http.getString();                                       // зчитування текстової відповіді віддаленого сервера
      if (resp != "0")                                                      // перевірка чи не повернув сервер нульовий статус
      {                                                                     // перевірка чи сервер зберіг новий запис у базу
        Serial.println("ThingSpeak: Data sent successfully");               // виведення підтвердження успішної фіксації
      }                                                                     // закриття блоку успішного збереження даних
      else                                                                  // перехід до обробки обмеження частоти запитів
      {                                                                     // обробка ситуації перевищення встановленого ліміту часу
        Serial.println("ThingSpeak: Rate limited (15s minimum)");           // сповіщення про необхідність дотримання паузи
      }                                                                     // завершення перевірки успішності збереження
    }                                                                       // закриття блоку обробки коду двісті
    else                                                                    // перехід до обробки мережевої помилки сервера
    {                                                                       // обробка ситуації виникнення мережевої помилки
      Serial.print("ThingSpeak error code: ");                              // виведення текстового префікса помилки
      Serial.println(code);                                                 // друк цифрового коду відповіді протоколу
    }                                                                       // завершення аналізу коду сервера
    http.end();                                                             // закриття мережевого з'єднання та звільнення пам'яті
  }                                                                         // закриття блоку перевірки підключення до мережі
  else                                                                      // перехід до дій у разі відсутності зв'язку
  {                                                                         // дії у випадку втрати зв'язку з точкою доступу
    Serial.println("ThingSpeak: WiFi not connected");                       // виведення попередження про відсутність мережі
  }                                                                         // завершення блоку перевірки підключення
}                                                                           // завершення функції передачі даних

void detectPeople()                                                         // заголовок функції виявлення переміщення людей
{                                                                           // функція реєстрації подій перетину лінії датчика
  int pirValue = digitalRead(pirPin);                                       // опитування поточного логічного стану виводу датчика
  unsigned long currentTime = millis();                                     // отримання поточного системного часу від старту
  if (pirValue == HIGH && (currentTime - lastPirTime > pirDebounce))        // перевірка спрацювання датчика з урахуванням затримки
  {                                                                         // фіксація нового руху з фільтрацією
    peopleCount++;                                                          // інкремент загального числа зафіксованих пасажирів
    EEPROM.writeInt(0, peopleCount);                                        // запис оновленого значення у енергонезалежну пам'ять
    EEPROM.commit();                                                        // збереження змін у постійній пам'яті мікроконтролера
    lastPirTime = currentTime;                                              // оновлення часової мітки останньої події
    digitalWrite(ledPin, HIGH);                                             // увімкнення світлодіода для індикації входу
    delay(80);                                                              // короткочасна затримка для візуальної видимості спалаху
    digitalWrite(ledPin, LOW);                                              // вимкнення індикаторного світлодіода
  }                                                                         // завершення обробки сигналу датчика
}                                                                           // завершення функції виявлення руху

void setup()                                                                // заголовок головної функції початкового налаштування
{                                                             // головна функція початкового налаштування системи
  Serial.begin(115200);                                       // ініціалізація послідовного інтерфейсу на вказаній швидкості
  delay(300);                                                 // пауза для стабілізації інтерфейсу передачі даних
  Serial.println();                                           // виведення порожнього рядка для візуального відступу
  Serial.println("=============================");            // друк верхньої межі рамки назви проєкту
  Serial.println("Public Transport Safety AI");               // друк офіційної назви програмного комплексу
  Serial.println("=============================");            // друк нижньої межі рамки назви проєкту
  Serial.println();                                           // додатковий порожній рядок для відокремлення блоків
  pinMode(pirPin, INPUT);                                     // конфігурація виводу датчика руху як цифрового входу
  pinMode(ledPin, OUTPUT);                                    // конфігурація виводу світлодіода як цифрового виходу
  pinMode(co2PotPin, INPUT);                                  // конфігурація виводу першого регулятора як входу
  pinMode(vocPotPin, INPUT);                                  // конфігурація виводу другого регулятора як входу

  EEPROM.begin(512);                                          // виділення байтів в енергонезалежній пам'яті
  peopleCount = EEPROM.readInt(0);                            // зчитування раніше збереженого лічильника людей
  if (peopleCount < 0 || peopleCount > 1000)                  // перевірка діапазону зчитаного лічильника пасажирів
  {                                                           // перевірка на коректність зчитаного значення
    peopleCount = 0;                                          // скидання лічильника при пошкодженні даних пам'яті
    EEPROM.writeInt(0, peopleCount);                          // повторний запис нульового значення в пам'ять
    EEPROM.commit();                                          // фіксація скидання в енергонезалежному сховищі
  }                                                           // завершення перевірки коректності лічильника
  Serial.println("EEPROM loaded");                            // сповіщення про успішне завантаження лічильника

  WiFi.begin(ssid, password);                                 // запуск процедури підключення до бездротової мережі
  while (WiFi.status() != WL_CONNECTED)                       // цикл очікування підключення до бездротової мережі
  {                                                           // цикл очікування успішного з'єднання
    delay(400);                                               // пауза між опитуваннями стану зв'язку
  }                                                           // завершення циклу очікування мережі
  Serial.println("WiFi connected...");                        // сповіщення про встановлення стабільного з'єднання

  dht.begin();                                                // запуск опитування кліматичного датчика
  Serial.println("DHT22 ready");                              // сповіщення про готовність кліматичного модуля
  Serial.println("PIR sensor ready");                         // сповіщення про готовність датчика руху
  Serial.println("AI module ready");                          // сповіщення про готовність логіки аналітики
  Serial.println();                                           // виведення порожнього рядка перед статусом готовності
  Serial.println("System ready!");                            // виведення повідомлення про повну готовність комплексу

  Serial.println();                                           // виведення порожнього рядка для переходу до телеметрії
}                                                             // завершення функції первинного налаштування

void loop()                                                   // заголовок головного циклу періодичного виконання
{                                                             // головний нескінченний цикл виконання програми
  detectPeople();                                             // виклик перевірки датчика руху пасажирів

  int co2Raw = readAnalogAverage(co2PotPin);                  // зчитування усередненого рівня газу
  int vocRaw = readAnalogAverage(vocPotPin);                  // зчитування усередненого рівня летких сполук
  float co2Val = mapPotToCO2(co2Raw);                         // обчислення концентрації вуглекислого газу
  float vocVal = mapPotToVOC(vocRaw);                         // обчислення концентрації летких речовин
  float tempVal = dht.readTemperature();                      // отримання поточної температури повітря
  float humVal = dht.readHumidity();                          // отримання поточної відносної вологості повітря
  if (isnan(tempVal))                                         // перевірка коректності зчитаної температури
    tempVal = 22.0f;                                          // підстановка резервного значення при помилці датчика
  if (isnan(humVal))                                          // перевірка коректності зчитаної вологості
    humVal = 45.0f;                                                   // підстановка нормальної вологості при помилці зчитування

  AIOutput aiResult = runAIInference(co2Val, vocVal, peopleCount);    // виконання аналізу моделлю

  if (aiResult.riskLevel == 2)                                        // перевірка наявності високого рівня небезпеки
  {                                                                   // перевірка чи досягнуто критичного рівня небезпеки
    digitalWrite(ledPin, (millis() / 250) % 2 == 0 ? HIGH : LOW);     // часте блимання світлодіода тривоги
  }                                                                   // закриття блоку високого рівня загрози
  else if (aiResult.riskLevel == 1)                                   // перевірка наявності помірного рівня небезпеки
  {                                                                   // перевірка чи встановлено помірний рівень небезпеки
    digitalWrite(ledPin, (millis() / 1000) % 2 == 0 ? HIGH : LOW);    // повільне блимання світлодіода попередження
  }                                                                   // закриття блоку помірного рівня загрози
  else                                                                // перехід до умов нормального безпечного стану
  {                                                                   // якщо рівень небезпеки нульовий або нормальний
    if (digitalRead(pirPin) == LOW)                                   // перевірка відсутності сигналу на датчику руху
    {                                                                 // перевірка чи датчик руху зараз не активний
      digitalWrite(ledPin, LOW);                                      // повне вимкнення світлодіода за відсутності тривоги
    }                                                                 // завершення перевірки сигналу руху
  }                                                                   // завершення блоку керування світлодіодом

  unsigned long currentMillis = millis();                             // фіксація поточного значення таймера процесора
  if (currentMillis - lastPrintTime >= printInterval)                 // перевірка інтервалу друку телеметрії в термінал

  {                                                                   // перевірка настання інтервалу монітора
    lastPrintTime = currentMillis;                                    // оновлення часової мітки виведення значень
    Serial.print("CO2: ");                                            // друк текстової назви параметра вуглекислого газу
    Serial.print(co2Val, 1);                                          // друк розрахованої концентрації вуглекислого газу
    Serial.print(" ppm | VOC: ");                                     // друк одиниці виміру газу та мітки летких сполук
    Serial.print(vocVal, 1);                                          // друк концентрації летких органічних речовин
    Serial.print(" ppb | Temp: ");                                    // друк одиниці виміру сполук та назви температури
    Serial.print(tempVal, 1);                                         // друк числового значення температури навколишнього середовища
    Serial.print(" C | Hum: ");                                       // друк символу градусів цельсія та мітки вологості
    Serial.print(humVal, 1);                                          // друк числового значення відносної вологості повітря
    Serial.print(" % | People: ");                                    // друк знака відсотка та мітки лічильника людей
    Serial.print(peopleCount);                                        // друк загальної кількості зареєстрованих пасажирів
    Serial.print(" | AI Occupancy: ");                                // друк назви поля прогнозованої заповненості
    Serial.print(aiResult.predictedOccupancy, 0);                     // друк прогнозу заповненості салону
    Serial.print(" | Risk: ");                                        // друк мітки оціненого індексу ризику
    Serial.print(aiResult.riskLevel);                                 // друк числового значення рівня небезпеки
    Serial.print(" | Conf: ");                                        // друк мітки коефіцієнта достовірності моделі
    Serial.println(aiResult.confidence, 2);                           // друк значення впевненості предиктора
  }                                                                   // завершення блоку виведення поточних вимірів

  if (currentMillis - lastSendTime >= sendInterval)                   // перевірка інтервалу відправлення даних на сервер
  {                                                                                                                                                                       // перевірка інтервалу синхронізації з хмарою
    lastSendTime = currentMillis;                                                                                                                                         // збереження нового часу відправлення пакету даних
    String llmPayload = generateLLMSchemaPayload(co2Val, vocVal, peopleCount, aiResult.predictedOccupancy, aiResult.riskLevel, aiResult.confidence, tempVal, humVal);     // генерація схеми даних
    Serial.println();                                                                                                                                                     // друк порожнього рядка для відокремлення блоку передачі
    Serial.println("LLM Data Schema Payload:");                                                                                                                           // сповіщення про створення пакета за схемою
    Serial.println(llmPayload);                                                                                                                                           // друк сформованого структурованого пакета у консоль
    sendToThingSpeak(co2Val, vocVal, peopleCount, aiResult.predictedOccupancy, tempVal, humVal, aiResult.riskLevel, aiResult.confidence, llmPayload);                     // трансляція даних у хмару
    Serial.println();                                                                                                                                                     // друк завершального порожнього рядка для відступу
  }                            // завершення процедури надсилання даних

  delay(20);                   // коротка циклічна пауза для зниження навантаження на ядро
}                              // завершення основного циклу програми