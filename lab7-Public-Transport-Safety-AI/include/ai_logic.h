#ifndef AI_LOGIC_H                    // захист від повторного включення заголовка
#define AI_LOGIC_H                    // визначення макросу заголовного файлу
#include <Arduino.h>                  // підключення базових функцій ардуіно
#include <math.h>                     // підключення математичної бібліотеки

struct AIOutput                       // оголошення структури вихідних даних моделі
{                                     // оголошення структури вихідних результатів штучного інтелекту
  float predictedOccupancy;           // прогнозована кількість пасажирів у салоні
  int riskLevel;                      // числовий рівень безпеки
  float confidence;                   // коефіцієнт впевненості моделі
  int anomaly;                        // прапорець виявлення аномального стрибка показників
};                                    // кінець структури вихідних даних

class OccupancyPredictor              // оголошення класу моделі прогнозування заповненості
{                                     // оголошення класу предиктора заповненості
private:                              // секція приватних полів класу
  float co2History[30];               // масив збереження попередніх значень вуглекислого газу
  float vocHistory[30];               // масив збереження попередніх значень летких сполук
  int peopleHistory[30];              // масив збереження попередніх показників лічильника
  int historyIndex;                   // поточний індекс для запису нового значення
  int historyCount;                   // загальна кількість записаних елементів в історію
  float co2Baseline;                  // базовий рівень чистого повітря для вуглекислого газу
  float vocBaseline;                  // базовий рівень чистого повітря для летких речовин

public:                               // секція публічних методів класу
  OccupancyPredictor()                // конструктор класу предиктора заповненості
  {                                   // конструктор класу для початкової ініціалізації
    historyIndex = 0;                 // скидання індексу історії в нуль
    historyCount = 0;                 // скидання лічильника збережених вимірів
    co2Baseline = 400.0f;             // встановлення базового значення вуглекислого газу
    vocBaseline = 0.0f;               // встановлення базового значення летких сполук
    for (int i = 0; i < 30; i++)      // початок циклу ініціалізації масивів даних
    {                                 // цикл заповнення масивів початковими даними
      co2History[i] = 400.0f;         // запис базового вуглекислого газу в комірку
      vocHistory[i] = 0.0f;           // запис базових летких речовин у комірку
      peopleHistory[i] = 0;           // скидання лічильника людей у комірці
    }                                 // завершення циклу заповнення масивів
  }                                                                 // завершення конструктора класу

  void updateHistory(float co2, float voc, int people)              // оголошення методу збереження нових вимірів
  {                                                                 // метод оновлення історії показників
    co2History[historyIndex] = co2;                                 // запис поточного вуглекислого газу в масив
    vocHistory[historyIndex] = voc;                                 // запис поточних летких сполук в масив
    peopleHistory[historyIndex] = people;                           // запис поточного значення лічильника в масив
    historyIndex = (historyIndex + 1) % 30;                         // циклічний перехід до наступного індексу масиву
    if (historyCount < 30)                                          // перевірка чи заповнений масив повністю
    {                                                               // перевірка чи заповнений масив повністю
      historyCount++;                                               // збільшення лічильника накопичених вимірів
    }                                                               // завершення умови перевірки заповненості
  }                                                                 // завершення методу оновлення історії

  void updateBaseline(float co2, float voc)                         // оголошення методу коригування базового рівня
  {                                                                 // метод адаптивного оновлення базового фону повітря
    if (co2 < co2Baseline)                                          // перевірка чи рівень газу нижчий за базовий
    {                                                               // перевірка чи поточний рівень газу менший за базовий
      co2Baseline = co2Baseline * 0.9f + co2 * 0.1f;                // швидке зменшення базового фону вуглекислого газу
    }                                                               // закриття блоку швидкої корекції фону газу
    else                                                            // перехід до повільної корекції фону газу
    {                                                               // якщо рівень газу більший або дорівнює базовому
      co2Baseline = co2Baseline * 0.995f + co2 * 0.005f;            // повільне підвищення базового фону вуглекислого газу
    }                                                               // завершення перевірки рівня вуглекислого газу
    if (voc < vocBaseline)                                          // перевірка чи рівень летких речовин нижчий за базовий
    {                                                               // перевірка чи поточний рівень летких сполук нижчий за фон
      vocBaseline = vocBaseline * 0.9f + voc * 0.1f;                // швидка адаптація фону летких сполук до меншого значення
    }                                                               // закриття блоку швидкої корекції летких сполук
    else                                                            // перехід до повільної корекції летких сполук
    {                                                               // якщо рівень летких сполук вищий за фон
      vocBaseline = vocBaseline * 0.995f + voc * 0.005f;            // плавна корекція базового фону летких речовин
    }                                                               // завершення перевірки рівня летких сполук
  }                                                                 // завершення методу адаптивного оновлення

  float calculateCo2Slope()                                         // оголошення методу розрахунку швидкості наростання газу
  {                                                                 // метод розрахунку тренду зміни газу через лінійну регресію
    if (historyCount < 2)                                           // перевірка наявності достатньої кількості вимірів
      return 0.0f;                                                  // повернення нуля якщо даних недостатньо для лінії
    float sumX = 0.0f, sumY = 0.0f, sumXY = 0.0f, sumXX = 0.0f;     // змінні накопичення сум для методу найменших квадратів
    for (int i = 0; i < historyCount; i++)                          // цикл накопичення сум за методом найменших квадратів
    {                                                               // цикл розрахунку сумарних величин точок
      int idx = (historyIndex - historyCount + i + 30) % 30;        // визначення правильного хронологічного індексу в буфері
      float x = (float)i;                                           // часова координата точки вимірювання
      float y = co2History[idx];                                    // значення концентрації газу в даній точці
      sumX += x;                                                    // додавання значення часу до загальної суми
      sumY += y;                                                    // додавання концентрації газу до загальної суми
      sumXY += x * y;                                               // додавання добутку координат до суми
      sumXX += x * x;                                               // додавання квадрата часу до суми
    }                                                               // завершення циклу підсумовування точок
    float n = (float)historyCount;                                  // приведення кількості вимірів до дробового типу
    float denominator = (n * sumXX - sumX * sumX);                  // розрахунок знаменника формули нахилу лінії
    if (denominator == 0.0f)                                        // перевірка знаменника формули на рівність нулю
      return 0.0f;                                                  // захист від ділення на нуль
    return (n * sumXY - sumX * sumY) / denominator;                 // обчислення кутового коефіцієнта швидкості зміни газу
  }                                                                 // завершення методу розрахунку тренду

  float calculateVariance()                                         // оголошення методу розрахунку дисперсії вимірювань
  {                                                                 // метод обчислення дисперсії коливань концентрації
    if (historyCount == 0)                                          // перевірка наявності накопичених вимірів у буфері
      return 0.0f;                                                  // повернення нуля за відсутності накопичених даних
    float sum = 0.0f;                                               // змінна для підрахунку суми значень
    for (int i = 0; i < historyCount; i++)                          // початок циклу обчислення середнього арифметичного значення
    {                                                               // цикл підсумовування збережених показників газу
      sum += co2History[i];                                         // накопичення суми вимірів
    }                                                               // завершення циклу підсумовування
    float avg = sum / (float)historyCount;                          // розрахунок середнього арифметичного значення
    float var = 0.0f;                                               // змінна для накопичення квадратичних відхилень
    for (int i = 0; i < historyCount; i++)                          // початок циклу обчислення суми квадратів відхилень
    {                                                               // цикл розрахунку різниць із середнім значенням
      var += (co2History[i] - avg) * (co2History[i] - avg);         // додавання квадрата відхилення точки від середнього
    }                                                               // завершення циклу обчислення відхилень
    return sqrtf(var / (float)historyCount);                        // розрахунок середньоквадратичного відхилення
  }                                                                 // завершення методу обчислення дисперсії

  AIOutput process(float co2, float voc, int people)                // оголошення основного методу обчислення прогнозу
  {                                                                                                     // основний метод інференсу штучного інтелекту
    updateBaseline(co2, voc);                                                                           // виклик оновлення фонових параметрів середовища
    updateHistory(co2, voc, people);                                                                    // збереження нових вимірів в історію
    float co2Delta = (co2 > co2Baseline) ? (co2 - co2Baseline) : 0.0f;                                  // обчислення приросту вуглекислого газу над фоном
    float vocDelta = (voc > vocBaseline) ? (voc - vocBaseline) : 0.0f;                                  // обчислення приросту летких сполук над фоном
    float co2Slope = calculateCo2Slope();                                                               // отримання швидкості зростання концентрації газу
    float variance = calculateVariance();                                                               // отримання дисперсії вимірювань
    float co2EstOccupancy = co2Delta / 35.0f;                                                           // оцінка кількості людей за виділеним вуглекислим газом
    float vocEstOccupancy = vocDelta / 20.0f;                                                           // оцінка кількості людей за концентрацією летких речовин
    float trendAdjustment = co2Slope * 1.5f;                                                            // поправка на динаміку наростання газу
    float sensorBasedEst = (co2EstOccupancy * 0.65f) + (vocEstOccupancy * 0.35f) + trendAdjustment;     // комбінована газова оцінка
    if (sensorBasedEst < 0.0f)                                                                          // перевірка на від'ємне значення оцінки за газами
      sensorBasedEst = 0.0f;                                                                            // обмеження від'ємних результатів оцінки
    float predicted = ((float)people * 0.5f) + (sensorBasedEst * 0.5f);                                 // злиття даних сенсора руху та газової аналітики
    if (predicted < 0.0f)                                                                               // перевірка на від'ємне підсумкове значення прогнозу
      predicted = 0.0f;                                                                                 // обмеження мінімальної оцінки нулем
    if (predicted > 60.0f)                                                                              // перевірка на перевищення максимальної місткості транспорту
      predicted = 60.0f;                                                                                // обмеження максимальної місткості салону
    float conf = 1.0f - (variance / 200.0f);                                                            // розрахунок коефіцієнта впевненості моделі
    if (conf < 0.2f)                                                                                    // перевірка мінімального порогу впевненості моделі
      conf = 0.2f;                                                                                      // обмеження мінімальної межі впевненості
    if (conf > 1.0f)                                                                                    // перевірка максимального значення впевненості моделі
      conf = 1.0f;                                                                                      // обмеження максимальної межі впевненості
    int anomaly = 0;                                                                                    // початкове значення прапорця аномалій
    if (co2 > 2500.0f || voc > 1000.0f || fabsf(co2Slope) > 80.0f)                                      // перевірка наявності аномального стрибка концентрацій
    {                                                                                                   // перевірка наявності критичних викидів або стрибків
      anomaly = 1;                                                                                      // встановлення ознаки виявленої аномалії
    }                                                                                                   // завершення перевірки наявності аномалії
    int risk = 0;                                                                                       // початковий безпечний рівень загрози
    if (predicted > 40.0f || co2 > 1600.0f || voc > 500.0f)                                             // перевірка настання критичного рівня загрози
    {                                                                                                   // критерій критичного переповнення або задухи
      risk = 2;                                                                                         // призначення небезпечного рівня ризику
    }                                                                                                   // закриття блоку критичного рівня загрози
    else if (predicted > 25.0f || co2 > 1000.0f || voc > 250.0f)                                        // перевірка настання помірного рівня загрози
    {                                                                                                   // критерій помірного навантаження на салон
      risk = 1;                                                                                         // призначення попереджувального рівня ризику
    }                                                                                                   // завершення визначення рівня ризику
    AIOutput out;                                                                                       // створення структури для формування вихідного результату
    out.predictedOccupancy = roundf(predicted);                                                         // запис округленої прогнозованої кількості пасажирів
    out.riskLevel = risk;                                                                               // запис визначеного рівня ризику в структуру
    out.confidence = conf;                                                                              // запис коефіцієнта достовірності прогнозу
    out.anomaly = anomaly;                                                                              // запис статусу наявності аномалії
    return out;                                                                                         // повернення об'єкта з результатами аналізу
  }                                                                                                     // завершення методу інференсу

};                                                                                                      // завершення оголошення класу

inline AIOutput runAIInference(float co2, float voc, int people)                                        // оголошення глобальної функції запуску штучного інтелекту
{                                                                                                       // функція запуску прогнозування заповненості
  static OccupancyPredictor aiPredictor;                                                                // створення статичного екземпляра предиктора
  return aiPredictor.process(co2, voc, people);                                                                                       // виклик обробки даних та повернення висновків моделі
}                                                                                                                                     // завершення функції інференсу

inline String generateLLMSchemaPayload(float co2, float voc, int people, float pred, int risk, float conf, float temp, float hum)     // оголошення функції створення структурованого пакета даних
{                                                                                                                                     // функція генерації схеми даних
  String json = "{\"device\":\"BUS-104\",\"co2\":" + String(co2, 1);              // запис ідентифікатора транспорту та вуглекислого газу
  json += ",\"voc\":" + String(voc, 1);                                           // додавання показника летких сполук у текстовий рядок
  json += ",\"temp\":" + String(temp, 1);                                         // додавання температури повітря у текстовий рядок
  json += ",\"hum\":" + String(hum, 1);                                           // додавання відносної вологості у текстовий рядок
  json += ",\"pir\":" + String(people);                                           // додавання фізичного значення лічильника пасажирів
  json += ",\"occupancy\":" + String(pred, 0);                                    // додавання прогнозованої штучним інтелектом заповненості
  json += ",\"risk\":" + String(risk);                                            // додавання рівня ризику для пасажирів
  json += ",\"conf\":" + String(conf, 2);                                         // додавання розрахованого коефіцієнта впевненості
  json += ",\"task\":\"SafetyAnalysis\"}";                                        // додавання завдання для обробки великою мовною моделлю
  return json;                                                                    // повернення сформованого структурованого пакета даних
}                                                                                 // завершення функції генерації схеми

#endif                                                                            // закриття директиви захисту заголовка