#include <WiFi.h>               // Підключення бібліотеки для роботи з бездротовою мережею
#include <HTTPClient.h>         // Підключення бібліотеки для надсилання запитів до сервера
#include <DHT.h>                // Підключення бібліотеки для роботи з датчиком мікроклімату

#define DHTPIN 15               // Визначення цифрового контакту для підключення датчика температури
#define DHTTYPE DHT22           // Вказання точної моделі датчика температури та вологості
#define LDR_PIN 34              // Номер аналогового контакту першого перетворювача для фоторезистора
#define PIR_PIN 17              // Номер цифрового контакту для сигналу від датчика виявлення руху
#define LED_PIN 18              // Номер цифрового контакту для зеленого світлодіода освітлення
#define FAN_PIN 19              // Номер цифрового контакту для червоного світлодіода вентилятора
#define BUZZER_PIN 5            // Номер цифрового контакту для п'єзоелектричного зумера

DHT dht(DHTPIN, DHTTYPE);                                             // Створення об'єкта датчика з передачею номера контакту та типу

const char *ssid = "Wokwi-GUEST";                                     // Назва бездротової точки доступу віртуальної мережі
const char *password = "";                                            // Порожній пароль для відкритої точки доступу в симуляторі

const char *thingspeakServer = "http://api.thingspeak.com/update";    // Адреса для відправки нових вимірювань на хмарний сервер
const char *apiKey = "MSDIBTMUKM8NUZZO";                              // Секретний ключ користувача для запису даних у канал

unsigned long lastSendTime = 0;                   // Змінна для фіксації часу останньої відправки пакета
const unsigned long sendInterval = 16000;         // Тривалість інтервалу між пакетами у мілісекундах
unsigned long lastMotionTime = 0;                 // Змінна для збереження моменту останнього зафіксованого руху

bool lightOn = false;                             // Прапорець поточного стану кімнатного освітлення
bool fanOn = false;                               // Прапорець поточного стану роботи вентилятора
bool anomalyFlag = false;                         // Прапорець наявності критичної ситуації в кімнаті
bool buzzerActive = false;                        // Прапорець активності генератора звуку для захисту від помилок

void setup()
{                                                 // Головна функція початкового налаштування мікроконтролера
  Serial.begin(115200);                           // Запуск послідовного порту передачі даних зі швидкістю 115200 бод
  Serial.println("AI-MONITORED SMART ROOM");      // Виведення назви проекту у вікно послідовного порту
  pinMode(LDR_PIN, INPUT);                        // Налаштування контакту фоторезистора на зчитування сигналу
  pinMode(PIR_PIN, INPUT);                        // Налаштування контакту датчика руху на прийом цифрового сигналу
  pinMode(LED_PIN, OUTPUT);                       // Налаштування контакту світлодіода кімнати на виведення сигналу
  pinMode(FAN_PIN, OUTPUT);                       // Налаштування контакту світлодіода вентилятора на виведення напруги
  pinMode(BUZZER_PIN, OUTPUT);                    // Налаштування контакту зумера на генерування вихідного сигналу
  dht.begin();                                    // Запуск протоколу обміну даними датчика мікроклімату
  Serial.print("Connecting to WiFi");             // Виведення тексту про початок пошуку бездротової мережі
  WiFi.begin(ssid, password);                     // Запуск спроби підключення до точки доступу
  while (WiFi.status() != WL_CONNECTED)           // Цикл очікування підтвердження успішного з'єднання з мережею
  {
    delay(500);                                   // Пауза на пів секунди між перевірками стану мережевого з'єднання
    Serial.print(".");                            // Друк чергової крапки у термінал як індикатора процесу
  }                                               // Закриття блоку циклу очікування встановлення зв'язку
  Serial.println();                               // Перехід на новий чистий рядок після завершення списку крапок
  Serial.println("System ready!");                // Повідомлення про успішне налаштування та готовність системи
  Serial.println();                               // Додатковий порожній рядок для відокремлення заголовка від робочих даних
}                                                 // Закриття функції початкової ініціалізації пристрою

void loop()
{                                                 // Головний нескінченний цикл виконання базової програми мікроконтролера
  float temp = dht.readTemperature();             // Зчитування поточного значення температури повітря
  float humidity = dht.readHumidity();            // Зчитування поточного значення відносної вологості повітря
  if (isnan(temp))                                // Перевірка на помилку зчитування температури та заміна її нулем
    temp = 0.0;
  if (isnan(humidity))                            // Перевірка на помилку зчитування вологості та встановлення нуля
    humidity = 0.0;

  int lightRaw = analogRead(LDR_PIN);                                 // Отримання сирого цифрового значення напруги з фоторезистора
  int lightLevel = map(lightRaw, 0, 4095, 0, 1000);                   // Масштабування сигналу у стандартні одиниці освітленості люкси
  bool motion = (digitalRead(PIR_PIN) == HIGH);                       // Визначення присутності людини за високим рівнем сигналу
  if (motion)                                                         // Перевірка умови наявності руху в контрольованій зоні
  {
    lastMotionTime = millis();                                        // Оновлення часу останньої активності поточним системним часом
  }                                                                   // Закриття блоку фіксації часу останнього руху

  String lightMsg = "";                                               // Створення текстової змінної для повідомлення про освітлення
  const unsigned long lightTimeout = 10000;                           // Завдання часу очікування вимкнення світла тривалістю десять секунд
  if (lightLevel < 200 && motion)
  {                                                                   // Перевірка умови нестачі природного світла та наявності руху
    lightOn = true;                                                   // Встановлення прапорця активного стану кімнатного освітлення
    digitalWrite(LED_PIN, HIGH);                                      // Подача напруги високого рівня на зелений світлодіод
    lightMsg = "[LIGHT] Dark + motion detected --> Light ON";         // Запис тексту про виявлення руху в темряві та увімкнення світла
  }
  else if (lightLevel >= 200)
  {                                                                   // Перевірка умови достатньої яскравості зовнішнього світла
    lightOn = false;                                                  // Зміна прапорця стану кімнатного освітлення на вимкнене
    digitalWrite(LED_PIN, LOW);                                       // Зняття напруги з контакту зеленого світлодіода для його гасіння
    lightMsg = "[LIGHT] Bright daylight --> Light OFF";               // Запис тексту про наявність світла та вимкнення лампи
  }
  else if (lightOn && (millis() - lastMotionTime >= lightTimeout))
  {                                                                   // Перевірка закінчення часу очікування після припинення активності
    lightOn = false;                                                  // Переведення системи освітлення у вимкнений режим
    digitalWrite(LED_PIN, LOW);                                       // Вимкнення зеленого світлодіода після закінчення затримки
    lightMsg = "[LIGHT] No motion timeout --> Light OFF";             // Формування рядка про спрацювання таймера відсутності людей
  }
  else if (lightOn)
  {                                                                                                 // Перевірка умови увімкненого світла під час відліку затримки
    unsigned long remainingSec = (lightTimeout - (millis() - lastMotionTime)) / 1000;               // Розрахунок кількості секунд що залишилися до вимкнення
    lightMsg = "[LIGHT] Dark + timer active (off in " + String(remainingSec) + "s) --> Light ON";   // Створення рядка зі зворотним відліком часу роботи лампи
  }
  else
  {                                                                                 // Дія для всіх інших випадків коли в кімнаті темно без людей
    lightMsg = "[LIGHT] Bright / no motion --> Light OFF";                          // Текстовий звіт про вимкнений стан освітлення через відсутність руху
  }                                                                                 // Закриття умовного блоку керування освітленням кімнати

  String fanMsg = "";                                                               // Створення текстової змінної для збереження статусу вентиляції
  if (temp > 30.0 || humidity > 70.0)
  {                                                                                 // Перевірка виходу температури або вологості за верхні межі комфорту
    fanOn = true;                                                                   // Зміна статусу роботи вентилятора на активний стан
    digitalWrite(FAN_PIN, HIGH);                                                    // Подача електричного сигналу на червоний світлодіод охолодження
    if (temp > 30.0)
    {                                                                               // Перевірка чи саме температура перевищила допустимий поріг
      fanMsg = "[FAN] High temperature (" + String(temp, 1) + " C) --> Fan ON";     // Запис тексту про увімкнення вентилятора через спеку
    }
    else
    {                                                                               // Варіант спрацювання коли причиною запуску стала висока вологість
      fanMsg = "[FAN] High humidity (" + String(humidity, 0) + "%) --> Fan ON";     // Запис тексту про активацію провітрювання через вологість
    }                                                                               // Закриття блоку визначення причини увімкнення вентилятора
  }
  else if (temp < 27.0 && humidity < 60.0)
  {                                                                                 // Перевірка повернення обох параметрів у безпечну зону норми
    fanOn = false;                                                                  // Зміна статусу вентилятора на неактивний після охолодження
    digitalWrite(FAN_PIN, LOW);                                                     // Зняття керуючої напруги з контакту червоного світлодіода
    fanMsg = "[FAN] Normal conditions --> Fan OFF";                                 // Повідомлення про досягнення норми та зупинку вентилятора
  }
  else
  {                                                                                 // Збереження попереднього стану всередині зони безпечного гістерезису
    if (fanOn)
    {                                                                               // Перевірка чи вентилятор працював до цього моменту
      fanMsg = "[FAN] Conditions not cleared --> Fan ON";                           // Повідомлення про продовження роботи до повного охолодження
    }
    else
    {                                                                               // Варіант коли вентилятор залишався вимкненим раніше
      fanMsg = "[FAN] Normal conditions --> Fan OFF";                               // Повідомлення про збереження вимкненого стану за відсутності перевищень
    }                                                                               // Закриття перевірки поточного стану вентилятора
  }                                                                                 // Закриття умовного блоку логіки роботи кліматичної системи

  String anomalyMsg = "";                                                           // Створення текстової змінної для опису аналітичного висновку
  anomalyFlag = false;                                                              // Скидання прапорця аварії перед початком нової перевірки параметрів
  if (temp > 35.0 && humidity > 85.0)
  {                                                                                 // Перевірка небезпечної комбінації спеки та надзвичайно високої вологості
    anomalyFlag = true;                                                             // Активація системного сигналу тривоги через аварійну ситуацію
    anomalyMsg = "[AI] ANOMALY: Extreme heat and humidity! --> Buzzer ON";          // Попередження про загрозу пожежі чи прориву тепломережі з парою
  }
  else if (temp > 38.0)
  {                                                                                                             // Перевірка критичного підвищення температури понад тридцять вісім градусів
    anomalyFlag = true;                                                                                         // Встановлення прапорця небезпеки сильного перегріву або загоряння
    anomalyMsg = "[AI] ANOMALY: Critical high temperature (" + String(temp, 1) + " C) --> Buzzer ON";           // Запис попередження про критичну спеку із зазначенням температури
  }
  else if (temp < 5.0)
  {                                                                                                             // Перевірка падіння температури нижче порогу замерзання води
    anomalyFlag = true;                                                                                         // Фіксація аварійного стану приміщення через загрозу замерзання труб
    anomalyMsg = "[AI] ANOMALY: Freezing temperature (" + String(temp, 1) + " C) --> Buzzer ON";                // Повідомлення про аварійне падіння температури до морозних значень
  }
  else if (humidity > 90.0)
  {                                                                                                             // Перевірка перевищення критичного рівня вологості понад дев'яносто відсотків
    anomalyFlag = true;                                                                                         // Увімкнення стану небезпеки через можливий потоп або витік води
    anomalyMsg = "[AI] ANOMALY: Flood hazard / high humidity (" + String(humidity, 0) + "%) --> Buzzer ON";     // Формування попередження про небезпеку затоплення приміщення водою
  }
  else
  {                                               // Варіант коли всі виміряні показники перебувають у межах норми
    anomalyMsg = "[AI] Room state: NORMAL";       // Запис інформації про стабільний та безпечний стан кімнати
  }                                               // Закриття блоку аналітичної перевірки критичних відхилень

  if (anomalyFlag)
  {                                               // Перевірка чи був зафіксований хоча б один аварійний випадок
    if (!buzzerActive)
    {                                             // Перевірка чи звуковий випромінювач ще не був активований раніше
      tone(BUZZER_PIN, 1000);                     // Генерація звукового коливання частотою в один кілогерц на зумері
      buzzerActive = true;                        // Збереження прапорця активної роботи звукового випромінювача
    }                                             // Закриття блоку первинного увімкнення генератора звуку
  }
  else
  {                                               // Дія у разі відсутності будь-яких аварійних факторів у кімнаті
    if (buzzerActive)
    {                                             // Перевірка чи звуковий випромінювач працював до цього моменту
      noTone(BUZZER_PIN);                         // Повне припинення подачі коливань на п'єзоелектричний зумер
      buzzerActive = false;                       // Скидання прапорця активного звуку для захисту від збоїв драйвера
    }                                             // Закриття блоку вимкнення звукового сповіщувача
  }                                               // Закриття умовного вибору стану звукової сигналізації

  Serial.println("--- Sensor Data ---");                                     // Друк заголовка розділу поточних показників вимірювальних приладів
  Serial.println("  Temperature:  " + String(temp, 1) + " C");               // Виведення значення температури з точністю до десятих часток градуса
  Serial.println("  Humidity:     " + String(humidity, 0) + " %");           // Виведення цілого значення відносної вологості повітря у відсотках
  Serial.println("  Light:        " + String(lightLevel) + " lux");          // Виведення розрахованого рівня освітленості кімнати у люксах
  Serial.println("  Motion:       " + String(motion ? "YES" : "NO"));        // Друк текстового статусу наявності або відсутності переміщень
  Serial.println();                                                          // Додавання порожнього рядка для відокремлення блоків інформації
  Serial.println("--- Control ---");                                         // Друк заголовка розділу прийнятих системою керуючих рішень
  Serial.println("  " + lightMsg);                                           // Виведення інформаційного повідомлення про поточний стан освітлення
  Serial.println("  " + fanMsg);                                             // Друк сформованого статусу роботи вентилятора приміщення
  Serial.println("  " + anomalyMsg);                                         // Виведення вердикту системи щодо безпеки та роботи сирени

  unsigned long currentTime = millis();                                      // Збереження поточної кількості мілісекунд від моменту старту плати
  if (WiFi.status() != WL_CONNECTED)
  {                                                                          // Перевірка наявності зв'язку та виявлення можливого обриву мережі
    WiFi.begin(ssid, password);                                              // Спроба повторного підключення до бездротової мережі при розриві
  }                                                                          // Закриття блоку перевірки працездатності мережевого підключення

  if (currentTime - lastSendTime >= sendInterval)
  {                                                                          // Перевірка настання чергового шістнадцятисекундного інтервалу відправки
    if (WiFi.status() == WL_CONNECTED)
    {                                                                        // Перевірка чи плата дійсно має активне мережеве з'єднання
      HTTPClient http;                                                       // Створення об'єкта клієнта для виконання мережевих протокольних запитів
      String url = String(thingspeakServer) + "?api_key=" + String(apiKey) + // Формування початкової частини посилання з адресою та ключем
                   "&field1=" + String(temp, 1) +                            // Додавання до запиту першого поля з показником температури
                   "&field2=" + String(humidity, 0) +                        // Додавання до запиту другого поля зі значенням вологості
                   "&field3=" + String(lightLevel) +                         // Додавання до запиту третього поля з рівнем освітленості
                   "&field4=" + String(motion ? 1 : 0) +                     // Додавання четвертого поля з числовим кодом наявності руху
                   "&field5=" + String(fanOn ? 1 : 0) +                      // Додавання п'ятого поля зі статусом увімкнення вентилятора
                   "&field6=" + String(lightOn ? 1 : 0) +                    // Додавання шостого поля з поточним станом кімнатного світла
                   "&field7=" + String(anomalyFlag ? 1 : 0);                 // Додавання сьомого поля з ознакою наявності аварійної ситуації
      http.begin(url);                                                       // Ініціалізація мережевого запиту за сформованою адресою посилання
      int httpCode = http.GET();                                             // Виконання запиту та збереження числового коду відповіді сервера
      if (httpCode > 0)
      {                                                                      // Перевірка отримання валідного коду відповіді від віддаленого сервера
        Serial.println();                                                    // Друк порожнього рядка перед звітом про мережеву операцію
        Serial.println("[THINGSPEAK] Data sent: T=" + String(temp, 1) +      // Початок друку рядка з підтвердженням відправки температури
                       " H=" + String(humidity, 0) +                         // Додавання інформації про надіслану вологість до рядка звіту
                       " L=" + String(lightLevel) +                          // Додавання надісланого рівня освітленості до тексту звіту
                       " M=" + String(motion ? 1 : 0) +                      // Додавання статусу активності руху до підсумкового звіту
                       " | Status: " + String(httpCode));                    // Завершення рядка виведенням отриманого числового статусу сервера
      }                                                                      // Закриття перевірки успішності мережевого обміну
      http.end();                                                            // Звільнення ресурсів клієнта та закриття встановленого з'єднання
    }                                                                        // Закриття блоку роботи з активним бездротовим підключенням
    lastSendTime = currentTime;                                              // Оновлення часу останньої передачі пакета на хмарну платформу
  }                                                                          // Закриття умови настання часу періодичної відправки даних

  Serial.println();                                                          // Друк додаткового порожнього рядка перед завершальною лінією
  Serial.println("--------------------------------------------");            // Виведення горизонтальної лінії для акуратного відокремлення ітерацій
  delay(2000);                                                               // Зупинка виконання циклу на дві секунди до наступного опитування
}                                                                            // Закриття тіла головної циклічної функції мікроконтролера