#ifndef AI_CLASSIFIER_H                                                                 // Захист від повторного включення заголовного файлу
#define AI_CLASSIFIER_H                                                                 // Оголошення макросу заголовка класифікатора

#include <Arduino.h>                                                                    // Підключення базової бібліотеки платформи
#include <math.h>                                                                       // Підключення математичних функцій обчислення

enum MotionClass {                                                                      // Перелік категорій механічного стану об'єкта
  CLASS_CALM = 0,                                                                       // Стан статичного спокою без збурень
  CLASS_NOISE = 1,                                                                      // Стан допустимого побутового вібраційного шуму
  CLASS_IMPACT = 2                                                                      // Стан тривожного удару та механічної загрози
};                                                                                      // Завершення переліку класів руху

struct ClassificationResult {                                                           // Структура збереження результатів класифікації ШІ
  MotionClass motionClass;                                                              // Ідентифікатор визначеного класу руху
  const char* className;                                                                // Текстова назва розпізнаного класу
  float variance;                                                                       // Розрахована дисперсія прискорення
  float peak;                                                                           // Максимальне зафіксоване пікове значення
  float confidence;                                                                     // Розрахований рівень достовірності моделі
  bool isAlarm;                                                                         // Ознака формування сигналу небезпеки
};                                                                                      // Завершення структури результату аналізу

class MotionClassifier {                                                                // Клас інтелектуального аналізу динаміки руху
private:                                                                                // Секція закритих змінних та налаштувань
  static const int WINDOW_SIZE = 25;                                                    // Кількість відліків ковзного вікна
  float buffer[WINDOW_SIZE];                                                            // Кільцевий буфер вибірок динамічного прискорення
  int bufferIndex;                                                                      // Поточний індекс запису нового виміру
  int sampleCount;                                                                      // Кількість накопичених вимірів у буфері
  float noiseVarianceThreshold;                                                         // Поріг дисперсії для побутового шуму
  float impactVarianceThreshold;                                                        // Поріг дисперсії для тривожного удару
  float noisePeakThreshold;                                                             // Поріг амплітуди для побутового шуму
  float impactPeakThreshold;                                                            // Поріг амплітуди для тривожного удару

public:                                                                                 // Секція загальнодоступних методів обробки
  MotionClassifier() {                                                                  // Конструктор ініціалізації класифікатора
    bufferIndex = 0;                                                                    // Скидання вказівника на початок буфера
    sampleCount = 0;                                                                    // Обнулення лічильника накопичених зразків
    noiseVarianceThreshold = 0.35f;                                                     // Встановлення порогової дисперсії шуму
    impactVarianceThreshold = 7.5f;                                                     // Встановлення порогової дисперсії загрози
    noisePeakThreshold = 1.2f;                                                          // Встановлення порогового піку шуму
    impactPeakThreshold = 5.5f;                                                         // Встановлення порогового піку загрози
    for (int i = 0; i < WINDOW_SIZE; i++) {                                             // Цикл очищення комірок буфера пам'яті
      buffer[i] = 0.0f;                                                                 // Запис нульового початкового значення
    }                                                                                   // Завершення циклу очищення буфера
  }                                                                                     // Завершення конструктора класифікатора

  void addSample(float ax, float ay, float az) {                                        // Метод додавання нового просторового відліку
    float magnitude = sqrt(ax * ax + ay * ay + az * az);                                // Обчислення просторової норми вектора
    float dynamicAccel = fabs(magnitude - 9.80665f);                                    // Компенсація сили земного тяжіння
    buffer[bufferIndex] = dynamicAccel;                                                 // Запис динамічного значення у вікно
    bufferIndex = (bufferIndex + 1) % WINDOW_SIZE;                                      // Циклічний зсув індексу ковзного буфера
    if (sampleCount < WINDOW_SIZE) {                                                    // Перевірка заповнення вікна відліками
      sampleCount++;                                                                    // Збільшення кількості активних відліків
    }                                                                                   // Завершення перевірки об'єму даних
  }                                                                                     // Завершення методу накопичення зразків

  ClassificationResult classify() {                                                     // Метод класифікації поточного стану об'єкта
    ClassificationResult result;                                                        // Створення об'єкта вихідного звіту
    if (sampleCount < 5) {                                                              // Перевірка мінімального обсягу вимірів
      result.motionClass = CLASS_CALM;                                                  // Призначення базового класу спокою
      result.className = "calm";                                                        // Встановлення текстової мітки спокою
      result.variance = 0.0f;                                                           // Нульова початкова дисперсія
      result.peak = 0.0f;                                                               // Нульова початкова пікова амплітуда
      result.confidence = 1.0f;                                                         // Максимальна початкова впевненість
      result.isAlarm = false;                                                           // Вимкнений аварійний прапорець
      return result;                                                                    // Повернення початкового звіту системи
    }                                                                                   // Завершення блоку недостатніх даних

    float sum = 0.0f;                                                                   // Змінна накопичення суми амплітуд
    float peak = 0.0f;                                                                  // Змінна пошуку екстремального піка
    for (int i = 0; i < sampleCount; i++) {                                             // Цикл перебору значень усередині вікна
      sum += buffer[i];                                                                 // Додавання поточного відліку до суми
      if (buffer[i] > peak) {                                                           // Перевірка перевищення поточного максимуму
        peak = buffer[i];                                                               // Оновлення зафіксованого значення піка
      }                                                                                 // Завершення перевірки максимуму
    }                                                                                   // Завершення циклу пошуку екстремуму
    float mean = sum / (float)sampleCount;                                              // Розрахунок середнього математичного рівня

    float varianceSum = 0.0f;                                                           // Змінна суми квадратів відхилень
    for (int i = 0; i < sampleCount; i++) {                                             // Цикл розрахунку відхилень від середнього
      float diff = buffer[i] - mean;                                                    // Обчислення різниці з середнім значенням
      varianceSum += diff * diff;                                                       // Додавання квадрата відхилення до суми
    }                                                                                   // Завершення циклу розрахунку різниць
    float variance = varianceSum / (float)sampleCount;                                  // Розрахунок статистичної дисперсії вікна

    result.variance = variance;                                                         // Запис отриманої дисперсії у звіт
    result.peak = peak;                                                                 // Запис зафіксованого піка у звіт

    if (variance >= impactVarianceThreshold || peak >= impactPeakThreshold) {           // Перевірка перевищення порогових меж удару
      result.motionClass = CLASS_IMPACT;                                                // Призначення класу тривожного удару
      result.className = "alarm impact";                                                // Встановлення текстового статусу загрози
      result.isAlarm = true;                                                            // Активація вихідного прапорця тривоги
      float conf = 0.85f + (variance / (variance + 15.0f)) * 0.14f;                     // Адаптивний розрахунок достовірності удару
      if (conf > 0.99f) conf = 0.99f;                                                   // Обмеження максимальної впевненості
      result.confidence = conf;                                                         // Збереження розрахованої достовірності
    } else if (variance >= noiseVarianceThreshold || peak >= noisePeakThreshold) {      // Перевірка меж допустимих коливань шуму
      result.motionClass = CLASS_NOISE;                                                 // Призначення класу побутового шуму
      result.className = "household noise";                                             // Встановлення текстового статусу шуму
      result.isAlarm = false;                                                           // Блокування аварійного прапорця
      float conf = 0.75f + (variance / (variance + 5.0f)) * 0.20f;                      // Адаптивний розрахунок достовірності шуму
      if (conf > 0.95f) conf = 0.95f;                                                   // Обмеження достовірності для шуму
      result.confidence = conf;                                                         // Збереження розрахованої достовірності
    } else {                                                                            // Умова перебування у стані спокою
      result.motionClass = CLASS_CALM;                                                  // Призначення класу спокійного стану
      result.className = "calm";                                                        // Встановлення текстового статусу спокою
      result.isAlarm = false;                                                           // Збереження безпечного статусу тривоги
      float conf = 0.90f + (1.0f - (variance / noiseVarianceThreshold)) * 0.09f;        // Розрахунок достовірності для спокою
      if (conf > 0.99f) conf = 0.99f;                                                   // Обмеження максимального показника
      result.confidence = conf;                                                         // Збереження розрахованої достовірності
    }                                                                                   // Завершення розгалуження класифікації

    return result;                                                                      // Повернення сформованого результату
  }                                                                                     // Завершення методу класифікації

  void reset() {                                                                        // Метод повного скидання класифікатора
    bufferIndex = 0;                                                                    // Обнулення вказівника на початок буфера
    sampleCount = 0;                                                                    // Обнулення лічильника вимірів буфера
    for (int i = 0; i < WINDOW_SIZE; i++) {                                             // Цикл обнулення комірок масиву даних
      buffer[i] = 0.0f;                                                                 // Запис нульового значення у комірку
    }                                                                                   // Завершення циклу очищення буфера
  }                                                                                     // Завершення методу скидання даних
};                                                                                      // Завершення оголошення класу класифікатора

#endif                                                                                  // Завершення блоку умовної компіляції