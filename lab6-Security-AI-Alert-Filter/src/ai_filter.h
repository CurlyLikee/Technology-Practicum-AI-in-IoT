#ifndef AI_FILTER_H                     // Перевірка чи не був підключений цей заголовний файл раніше
#define AI_FILTER_H                     // Оголошення макросу захисту від повторного включення файлу

#include <Arduino.h>                    // Підключення базової бібліотеки типів та функцій середовища Arduino

enum SecurityClass                      // Тип перерахування класів подій
{                                       // Перерахування класів класифікації подій системи безпеки
  CLASS_NORMAL = 0,                     // Нормальний стан без виявлених загроз
  CLASS_NOISE = 1,                      // Хибне спрацювання через апаратні шуми або перешкоди
  CLASS_PET = 2,                        // Хибне спрацювання викликане рухом домашнього улюбленця
  CLASS_HUMAN_INTRUSION = 3             // Критична тривога реальне проникнення людини
};                                      // Кінець визначення перерахування SecurityClass

enum PolicyMode                         // Тип перерахування режимів політики
{                                       // Перерахування режимів роботи політики чутливості
  MODE_DAY,                             // Денний режим з підвищеною толерантністю
  MODE_NIGHT,                           // Нічний режим з високою чутливістю
  MODE_AWAY                             // Режим відсутності господарів з максимально суворим контролем
};                                      // Кінець визначення перерахування PolicyMode

struct TimingPolicy                     // Тип структури часових параметрів
{                                       // Структура часових параметрів та порогів політики
  PolicyMode mode;                      // Поточний активний режим політики
  unsigned long noiseThresholdMs;       // Поріг відсікання коротких шумів у мілісекундах
  unsigned long petMaxDurationMs;       // Максимальна тривалість сигналу характерна для тварин
  unsigned long verificationWindowMs;   // Вікно валідації сумісного спрацювання сенсорів у мілісекундах
  unsigned long alarmHoldMs;            // Тривалість утримання сигналу тривоги в мілісекундах
  float confidenceThreshold;            // Мінімальний поріг впевненості для прийняття рішення
};                                      // Кінець структури TimingPolicy

struct FeatureVector                    // Тип структури вектора ознак сенсорів
{                                       // Структура вхідного вектора ознак для класифікатора
  bool reedOpen;                        // Ознака розмикання геркона або відкриття дверей
  unsigned long motionDurationMs;       // Виміряна тривалість імпульсу датчика руху в мілісекундах
  int pulseCount;                       // Кількість зареєстрованих імпульсів сенсора за час активності
  long delayReedToPirMs;                // Затримка між відкриттям геркона і виявленням руху
};                                      // Кінець структури FeatureVector

static TimingPolicy currentPolicy = {   // Ініціалізація поточної політики безпеки
    MODE_NIGHT,                         // Базовий режим за замовчуванням нічний
    350,                                // Поріг фільтрації шуму триста п'ятдесят мілісекунд
    2200,                               // Максимальний час руху для тварин дві тисячі двісті мілісекунд
    6000,                               // Часове вікно перевірки шість тисяч мілісекунд
    4000,                               // Час активності тривоги чотири тисячі мілісекунд
    0.75                                // Поріг достовірності нуль цілих сімдесят п'ять сотих
};                                      // Кінець ініціалізації структури currentPolicy

inline const char *getClassName(SecurityClass sc)            // Оголошення функції визначення текстового імені класу загрози
{                                                            // Функція повернення текстової назви класу
  switch (sc)                                                // Вибір назви для переданого класу безпеки
  {                                                          // Вибір назви відповідно до значення класу безпеки
  case CLASS_NORMAL:                                         // Обробка нормального стану безпеки
    return "NORMAL";                                         // Повернення назви для нормального стану
  case CLASS_NOISE:                                          // Обробка стану хибного шуму
    return "FALSE_ALARM (NOISE/GLITCH)";                     // Повернення назви для хибного шуму
  case CLASS_PET:                                            // Обробка стану руху тварини
    return "FALSE_ALARM (PET_MOVEMENT)";                     // Повернення назви для руху тварини
  case CLASS_HUMAN_INTRUSION:                                // Обробка стану проникнення людини
    return "CRITICAL_ALARM (HUMAN_INTRUSION)";               // Повернення назви для вторгнення
  default:                                                   // Варіант для невідомого стану
    return "UNKNOWN";                                        // Повернення невідомого стану для інших значень
  }                                                          // Кінець конструкції switch
}                                                            // Кінець функції getClassName

inline void applyLLMPolicy(PolicyMode newMode)                                                              // Головна функція застосування вибраної часової політики
{                                                                                                           // Функція оновлення політики з відповідними параметрами
  currentPolicy.mode = newMode;                                                                             // Збереження нового активного режиму
  if (newMode == MODE_DAY)                                                                                  // Перевірка умови вибору денного режиму
  {                                                                                                         // Перевірка чи вибрано денний режим
    currentPolicy.noiseThresholdMs = 450;                                                                   // Встановлення порогу шуму для денного режиму
    currentPolicy.petMaxDurationMs = 2800;                                                                  // Встановлення тривалості руху тварини для дня
    currentPolicy.verificationWindowMs = 7000;                                                              // Встановлення вікна верифікації для дня
    currentPolicy.alarmHoldMs = 3000;                                                                       // Встановлення часу тривоги для дня
    currentPolicy.confidenceThreshold = 0.80;                                                               // Встановлення порогу впевненості для дня
    Serial.println();                                                                                       // Друк порожнього рядка для відступу
    Serial.println("[LLM-POLICY] DAY_MODE activated.");                                                     // Сповіщення про активацію денного режиму
  }                                                                                                         // Завершення налаштування параметрів для дня
  else if (newMode == MODE_NIGHT)                                                                           // Перевірка умови вибору нічного режиму
  {                                                                                                         // Перевірка чи вибрано нічний режим
    currentPolicy.noiseThresholdMs = 300;                                                                   // Встановлення порогу шуму для ночі
    currentPolicy.petMaxDurationMs = 2000;                                                                  // Встановлення тривалості руху тварини для ночі
    currentPolicy.verificationWindowMs = 5000;                                                              // Встановлення вікна верифікації для ночі
    currentPolicy.alarmHoldMs = 5000;                                                                       // Встановлення часу тривоги для ночі
    currentPolicy.confidenceThreshold = 0.70;                                                               // Встановлення порогу впевненості для ночі
    Serial.println();                                                                                       // Друк порожнього рядка для відступу
    Serial.println("[LLM-POLICY] NIGHT_MODE activated.");                                                   // Сповіщення про активацію нічного режиму
  }                                                                                                         // Завершення налаштування параметрів для ночі
  else if (newMode == MODE_AWAY)                                                                            // Перевірка умови вибору режиму відсутності
  {                                                                                                         // Перевірка чи вибрано режим поза домом
    currentPolicy.noiseThresholdMs = 200;                                                                   // Встановлення порогу шуму для режиму відсутності
    currentPolicy.petMaxDurationMs = 1500;                                                                  // Встановлення тривалості руху тварини при відсутності
    currentPolicy.verificationWindowMs = 4000;                                                              // Встановлення вікна верифікації при відсутності
    currentPolicy.alarmHoldMs = 7000;                                                                       // Встановлення часу тривоги при відсутності
    currentPolicy.confidenceThreshold = 0.65;                                                               // Встановлення порогу впевненості при відсутності
    Serial.println();                                                                                       // Друк порожнього рядка для відступу
    Serial.println("[LLM-POLICY] AWAY_MODE activated.");                                                    // Сповіщення про активацію режиму відсутності
  }                                                                                                         // Кінець блоку перевірки умов режимів
}                                                                                                           // Кінець функції applyLLMPolicy

inline SecurityClass evaluateAIClassifier(FeatureVector features, float &outConfidence)                     // Оголошення функції класифікації вхідного вектора ознак
{                                                                     // Функція оцінки ознак класифікатором
  if (features.reedOpen)                                              // Перевірка умови відчинених дверей
  {                                                                   // Перевірка чи зафіксовано відкриття дверей герконом
    if (features.motionDurationMs > currentPolicy.noiseThresholdMs)   // Перевірка перевищення порогу тривалості шуму
    {                                                                 // Якщо тривалість руху перевищує поріг шуму
      outConfidence = 0.96;                                           // Встановлення впевненості дев'яносто шість відсотків
      return CLASS_HUMAN_INTRUSION;                                   // Повернення висновку про вторгнення людини
    }                                                                 // Кінець блоку тривалого руху після дверей
    else if (features.motionDurationMs > 0)                           // Перевірка наявності короткого руху після дверей
    {                                                                 // Якщо рух зафіксовано але він короткий
      outConfidence = 0.75;                                           // Встановлення впевненості сімдесят п'ять відсотків
      return CLASS_HUMAN_INTRUSION;                                   // Повернення висновку про підозріле проникнення
    }                                                                 // Кінець вкладеної умови перевірки тривалості
  }                                                                   // Кінець умови перевірки відкритого геркона

  if (features.motionDurationMs > 0 && features.motionDurationMs <= currentPolicy.noiseThresholdMs)     // Перевірка потрапляння у діапазон короткого шуму
  {                                                                                                     // Перевірка чи рух потрапляє у діапазон короткого шуму
    outConfidence = 0.88;                                                                               // Встановлення впевненості вісімдесят вісім відсотків
    return CLASS_NOISE;                                                                                 // Повернення класу короткого шуму
  }                                                                                                     // Кінець умови класифікації шуму

  if (features.motionDurationMs > currentPolicy.noiseThresholdMs &&   // Перевірка нижньої межі діапазону для руху тварини
      features.motionDurationMs <= currentPolicy.petMaxDurationMs)    // Перевірка верхньої межі тривалості для тварин
  {                                                                   // Перевірка верхньої межі діапазону для руху тварини
    if (features.pulseCount <= 3)                                     // Перевірка малої кількості імпульсів тварини
    {                                                                 // Якщо зареєстровано невелику кількість імпульсів
      outConfidence = 0.84;                                           // Встановлення впевненості вісімдесят чотири відсотки
      return CLASS_PET;                                               // Повернення класу руху домашньої тварини
    }                                                                 // Кінець перевірки спокійної поведінки тварини
    else                                                              // Гілка більшої кількості імпульсів тварини
    {                                                                 // Якщо імпульсів більше норми для спокійної тварини
      outConfidence = 0.72;                                           // Встановлення помірної впевненості сімдесят два відсотки
      return CLASS_PET;                                               // Повернення класу домашньої тварини
    }                                                                 // Кінець умови перевірки кількості імпульсів
  }                                                                   // Кінець умови класифікації руху тварини

  if (features.motionDurationMs > currentPolicy.petMaxDurationMs)     // Перевірка перевищення максимального часу для тварин
  {                                                                   // Якщо рух тривалий і перевищує максимум для тварин
    outConfidence = 0.91;                                             // Встановлення високої впевненості дев'яносто один відсоток
    return CLASS_HUMAN_INTRUSION;                                     // Повернення класу активності людини
  }                                                                   // Кінець умови тривалого руху

  outConfidence = 1.0;                                                // Встановлення стовідсоткової впевненості для стану спокою
  return CLASS_NORMAL;                                                // Повернення класу нормального стану безпеки
}                                                                     // Кінець функції evaluateAIClassifier

#endif                                                                // Завершення директиви перевірки заголовного файлу