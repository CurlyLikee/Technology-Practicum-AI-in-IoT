#include <WiFi.h>                                                                       // Підключення бібліотеки бездротової мережі для плати
#include <DHT.h>                                                                        // Підключення бібліотеки кліматичного сенсора температури
#include <PubSubClient.h>                                                               // Підключення клієнтської бібліотеки мережевого протоколу
#include <time.h>                                                                       // Підключення системної бібліотеки часу та синхронізації
#include "ai_model.h"                                                                   // Підключення модуля штучного інтелекту та прогнозування

const char* ssid = "Wokwi-GUEST";                                                       // Ідентифікатор точки доступу тестової бездротової мережі
const char* password = "";                                                              // Пароль бездротової мережі для гостьового доступу

const char* mqttServer = "broker.hivemq.com";                                           // Адреса публічного мережевого брокера повідомлень
const int mqttPort = 1883;                                                              // Стандартний мережевий порт брокера для передачі телеметрії
const char* topicTelemetry = "agro/alona_hruieva/telemetry";                            // Назва каналу для публікації вимірювань агросистеми
const char* topicCommands = "agro/alona_hruieva/commands";                              // Назва каналу для отримання команд дистанційного керування

const char* ntpServer = "pool.ntp.org";                                                 // Сервер точного мережевого часу для синхронізації
const long gmtOffset_sec = 7200;                                                        // Зсув часу відносно нульового меридіана у секундах
const int daylightOffset_sec = 0;                                                       // Додатковий сезонний зсув для переходу на літній час

#define DHT_PIN 4                                                                       // Цифровий пін для зчитування даних мікроклімату
#define SOIL_PIN 34                                                                     // Аналоговий пін місткісного сенсора вологості грунту
#define SOIL_RESISTIVE_PIN 35                                                           // Аналоговий пін резистивного сенсора вологості грунту
#define PH_PIN 32                                                                       // Аналоговий пін модуля визначення кислотності грунту
#define RELAY_PUMP_PIN 25                                                               // Цифровий пін керування силовим реле водяного насоса
#define RELAY_FAN_PIN 26                                                                // Цифровий пін керування силовим реле вентилятора обдуву
#define LED_PIN 2                                                                       // Цифровий пін індикаторного світлодіода активності поливу

#define DHT_TYPE DHT22                                                                  // Встановлення модифікації сенсора клімату
DHT dht(DHT_PIN, DHT_TYPE);                                                             // Створення екземпляра обєкта кліматичного сенсора
WiFiClient espClient;                                                                   // Створення клієнта мережевого зєднання для протоколів
PubSubClient mqtt(espClient);                                                           // Створення екземпляра протокольного клієнта передачі даних
AgroAIEngine aiEngine;                                                                  // Створення екземпляра інтелектуального рушія агросистеми
AgroTelemetry telemetry;                                                                // Структура для передачі показників сенсорів у модуль аналізу
AIPredictionResult aiResult;                                                            // Структура для збереження результатів розрахунків моделі

float temperature = 0.0;                                                                // Змінна температури повітря у градусах Цельсія
float humidity = 0.0;                                                                   // Змінна відносної вологості повітря у відсотках
int soilMoistureRaw = 0;                                                                // Сире цифрове значення місткісного сенсора вологості
int soilMoisturePercent = 0;                                                            // Розрахована вологість грунту з місткісного сенсора
int soilResistiveRaw = 0;                                                               // Сире цифрове значення резистивного сенсора вологості
int soilResistivePercent = 0;                                                           // Розрахована вологість грунту з резистивного датчика
float phValue = 7.0;                                                                    // Поточне значення водневого показника кислотності

bool pumpStatus = false;                                                                // Поточний логічний стан роботи силового реле насоса
bool fanStatus = false;                                                                 // Поточний логічний стан роботи реле системи вентиляції
int wateringDuration = 0;                                                               // Фактична тривалість останнього циклу поливу у секундах
int irrigationCount = 0;                                                                // Загальна кількість успішно виконаних циклів поливу

const int DRY_THRESHOLD = 30;                                                           // Пороговий рівень сухості грунту для активації насоса
const int TARGET_MOISTURE = 50;                                                         // Цільовий відсоток зволоження грунту для завершення
const unsigned long MAX_WATERING_TIME = 30000;                                          // Максимальний час безпечної роботи насоса у мілісекундах
const float TEMP_FAN_THRESHOLD = 30.0;                                                  // Температурний поріг для увімкнення охолодження повітря

unsigned long lastUpdate = 0;                                                           // Мітка часу останньої відправки телеметрії у мілісекундах
unsigned long wateringStartTime = 0;                                                    // Мітка часу моменту запуску насоса у мілісекундах
unsigned long lastWateringEnd = 0;                                                      // Мітка часу моменту вимкнення насоса у мілісекундах
unsigned long lastDigestTime = 0;                                                       // Мітка часу генерації інтелектуального дайджесту
unsigned long lastMqttReconnect = 0;                                                    // Мітка часу останньої спроби підключення до брокера
const unsigned long UPDATE_INTERVAL = 3000;                                             // Інтервал публікації телеметрії у брокер три секунди
const unsigned long WATERING_COOLDOWN = 5000;                                           // Мінімальний захисний інтервал між сесіями поливу
const unsigned long DIGEST_INTERVAL = 32000;                                            // Періодичність виводу аналітичного дайджесту тридцять дві секунди

const int CAP_AIR_VALUE = 1680;                                                         // Калібрувальне значення місткісного сенсора на сухому повітрі
const int CAP_WATER_VALUE = 3620;                                                       // Калібрувальне значення місткісного сенсора у воді
const int RES_AIR_VALUE = 4095;                                                         // Калібрувальне значення резистивного сенсора у сухому грунті
const int RES_WATER_VALUE = 1000;                                                       // Калібрувальне значення резистивного сенсора у вологому грунті
const float PH_VOLTAGE_NEUTRAL = 2.5;                                                   // Напруга сенсора кислотності для нейтрального рівня сім
const float PH_VOLTAGE_PER_UNIT = 0.18;                                                 // Чутливість сенсора кислотності у вольтах на одиницю показника

void readSensors();                                                                     // Прототип функції опитування всіх підключених датчиків
void evaluateAI();                                                                      // Прототип функції виклику аналізу штучного інтелекту
void controlIrrigation();                                                               // Прототип функції алгоритму керування зрошенням грунту
void controlFan();                                                                      // Прототип функції температурного контролю вентилятора
void startPump();                                                                       // Прототип функції апаратного увімкнення водяного насоса
void stopPump();                                                                        // Прототип функції апаратного вимкнення водяного насоса
void sendMQTTTelemetry();                                                               // Прототип функції публікації телеметрії у мережевий брокер
void reconnectMQTT();                                                                   // Прототип функції відновлення мережевого зєднання з брокером
void mqttCallback(char* topic, byte* payload, unsigned int length);                     // Прототип функції обробки вхідних дистанційних команд
void logEvent(const char* category, const char* message);                               // Прототип функції ведення системного журналу подій
void printTableRow(const char* name, const char* val, const char* unit);                // Прототип функції виводу одного рядка таблиці
void printDataTable();                                                                  // Прототип функції виводу структурованої таблиці в термінал

void setup() {                                                                          // Функція первинного налаштування мікроконтролера
  Serial.begin(115200);                                                                 // Ініціалізація послідовного порту зі швидкістю обміну
  Serial.println();                                                                     // Відступ порожнім рядком після системного завантаження
  Serial.println("===================");                                                // Вивід верхньої межі назви проєкту в термінал
  Serial.println("AI Smart Agriculture System");                                        // Вивід назви розробленої системи агромоніторингу
  Serial.println("===================");                                                // Вивід нижньої межі назви проєкту в термінал
  Serial.println();                                                                     // Відступ порожнім рядком після виводу назви проєкту
  pinMode(RELAY_PUMP_PIN, OUTPUT);                                                      // Конфігурація цифрового виводу насоса у режим виходу
  pinMode(RELAY_FAN_PIN, OUTPUT);                                                       // Конфігурація цифрового виводу вентилятора у режим виходу
  pinMode(LED_PIN, OUTPUT);                                                             // Конфігурація цифрового виводу індикатора у режим виходу
  digitalWrite(RELAY_PUMP_PIN, LOW);                                                    // Встановлення низького рівня для вимкнення реле насоса
  digitalWrite(RELAY_FAN_PIN, LOW);                                                     // Встановлення низького рівня для вимкнення вентилятора
  digitalWrite(LED_PIN, LOW);                                                           // Встановлення низького рівня для вимкнення індикатора
  dht.begin();                                                                          // Апаратна ініціалізація роботи сенсора клімату
  Serial.print("Connecting to WiFi: ");                                                 // Вивід підпису процедури підключення до мережі
  Serial.print(ssid);                                                                   // Друк назви бездротової точки доступу без переходу рядка
  Serial.print(" ");                                                                    // Вивід пробілу перед точками прогресу підключення
  WiFi.begin(ssid, password);                                                           // Запуск процедури підключення до бездротової мережі
  while (WiFi.status() != WL_CONNECTED) {                                               // Очікування встановлення зєднання з бездротовою мережею
    delay(500);                                                                         // Затримка пів секунди під час опитування стану мережі
    Serial.print(".");                                                                  // Вивід крапки для візуалізації процесу підключення
  }                                                                                     // Завершення циклу очікування підключення до мережі
  Serial.println();                                                                     // Перехід на новий рядок після завершення підключення
  Serial.print("WiFi connected, IP: ");                                                 // Вивід повідомлення про успішне підключення до мережі
  Serial.println(WiFi.localIP());                                                       // Друк локальної мережевої адреси плати в термінал
  mqtt.setServer(mqttServer, mqttPort);                                                 // Конфігурація мережевої адреси та порту брокера
  mqtt.setCallback(mqttCallback);                                                       // Реєстрація функції обробника вхідних мережевих пакетів
  configTime(gmtOffset_sec, daylightOffset_sec, ntpServer);                             // Налаштування сервісу мережевого часу для відліку
  Serial.print("Synchronizing time with NTP server...");                                // Інформаційне сповіщення про старт синхронізації часу
  int ntpRetry = 0;                                                                     // Лічильник спроб отримання мережевого часу від сервера
  while (time(nullptr) < 100000 && ntpRetry < 30) {                                     // Очікування синхронізації з сервером точного часу
    delay(150);                                                                         // Затримка між ітераціями перевірки мережевого часу
    Serial.print(".");                                                                  // Візуалізація процесу очікування мережевої відповіді
    ntpRetry++;                                                                         // Інкремент лічильника виконаних перевірок часу
  }                                                                                     // Завершення блоку очікування синхронізації часу
  Serial.println();                                                                     // Переведення курсора термінала на новий рядок
  Serial.println("Time synchronized successfully with NTP server");                     // Підтвердження успішної синхронізації системного часу
  Serial.println();                                                                     // Відступ перед виводом стартового системного запису
  logEvent("SYSTEM", "Smart Agro AI system initialized with MQTT");                     // Запис стартової системної події у журнал моніторингу
  Serial.println();                                                                     // Відступ перед підключенням до мережевого брокера
  reconnectMQTT();                                                                      // Початкове підключення до брокера перед стартом циклу
}                                                                                       // Завершення функції первинного налаштування системи

void loop() {                                                                           // Головний безперервний робочий цикл програми
  if (!mqtt.connected()) {                                                              // Перевірка активності зєднання з мережевим брокером
    reconnectMQTT();                                                                    // Виклик процедури відновлення зв’язку з брокером
  }                                                                                     // Завершення блоку контролю мережевого підключення
  mqtt.loop();                                                                          // Обробка черги повідомлень протокольного клієнта
  readSensors();                                                                        // Опитування фізичних сенсорів та первинна обробка даних
  evaluateAI();                                                                         // Передача даних рушію штучного інтелекту для аналізу
  controlIrrigation();                                                                  // Прийняття рішення та керування зрошенням субстрату
  controlFan();                                                                         // Прийняття рішення щодо охолодження та мікроклімату
  if (millis() - lastUpdate >= UPDATE_INTERVAL) {                                       // Перевірка необхідності відправки пакету телеметрії
    sendMQTTTelemetry();                                                                // Публікація свіжого пакету телеметрії у брокер
    lastUpdate = millis();                                                              // Фіксація часу останньої передачі даних у сховище
  }                                                                                     // Завершення блоку перевірки таймера відправки даних
  if (millis() - lastDigestTime >= DIGEST_INTERVAL) {                                   // Перевірка настання часу формування аналітичного звіту
    aiEngine.printLLMDigest(telemetry, aiResult);                                       // Виклик генератора інтелектуального розгорнутого дайджесту
    lastDigestTime = millis();                                                          // Оновлення часової мітки виводу аналітичного дайджесту
  }                                                                                     // Завершення блоку періодичної генерації дайджесту
  printDataTable();                                                                     // Вивід оновленої структурованої таблиці стану компонентів
  delay(2000);                                                                          // Пауза тривалістю дві секунди між робочими ітераціями
}                                                                                       // Завершення головного циклу виконання програми

void readSensors() {                                                                    // Функція опитування та масштабування даних сенсорів
  temperature = dht.readTemperature();                                                  // Зчитування показника температури з цифрового сенсора
  humidity = dht.readHumidity();                                                        // Зчитування показника вологості повітря з сенсора
  if (isnan(temperature) || isnan(humidity)) {                                          // Перевірка коректності зчитаних значень клімату
    temperature = 22.0;                                                                 // Встановлення номінального значення температури при помилці
    humidity = 55.0;                                                                    // Встановлення номінального значення вологості при помилці
  }                                                                                     // Завершення блоку перевірки валідності кліматичних даних
  soilMoistureRaw = analogRead(SOIL_PIN);                                               // Зчитування амплітуди напруги з місткісного сенсора
  soilMoisturePercent = map(soilMoistureRaw, CAP_AIR_VALUE,                             // Масштабування сирого значення місткісного датчика
                            CAP_WATER_VALUE, 0, 100);                                   // Завершення перетворення у шкалу від нуля до ста
  soilMoisturePercent = constrain(soilMoisturePercent, 0, 100);                         // Обмеження розрахованого значення допустимим діапазоном
  soilResistiveRaw = analogRead(SOIL_RESISTIVE_PIN);                                    // Зчитування значення аналогового сигналу резистивного датчика
  soilResistivePercent = map(soilResistiveRaw, RES_AIR_VALUE,                           // Масштабування сирого сигналу резистивного датчика
                             RES_WATER_VALUE, 0, 100);                                  // Завершення масштабування показника у відсотки
  soilResistivePercent = constrain(soilResistivePercent, 0, 100);                       // Нормалізація результату у межах від нуля до ста
  int phRaw = analogRead(PH_PIN);                                                       // Зчитування аналогової напруги модуля визначення кислотності
  float voltage = (float)phRaw * (3.3 / 4095.0);                                        // Переведення виміряного сигналу у значення напруги в вольтах
  phValue = 7.0 + ((PH_VOLTAGE_NEUTRAL - voltage) /                                     // Обчислення кислотності грунту за характеристикою сенсора
                   PH_VOLTAGE_PER_UNIT);                                                // Завершення розрахунку величини водневого показника
  phValue = constrain(phValue, 0.0, 14.0);                                              // Обмеження діапазону шкали кислотності від нуля до чотирнадцяти
}                                                                                       // Завершення функції опитування підключених давачів

void evaluateAI() {                                                                     // Функція формування вхідних даних та розрахунку моделі
  telemetry.airTemperature = temperature;                                               // Передача поточної температури повітря у структуру даних
  telemetry.airHumidity = humidity;                                                     // Передача поточної відносної вологості атмосфери
  telemetry.soilMoistureCapacitive = soilMoisturePercent;                               // Передача відсотка зволоження з місткісного сенсора
  telemetry.soilMoistureResistive = soilResistivePercent;                               // Передача відсотка зволоження з резистивного сенсора
  telemetry.soilPh = phValue;                                                           // Передача поточного водневого показника кислотності грунту
  aiResult = aiEngine.analyze(telemetry);                                               // Виклик аналітичного методу прогнозування моделі інтелекту
}                                                                                       // Завершення процедури інтелектуальної оцінки агросистеми

void controlIrrigation() {                                                              // Функція алгоритму керування зрошенням та безпекою
  if (pumpStatus) {                                                                     // Перевірка чи знаходиться насос в активному стані подачі
    unsigned long currentDuration = millis() - wateringStartTime;                       // Розрахунок часу поточної безперервної роботи насоса
    bool targetReached = (soilMoisturePercent >= TARGET_MOISTURE);                      // Перевірка чи досягнуто бажаного рівня зволоження
    bool timeoutReached = (currentDuration >= MAX_WATERING_TIME);                       // Перевірка спрацювання захисного часового обмеження
    if (targetReached || timeoutReached) {                                              // Умова зупинки процесу зрошення за цільовим рівнем або лімітом
      stopPump();                                                                       // Виклик процедури вимкнення подачі води насосом
    }                                                                                   // Завершення блоку умов зупинки активного поливу
  } else {                                                                              // Гілка алгоритму для випадку коли насос наразі вимкнено
    unsigned long cooldown = (lastWateringEnd == 0) ?                                   // Розрахунок часу що минув після завершення останнього поливу
      WATERING_COOLDOWN : (millis() - lastWateringEnd);                                 // Захист від передчасного повторного запуску зволоження
    bool ready = (cooldown >= WATERING_COOLDOWN);                                       // Перевірка готовності системи до нового циклу зрошення
    bool dry = (soilMoisturePercent < DRY_THRESHOLD);                                   // Перевірка чи впала вологість нижче мінімального порогу
    bool aiNeed = aiResult.wateringRecommended &&                                       // Перевірка комплексної рекомендації алгоритму моделі
                  (soilMoisturePercent < TARGET_MOISTURE);                              // Узгодження рекомендації з цільовим рівнем вологості
    if ((dry || aiNeed) && ready) {                                                     // Перевірка умов потреби та дозволу запуску зрошення
      startPump();                                                                      // Активація поливної помпи для подачі води рослинам
    }                                                                                   // Завершення блоку прийняття рішення про увімкнення
  }                                                                                     // Завершення блоку аналізу стану поливної системи
}                                                                                       // Завершення функції керування процесом зволоження

void startPump() {                                                                      // Функція активації реле подачі води та індикації
  pumpStatus = true;                                                                    // Зміна глобальної змінної статусу насоса на увімкнено
  wateringStartTime = millis();                                                         // Запамятовування моменту часу увімкнення водяного насоса
  digitalWrite(RELAY_PUMP_PIN, HIGH);                                                   // Подача високого керуючого сигналу для спрацювання реле
  digitalWrite(LED_PIN, HIGH);                                                          // Увімкнення сигнального світлодіода активності помпи
  irrigationCount++;                                                                    // Інкремент лічильника загальної кількості поливів
  char msg[90];                                                                         // Буферний масив для формування текстового повідомлення
  snprintf(msg, sizeof(msg), "Pump started. Moisture: %d%%, Duration: %d sec",          // Запис повідомлення про запуск помпи та розраховані параметри
           soilMoisturePercent, aiResult.recommendedDurationSec);                       // Передача числових аргументів у рядок повідомлення
  Serial.println();                                                                     // Відступ перед сповіщенням про запуск помпи
  logEvent("PUMP", msg);                                                                // Фіксація події запуску помпи в системному журналі
  Serial.println("[PUMP ACTION] Irrigation relay CLOSED, LED indicator ON");            // Сповіщення про фізичне спрацювання реле та світлодіода
  Serial.print("[PUMP ACTION] Soil moisture: ");                                        // Вивід підпису параметра поточної вологості грунту
  Serial.print(soilMoisturePercent);                                                    // Друк значення відсотка вологості на момент старту
  Serial.print(" %, AI Target: ");                                                      // Вивід підпису цільового порогу зволоження грунту
  Serial.print(TARGET_MOISTURE);                                                        // Друк цільового порогу вологості у відсотках
  Serial.println(" %");                                                                 // Завершення рядка з інформацією про вологість
  Serial.println();                                                                     // Відступ після повідомлення про запуск помпи
}                                                                                       // Завершення функції увімкнення водяного насоса

void stopPump() {                                                                       // Функція деактивації реле подачі води та скидання
  pumpStatus = false;                                                                   // Зміна глобальної змінної статусу насоса на вимкнено
  wateringDuration = (int)((millis() - wateringStartTime) / 1000);                      // Обчислення тривалості відпрацьованого циклу у секундах
  lastWateringEnd = millis();                                                           // Запамятовування часової мітки завершення сесії поливу
  digitalWrite(RELAY_PUMP_PIN, LOW);                                                    // Подача низького рівня на реле для зупинки насоса
  digitalWrite(LED_PIN, LOW);                                                           // Вимкнення світлодіодного індикатора подачі води
  char msg[90];                                                                         // Буферний масив для формування тексту повідомлення
  snprintf(msg, sizeof(msg), "Pump stopped. Runtime: %d sec, Moisture: %d%%",           // Запис текстового підсумку роботи із часом та вологістю
           wateringDuration, soilMoisturePercent);                                      // Передача числових значень тривалості та вологості
  Serial.println();                                                                     // Відступ перед сповіщенням про зупинку помпи
  logEvent("PUMP", msg);                                                                // Запис події вимкнення насоса у системний журнал
  Serial.println("[PUMP ACTION] Irrigation relay OPENED, LED indicator OFF");           // Сповіщення про фізичне розмикання реле помпи та вимкнення LED
  Serial.print("[PUMP ACTION] Total duration: ");                                       // Вивід підпису фактичної тривалості роботи насоса
  Serial.print(wateringDuration);                                                       // Друк тривалості відпрацьованого часу у секундах
  Serial.println(" sec");                                                               // Друк одиниці вимірювання часу після числового значення
  Serial.println();                                                                     // Відступ після повідомлення про зупинку помпи
}                                                                                       // Завершення функції вимкнення водяного насоса

void controlFan() {                                                                     // Функція температурного контролю охолодження та обдуву
  if (temperature > TEMP_FAN_THRESHOLD && !fanStatus) {                                 // Перевірка перевищення температури та стану вентилятора
    fanStatus = true;                                                                   // Встановлення глобального прапорця роботи вентилятора
    digitalWrite(RELAY_FAN_PIN, HIGH);                                                  // Подача сигналу спрацьовування на реле вентилятора
    char msg[90];                                                                       // Буферний масив для формування тексту сповіщення
    snprintf(msg, sizeof(msg), "High temp detected: %.1f C. Fan started",               // Формування тексту сповіщення про активацію охолодження
             temperature);                                                              // Передача поточного значення температури у текст
    Serial.println();                                                                   // Відступ перед сповіщенням про запуск вентилятора
    logEvent("FAN", msg);                                                               // Запис події увімкнення охолодження у журнал системи
    Serial.println("[FAN ACTION] Cooling relay CLOSED, Ventilation ON");                // Сповіщення про фізичне замикання контактів реле обдуву
    Serial.println();                                                                   // Відступ після сповіщення про запуск вентилятора
  } else if (temperature <= (TEMP_FAN_THRESHOLD - 2.0) && fanStatus) {                  // Перевірка зниження температури з урахуванням гістерезису
    fanStatus = false;                                                                  // Скидання глобального прапорця роботи вентилятора
    digitalWrite(RELAY_FAN_PIN, LOW);                                                   // Подача низького рівня на реле для зупинки вентилятора
    char msg[90];                                                                       // Буферний масив для сповіщення про вимкнення
    snprintf(msg, sizeof(msg), "Temp normalized: %.1f C. Fan stopped",                  // Формування тексту сповіщення про зупинку вентилятора
             temperature);                                                              // Передача виміряного показника температури у текст
    Serial.println();                                                                   // Відступ перед сповіщенням про зупинку вентилятора
    logEvent("FAN", msg);                                                               // Запис події вимкнення охолодження у журнал
    Serial.println("[FAN ACTION] Cooling relay OPENED, Ventilation OFF");               // Сповіщення про фізичне розмикання контактів реле вентилятора
    Serial.println();                                                                   // Відступ після сповіщення про зупинку вентилятора
  }                                                                                     // Завершення блоку умов керування вентилятором
}                                                                                       // Завершення функції автоматичного кліматичного контролю

void sendMQTTTelemetry() {                                                              // Функція формування та публікації пакету телеметрії
  if (!mqtt.connected()) return;                                                        // Перевірка наявності активного підключення перед відправкою
  char payload[250];                                                                    // Буферний символьний масив для тексту мережевого повідомлення
  snprintf(payload, sizeof(payload),                                                    // Форматування числових показників датчиків у рядок даних
           "{\"temp\":%.1f,\"hum\":%.1f,\"soil_cap\":%d,\"soil_res\":%d,"               // Перша частина структури переданих кліматичних вимірювань
           "\"ph\":%.2f,\"pump\":%d,\"fan\":%d,\"score\":%d,"                           // Друга частина набору даних зі станом реле та індексом
           "\"pred\":%.1f,\"vpd\":%.2f,\"drying\":%.2f}",                               // Завершальна частина пакету з прогнозом та випаровуванням
           temperature, humidity, soilMoisturePercent, soilResistivePercent,            // Передача значень клімату та вологості у функцію друку
           phValue, pumpStatus ? 1 : 0, fanStatus ? 1 : 0, aiResult.irrigationScore,    // Передача показників стану актуаторів та розрахунку ШІ
           aiResult.predictedMoisture1h, aiResult.vpdKpa, aiResult.dryingRatePerHour);  // Передача фізичних прогнозних показників розрахунку моделі
  bool success = mqtt.publish(topicTelemetry, payload);                                 // Публікація сформованого пакету даних у визначений канал
  if (success) {                                                                        // Перевірка результату успішної передачі мережевого пакету
    Serial.println();                                                                   // Відступ перед сповіщенням про публікацію даних
    Serial.println("[MQTT] Telemetry published to agro/alona_hruieva/telemetry");       // Сповіщення про успішну доставку вимірювань на брокер
    Serial.print("[MQTT] Payload: ");                                                   // Вивід текстового префіксу переданого тіла повідомлення
    Serial.println(payload);                                                            // Друк повного вмісту сформованого інформаційного пакету
    Serial.println();                                                                   // Відступ після виводу інформації про відправлений пакет
  } else {                                                                              // Гілка дій у разі виникнення помилки публікації пакету
    Serial.println();                                                                   // Відступ перед повідомленням про помилку відправки
    Serial.println("[MQTT] Publish failed, buffer or connection error");                // Сповіщення про невдалу спробу відправки вимірювань
    Serial.println();                                                                   // Відступ після виводу помилки публікації пакету
  }                                                                                     // Завершення перевірки статусу публікації пакету даних
}                                                                                       // Завершення функції публікації телеметрії у мережевий брокер

void reconnectMQTT() {                                                                  // Функція безпечного відновлення зєднання з сервером брокера
  if (WiFi.status() != WL_CONNECTED) return;                                            // Перевірка фізичного зєднання перед підключенням до брокера
  if (lastMqttReconnect != 0 && millis() - lastMqttReconnect < 5000) return;            // Захисна пауза між повторними спробами підключення
  lastMqttReconnect = millis();                                                         // Оновлення мітки часу останньої спроби входу на брокер
  char clientId[35];                                                                    // Буферний масив для унікального ідентифікатора клієнта
  snprintf(clientId, sizeof(clientId), "agro-alona-hruieva-%04X",                       // Формування ідентифікатора з персональним ім’ям
           (uint16_t)(millis() & 0xFFFF));                                              // Додавання унікального суфікса для виключення колізій на брокері
  Serial.print("[MQTT] Connecting to broker HiveMQ as ");                               // Вивід текстового повідомлення про початок авторизації
  Serial.print(clientId);                                                               // Друк згенерованого імені пристрою у термінал системи
  Serial.println("...");                                                                // Завершення інформаційного рядка сповіщення про зв’язок
  if (mqtt.connect(clientId)) {                                                         // Спроба встановлення клієнтської сесії з мережевим брокером
    mqtt.subscribe(topicCommands);                                                      // Оформлення підписки на отримання дистанційних команд
    Serial.println();                                                                   // Відступ перед системним сповіщенням про зв’язок
    logEvent("MQTT", "Connected to HiveMQ broker and subscribed");                      // Запис події встановлення мережевого зв’язку в журнал
    Serial.println();                                                                   // Відступ після успішного підключення до брокера
  } else {                                                                              // Гілка дій при отриманні відмови або помилки зєднання
    Serial.print("[MQTT] Connection failed, rc=");                                      // Вивід текстового підпису системного коду помилки клієнта
    Serial.println(mqtt.state());                                                       // Друк числового значення статусу помилки підключення
  }                                                                                     // Завершення блоку перевірки встановленого зєднання
}                                                                                       // Завершення функції відновлення зєднання з брокером

void mqttCallback(char* topic, byte* payload, unsigned int length) {                    // Функція обробника вхідних мережевих повідомлень керування
  char message[50];                                                                     // Буферний масив для збереження отриманого тексту команди
  unsigned int copyLen = (length < sizeof(message) - 1) ?                               // Визначення безпечної довжини копіювання отриманих байтів
                         length : (sizeof(message) - 1);                                // Захист від переповнення виділеного буферного масиву тексту
  memcpy(message, payload, copyLen);                                                    // Копіювання байтів повідомлення у внутрішній символьний буфер
  message[copyLen] = '\0';                                                              // Встановлення кінцевого нульового символу завершення рядка
  Serial.println();                                                                     // Відступ перед виводом отриманої дистанційної команди
  Serial.print("[MQTT COMMAND] Received on topic: ");                                   // Вивід назви каналу з якого надійшла керуюча команда
  Serial.print(topic);                                                                  // Друк текстової назви топіка у послідовний термінал
  Serial.print(" | Payload: ");                                                         // Вивід розділювача між топіком та вмістом команди
  Serial.println(message);                                                              // Друк отриманого тексту команди в термінал системи
  Serial.println();                                                                     // Відступ після виводу отриманої дистанційної команди
  if (strstr(message, "PUMP_ON") || strstr(message, "\"pump\":1")) {                    // Аналіз команди запиту примусового увімкнення поливу
    if (!pumpStatus) {                                                                  // Перевірка чи насос наразі ще не запущений у роботу
      startPump();                                                                      // Активація насоса за отриманою дистанційною вказівкою
      logEvent("REMOTE", "Pump started by remote MQTT command");                        // Запис події дистанційного пуску насоса у журнал
    }                                                                                   // Завершення блоку перевірки попереднього стану насоса
  } else if (strstr(message, "PUMP_OFF") || strstr(message, "\"pump\":0")) {            // Аналіз команди примусового припинення процесу поливу
    if (pumpStatus) {                                                                   // Перевірка чи знаходиться насос у процесі активної роботи
      stopPump();                                                                       // Зупинка роботи насоса за дистанційною вказівкою користувача
      logEvent("REMOTE", "Pump stopped by remote MQTT command");                        // Запис події дистанційної зупинки насоса у журнал
    }                                                                                   // Завершення блоку перевірки поточної активності насоса
  }                                                                                     // Завершення перевірки варіантів отриманих команд керування
}                                                                                       // Завершення функції зворотного виклику обробки команд

void logEvent(const char* category, const char* message) {                              // Функція форматування та виводу повідомлень журналу
  struct tm timeinfo;                                                                   // Структура для збереження компонентів поточного часу
  char timeStr[20];                                                                     // Символьний буфер для формування рядка з часом
  if (getLocalTime(&timeinfo)) {                                                        // Опитування локального часу синхронізованого за протоколом
    snprintf(timeStr, sizeof(timeStr), "%02d:%02d:%02d",                                // Запис годин, хвилин та секунд у буферний рядок
             timeinfo.tm_hour, timeinfo.tm_min, timeinfo.tm_sec);                       // Передача компонентів часу у функцію форматування
  } else {                                                                              // Гілка дій якщо локальний мережевий час недоступний
    unsigned long sec = millis() / 1000;                                                // Обчислення кількості секунд від моменту старту плати
    snprintf(timeStr, sizeof(timeStr), "%02lu:%02lu:%02lu",                             // Запис відліку часу роботи системи у форматі годин
             (sec / 3600) % 24, (sec / 60) % 60, sec % 60);                             // Завершення формування рядка часу за системним лічильником
  }                                                                                     // Завершення блоку визначення поточного системного часу
  char logLine[150];                                                                    // Буферний масив для повного тексту рядка журналу
  snprintf(logLine, sizeof(logLine), "[%s] [%s] %s",                                    // Формування тексту із часом, категорією та змістом
           timeStr, category, message);                                                 // Передача параметрів для створення рядка журналу
  Serial.println(logLine);                                                              // Друк сформованого інформаційного повідомлення журналу
}                                                                                       // Завершення функції реєстрації події у журналі системи

void printTableRow(const char* name, const char* val, const char* unit) {               // Функція форматованого друку одного рядка таблиці
  char rowBuffer[70];                                                                   // Символьний буфер фіксованого розміру для рядка таблиці
  snprintf(rowBuffer, sizeof(rowBuffer), "| %-34s | %-10s | %-6s |", name, val, unit);  // Форматування стовпців назви показника та одиниць виміру
  Serial.println(rowBuffer);                                                            // Друк сформованого відкаліброваного рядка у термінал
}                                                                                       // Завершення функції виводу одного рядка таблиці

void printDataTable() {                                                                 // Функція виводу структурованої таблиці стану компонентів
  char valBuf[16];                                                                      // Буферний масив для перетворення числових значень у текст
  Serial.println();                                                                     // Вивід порожнього рядка для вертикального розділення
  Serial.println("+------------------------------------+------------+--------+");       // Верхня горизонтальна межа структурованої таблиці
  Serial.println("| Monitored Parameter                | Value      | Unit   |");       // Заголовки стовпців параметрів значень та одиниць
  Serial.println("+------------------------------------+------------+--------+");       // Розділювач заголовка від рядків з вимірюваннями
  snprintf(valBuf, sizeof(valBuf), "%.1f", temperature);                                // Конвертація поточної температури повітря у текстовий формат
  printTableRow("Air Temperature", valBuf, "C");                                        // Друк рядка поточної температури повітря у таблицю
  snprintf(valBuf, sizeof(valBuf), "%.1f", humidity);                                   // Конвертація відносної вологості атмосфери у текстовий формат
  printTableRow("Air Humidity", valBuf, "%");                                           // Друк рядка відносної вологості повітря у таблицю
  snprintf(valBuf, sizeof(valBuf), "%d", soilMoisturePercent);                          // Конвертація вологості місткісного сенсора у текст
  printTableRow("Soil Moisture Capacitive", valBuf, "%");                               // Друк рядка вологості місткісного сенсора у таблицю
  snprintf(valBuf, sizeof(valBuf), "%d", soilResistivePercent);                         // Конвертація вологості резистивного сенсора у текст
  printTableRow("Soil Moisture Resistive", valBuf, "%");                                // Друк рядка показника резистивного сенсора вологості
  snprintf(valBuf, sizeof(valBuf), "%.2f", phValue);                                    // Конвертація водневого показника кислотності у текст
  printTableRow("Soil pH Level", valBuf, "pH");                                         // Друк рядка показника кислотності грунтового субстрату
  printTableRow("Irrigation Pump Relay", pumpStatus ? "ON" : "OFF", "status");          // Друк рядка робочого стану реле насоса зрошення
  printTableRow("Cooling Fan Relay", fanStatus ? "ON" : "OFF", "status");               // Друк рядка робочого стану реле системи вентиляції
  printTableRow("Status Indicator LED", pumpStatus ? "ON" : "OFF", "status");           // Друк рядка робочого стану сигнального світлодіода
  snprintf(valBuf, sizeof(valBuf), "%d", aiResult.irrigationScore);                     // Конвертація розрахованого індексу штучного інтелекту
  printTableRow("AI Irrigation Need Score", valBuf, "/100");                            // Друк рядка розрахованої інтелектуальної потреби поливу
  snprintf(valBuf, sizeof(valBuf), "%.1f", aiResult.predictedMoisture1h);               // Конвертація прогнозованої вологості грунту через годину
  printTableRow("AI Predicted Moisture 1h", valBuf, "%");                               // Друк рядка прогнозу вологості грунту через одну годину
  Serial.println("+------------------------------------+------------+--------+");       // Нижня завершальна горизонтальна лінія таблиці
  Serial.println();                                                                     // Вивід завершального порожнього рядка після таблиці
}                                                                                       // Завершення функції виводу структурованої таблиці
