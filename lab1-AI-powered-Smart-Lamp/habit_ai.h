#pragma once                                                                           // Запобігає повторному підключенню заголовного файлу
#include <Arduino.h>                                                                   // Підключає базові типи та функції платформи Arduino
#include <math.h>                                                                      // Підключає бібліотеку математичних обчислень

#ifndef AI_ON_TH                                                                       // Перевіряє відсутність визначення порогу ввімкнення
#define AI_ON_TH 0.62f                                                                 // Встановлює числове значення порогу спрацьовування моделі
#endif                                                                                 // Завершує директиву перевірки порогу ввімкнення
#ifndef AI_OFF_TH                                                                      // Перевіряє відсутність визначення порогу вимкнення
#define AI_OFF_TH 0.38f                                                                // Встановлює числове значення порогу деактивації навантаження
#endif                                                                                 // Завершує директиву перевірки порогу вимкнення
#ifndef AI_LR                                                                          // Перевіряє відсутність визначення швидкості навчання
#define AI_LR 0.08f                                                                    // Встановлює коефіцієнт кроку градієнтного спуску
#endif                                                                                 // Завершує директиву перевірки швидкості навчання

struct AiFeatures                                                                      // Оголошує структуру вхідних параметрів моделі
{                                                                                      // Відкриває блок опису полів ознак
  uint8_t hour;                                                                        // Зберігає значення поточної години доби
  uint8_t weekday;                                                                     // Зберігає числовий індекс дня тижня
  uint8_t motion;                                                                      // Зберігає бінарну ознаку присутності людини
  uint8_t dark;                                                                        // Зберігає бінарну ознаку настання сутінків
};                                                                                     // Закриває блок опису полів ознак

static float W_BIAS = -1.69f;                                                          // Зберігає вагу вільного члена моделі
static float W_HSIN = -0.14f;                                                          // Зберігає ваговий коефіцієнт гармонійної компоненти синуса
static float W_HCOS = 0.25f;                                                           // Зберігає ваговий коефіцієнт гармонійної компоненти косинуса
static float W_MOTION = 2.60f;                                                         // Зберігає ваговий коефіцієнт фактора руху
static float W_DARK = 0.76f;                                                           // Зберігає ваговий коефіцієнт фактора освітленості
static float W_WD = -0.37f;                                                            // Зберігає ваговий коефіцієнт фактора дня тижня

static float gSlot[24];                                                                // Оголошує масив вагових коефіцієнтів годин доби

static float clampf(float x, float a, float b)                                         // Обмежує значення змінної у заданому числовому діапазоні
{                                                                                      // Відкриває тіло функції обмеження діапазону
  if (x < a)                                                                           // Перевіряє вихід значення за нижню межу
    return a;                                                                          // Повертає значення мінімальної межі
  if (x > b)                                                                           // Перевіряє вихід значення за верхню межу
    return b;                                                                          // Повертає значення максимальної межі
  return x;                                                                            // Повертає вхідне число без змін
}                                                                                      // Закриває тіло функції обмеження діапазону

static float sigmoid(float z)                                                          // Розраховує логістичну функцію активації
{                                                                                      // Відкриває тіло обчислення сигмоїди
  if (z > 12)                                                                          // Перевіряє значення на додатне насичення
    return 1.f;                                                                        // Повертає одиницю для запобігання переповненню
  if (z < -12)                                                                         // Перевіряє значення на від'ємне насичення
    return 0.f;                                                                        // Повертає нуль для запобігання переповненню
  return 1.f / (1.f + expf(-z));                                                       // Обчислює значення математичної сигмоїди
}                                                                                      // Закриває тіло обчислення сигмоїди

inline void habitInit()                                                                // Заповнює початкові значення ймовірностей для часових слотів
{                                                                                      // Відкриває функцію ініціалізації масиву
  for (int h = 0; h < 24; h++)                                                         // Запускає перебір індексів доби
  {                                                                                    // Відкриває блок призначення початкових ваг
    if (h >= 18 && h <= 22)                                                            // Перевіряє приналежність години до вечірнього піку
      gSlot[h] = 0.55f;                                                                // Задає підвищену базову ймовірність для вечора
    else if (h >= 6 && h <= 8)                                                         // Перевіряє приналежність години до ранкового інтервалу
      gSlot[h] = 0.35f;                                                                // Задає помірну базову ймовірність для ранку
    else                                                                               // Обробляє всі інші години доби
      gSlot[h] = 0.12f;                                                                // Задає мінімальну фонову ймовірність
  }                                                                                    // Закриває блок призначення початкових ваг
}                                                                                      // Закриває функцію ініціалізації масиву

inline float habitSlot(uint8_t hour)                                                   // Повертає збережене значення ймовірності для обраної години
{                                                                                      // Відкриває тіло вибірки з масиву
  return gSlot[hour % 24];                                                             // Читає коефіцієнт з масиву з контролем діапазону індексу
}                                                                                      // Закриває тіло вибірки з масиву

inline float habitPredict(const AiFeatures &f)                                         // Обчислює підсумкову ймовірність ввімкнення освітлення
{                                                                                      // Відкриває функцію інференсу моделі
  const float ang = 2.f * 3.14159265f * (float)f.hour / 24.f;                          // Перетворює годину в кутовий радіанний масштаб
  const float hs = sinf(ang);                                                          // Обчислює тригонометричну складову синуса часу
  const float hc = cosf(ang);                                                          // Обчислює тригонометричну складову косинуса часу
  const float z = W_BIAS + W_HSIN * hs + W_HCOS * hc + W_MOTION * (float)f.motion +    // Розраховує скалярний добуток ваг на ознаки активності
                  W_DARK * (float)f.dark + W_WD * ((float)f.weekday / 6.f);            // Додає вплив фактора темряви та нормалізованого дня
  const float pLogit = sigmoid(z);                                                     // Перетворює результат регресії у ймовірність
  const float pSlot = gSlot[f.hour % 24];                                              // Зчитує статистичну вагу поточного часового інтервалу
  return clampf(0.62f * pLogit + 0.38f * pSlot, 0.f, 1.f);                             // Зважує результати регресії та слота з нормалізацією меж
}                                                                                      // Закриває функцію інференсу моделі

inline void habitLearn(const AiFeatures &f, float label)                               // Виконує корекцію вагових коефіцієнтів методом градієнтного спуску
{                                                                                      // Відкриває функцію адаптивного навчання
  const uint8_t h = f.hour % 24;                                                       // Визначає безпечний індекс години доби
  gSlot[h] = clampf(0.75f * gSlot[h] + 0.25f * label, 0.02f, 0.98f);                   // Оновлює коефіцієнт слота за алгоритмом ковзного середнього

  const float ang = 2.f * 3.14159265f * (float)f.hour / 24.f;                          // Обчислює циклічний кут доби
  const float hs = sinf(ang);                                                          // Отримує гармонійну проєкцію синуса
  const float hc = cosf(ang);                                                          // Отримує гармонійну проєкцію косинуса
  const float z = W_BIAS + W_HSIN * hs + W_HCOS * hc + W_MOTION * (float)f.motion +    // Вираховує вихід лінійної моделі перед функцією активації
                  W_DARK * (float)f.dark + W_WD * ((float)f.weekday / 6.f);            // Враховує параметри сенсора світла та дня тижня
  const float p = sigmoid(z);                                                          // Отримує поточну ймовірність моделі
  const float err = p - label;                                                         // Обчислює величину нев'язки між прогнозом та дією
  W_BIAS -= AI_LR * err;                                                               // Коригує вільний член моделі
  W_HSIN -= AI_LR * err * hs;                                                          // Коригує ваговий коефіцієнт синусної складової
  W_HCOS -= AI_LR * err * hc;                                                          // Коригує ваговий коефіцієнт косинусної складової
  W_MOTION -= AI_LR * err * (float)f.motion;                                           // Коригує ваговий коефіцієнт сигналу руху
  W_DARK -= AI_LR * err * (float)f.dark;                                               // Коригує ваговий коефіцієнт сигналу темряви
  W_WD -= AI_LR * err * ((float)f.weekday / 6.f);                                      // Коригує ваговий коефіцієнт календарного дня
}                                                                                      // Закриває функцію адаптивного навчання

inline void habitDecayHour(uint8_t hour)                                               // Знижує вагу застарілих даних для певної години
{                                                                                      // Відкриває функцію поступового забування звичок
  const uint8_t h = hour % 24;                                                         // Обмежує діапазон індексу години
  gSlot[h] = clampf(0.97f * gSlot[h], 0.02f, 0.98f);                                   // Зменшує ймовірність за формулою експоненційного згасання
}                                                                                      // Закриває функцію поступового забування звичок

inline const char *habitExplain(const AiFeatures &f, float p)                          // Формує текстове обґрунтування логіки прийнятого рішення
{                                                                                      // Відкриває блок генерації пояснення
  if (p >= AI_ON_TH && f.dark && f.motion)                                             // Перевіряє сукупність критеріїв для активації освітлення
    return "habit+dark+motion => ON";                                                  // Повертає повідомлення про спрацювання комплексу умов
  if (p <= AI_OFF_TH)                                                                  // Перевіряє факт недостатньої ймовірності моделі
    return "low habit => prefer OFF";                                                  // Повертає повідомлення про відсутність вираженої звички
  if (!f.dark)                                                                         // Перевіряє стан надлишкового природного освітлення
    return "bright room, AI holds OFF";                                                // Повертає повідомлення про блокування світлом
  if (!f.motion)                                                                       // Перевіряє факт відсутності активності в зоні сенсора
    return "no occupancy, wait";                                                       // Повертає повідомлення про режим очікування присутності
  return "hysteresis band, keep state";                                                // Повертає повідомлення про збереження стану в зоні гістерезису
}                                                                                      // Закриває блок генерації пояснення