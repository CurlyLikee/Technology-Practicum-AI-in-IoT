#define BLYNK_TEMPLATE_ID "TMPL4ieBAK6RG"                     // Визначає ідентифікатор шаблону Blynk
#define BLYNK_TEMPLATE_NAME "AI Smart Lamp"                   // Визначає назву шаблону Blynk
#define BLYNK_AUTH_TOKEN "B64CYQ2KBO3oXkK64_5uNaeUgJ6HIMft"   // Визначає токен авторизації Blynk
#define BLYNK_PRINT Serial                                    // Вказує порт виведення логів Blynk

#include <WiFi.h>                                             // Підключає бібліотеку для роботи з мережею WiFi
#include <BlynkSimpleEsp32.h>                                 // Підключає бібліотеку взаємодії з Blynk для ESP32
#include <HTTPClient.h>                                       // Підключає бібліотеку виконання HTTP запитів
#include "habit_ai.h"                                         // Підключає модуль штучного інтелекту звичок

#define PIN_RELAY 19                                          // Задає номер піна керування реле
#define PIN_LDR 34                                            // Задає номер аналогового піна фоторезистора
#define PIN_PIR 26                                            // Задає номер піна датчика руху
#define PIN_BTN 27                                            // Задає номер піна тактової кнопки

#define RELAY_ACTIVE_HIGH 1                                   // Задає прямий тип сигналу для реле

#define ADC_DARK_ON 2400                                      // Задає поріг освітленості для темряви
#define ADC_BRIGHT_OFF 1600                                   // Задає поріг освітленості для світла

#define BTN_DEBOUNCE_MS 20                                    // Задає час фільтрації брязкоту кнопки
#define BTN_LONG_MS 1000                                      // Задає поріг тривалого утримання кнопки
#define FSM_MIN_HOLD_MS 3000                                  // Задає час стабілізації стану автомата
#define AUTO_OFF_MS 8000                                      // Задає інтервал автовимкнення за відсутності руху

#define WIFI_SSID "Wokwi-GUEST"                               // Задає назву віртуальної мережі симулятора
#define WIFI_PASS ""                                          // Задає порожній пароль мережі симулятора

#define THINGSPEAK_KEY "G429ED3BG18WWTSL"                     // Задає ключ запису на канал ThingSpeak
#define THINGSPEAK_MS 16000                                   // Задає період передачі пакетів на ThingSpeak

#define TELEMETRY_MS 1500                                     // Задає період виведення даних у термінал
#define SIM_MINUTE_EVERY_MS 1500                              // Задає тривалість однієї віртуальної хвилини

enum LampMode : uint8_t                                       // Оголошує перелік режимів функціонування системи
{                                                             // Відкриває блок переліку режимів
  MODE_MANUAL = 0,                                            // Визначає повністю ручний режим керування
  MODE_AUTO = 1,                                              // Визначає автоматичний режим за датчиками
  MODE_AI = 2                                                 // Визначає адаптивний режим на основі моделі
};                                                            // Закриває блок переліку режимів

enum LampState : uint8_t                                      // Оголошує перелік можливих станів освітлення
{                                                             // Відкриває блок переліку станів
  ST_OFF = 0,                                                 // Визначає стан вимкненого освітлення
  ST_ON = 1                                                   // Визначає стан активного освітлення
};                                                            // Закриває блок переліку станів

struct FsmInput                                               // Оголошує структуру вхідних сигналів скінченного автомата
{                                                             // Відкриває опис полів структури
  bool dark;                                                  // Зберігає ознаку недостатнього освітлення
  bool motion;                                                // Зберігає факт виявлення руху в зоні
  bool btnShort;                                              // Зберігає ознаку короткого натискання кнопки
  bool btnLong;                                               // Зберігає ознаку тривалого утримання кнопки
  float aiProb;                                               // Зберігає розраховану ймовірність потреби світла
};                                                            // Закриває опис полів структури

struct FsmOutput                                              // Оголошує структуру вихідних команд автомата
{                                                             // Відкриває опис полів виходу
  LampMode mode;                                              // Повертає поточний активний режим
  LampState state;                                            // Повертає сформований стан автомата
  bool lampOn;                                                // Повертає логічний рівень керування навантаженням
  const char *reason;                                         // Повертає причину спрацювання логіки
};                                                            // Закриває опис полів виходу

static LampMode gMode = MODE_AUTO;                            // Зберігає глобальний режим роботи системи
static LampState gState = ST_OFF;                             // Зберігає глобальний стан навантаження
static uint32_t gLastChange = 0;                              // Фіксує системний час останнього перемикання
static uint32_t gLastMotion = 0;                              // Фіксує системний час останньої фіксації руху
static const char *gReason = "boot";                          // Зберігає текстовий опис події зміни стану

const char *modeName(LampMode m)                              // Отримує рядкову назву для режиму роботи
{                                                             // Відкриває тіло функції назви режиму
  switch (m)                                                  // Аналізує код поточного режиму
  {                                                           // Відкриває гілки селектора режиму
  case MODE_MANUAL:                                           // Обробляє випадок ручного режиму
    return "MANUAL";                                          // Повертає назву ручного керування
  case MODE_AUTO:                                             // Обробляє випадок автоматичного режиму
    return "AUTO";                                            // Повертає назву автоматичного керування
  default:                                                    // Обробляє інший встановлений режим
    return "AI";                                              // Повертає назву інтелектуального режиму
  }                                                           // Закриває гілки селектора режиму
}                                                             // Закриває тіло функції назви режиму

const char *stateName(LampState s)                            // Отримує рядкову назву поточного стану
{                                                             // Відкриває тіло функції назви стану
  return s == ST_ON ? "ON" : "OFF";                           // Повертає текст стану навантаження
}                                                             // Закриває тіло функції назви стану

void fsmInit()                                                // Ініціалізує початковий стан автомата
{                                                             // Відкриває тіло функції ініціалізації
  gMode = MODE_AUTO;                                          // Призначає початковий автоматичний режим
  gState = ST_OFF;                                            // Встановлює початковий вимкнений стан
  gLastChange = gLastMotion = 0;                              // Обнуляє таймери відліку інтервалів
  gReason = "init";                                           // Фіксує початкову мітку старту
}                                                             // Закриває тіло функції ініціалізації

void fsmSetMode(LampMode m, uint32_t nowMs)                   // Змінює поточний режим роботи автомата
{                                                             // Відкриває тіло встановлення режиму
  gMode = m;                                                  // Записує нове значення режиму
  gReason = "mode_set";                                       // Записує мітку зміни режиму
  gLastChange = nowMs;                                        // Оновлює мітку часу зміни налаштувань
}                                                             // Закриває тіло встановлення режиму

void fsmForce(LampState s, uint32_t nowMs, const char *why)   // Примусово змінює стан навантаження
{                                                             // Відкриває тіло примусового запису
  gState = s;                                                 // Записує новий стан навантаження
  gLastChange = nowMs;                                        // Оновлює системний час модифікації
  gReason = why;                                              // Зберігає причину примусового перемикання
}                                                             // Закриває тіло примусового запису

static void setState(LampState s, uint32_t nowMs, const char *why)  // Встановлює стан за умови закінчення інтервалу стабілізації
{                                                                   // Відкриває перевірку умов перемикання
  if (s == gState)                                                  // Перевіряє чи співпадає стан із поточним
    return;                                                         // Завершує виконання без модифікації даних
  if (nowMs - gLastChange < FSM_MIN_HOLD_MS)                        // Перевіряє захисний інтервал від брязкоту логіки
    return;                                                         // Завершує виконання при активному інтервалі утримання
  gState = s;                                                       // Записує підтверджений стан навантаження
  gLastChange = nowMs;                                              // Оновлює таймер останньої зміни стану
  gReason = why;                                                    // Зберігає текстову причину автоматичного перемикання
}                                                                   // Закриває перевірку умов перемикання

static void applyBtnToggle(uint32_t nowMs, const char *why)         // Інвертує стан і переводить пристрій у ручний режим
{                                                                   // Відкриває логіку перемикання кнопкою
  gMode = MODE_MANUAL;                                              // Вмикає ручний режим для блокування автовимкнення
  const LampState nextState = (gState == ST_ON) ? ST_OFF : ST_ON;   // Визначає протилежний стан навантаження
  fsmForce(nextState, nowMs, why);                                  // Встановлює інвертований стан
}                                                                   // Закриває логіку перемикання кнопкою

FsmOutput fsmTick(const FsmInput &in, uint32_t nowMs)         // Обробляє логіку автоматних переходів за подіями
{                                                             // Відкриває блок такту автомата
  if (in.motion)                                              // Перевіряє фіксацію активності датчиком
    gLastMotion = nowMs;                                      // Оновлює мітку останнього зафіксованого руху

  if (in.btnLong)                                             // Перевіряє подію тривалого натискання клавіші
  {                                                           // Відкриває обробку зміни режиму кнопкою
    gMode = (LampMode)((gMode + 1) % 3);                      // Змінює режим на наступний по колу
    gReason = "mode_cycle";                                   // Фіксує причину зміни конфігурації
    gLastChange = nowMs;                                      // Оновлює час фіксації натискання
  }                                                           // Закриває обробку зміни режиму кнопкою

  if (in.btnShort)                                            // Перевіряє наявність короткого імпульсу кнопки
  {                                                           // Відкриває блок обробки дії кнопки
    applyBtnToggle(nowMs, "btn_toggle");                      // Перемикає навантаження в протилежний стан
  }                                                           // Закриває блок обробки дії кнопки
  else if (gMode == MODE_AUTO)                                // Перевіряє виконання автоматичного режиму
  {                                                           // Відкриває гілку автоматичного керування
    if (in.dark && in.motion)                                 // Перевіряє одночасну темряву та рух
      setState(ST_ON, nowMs, "auto_dark_motion");             // Вмикає світло за датчиками
    else if (!in.dark)                                        // Перевіряє наявність достатнього денного світла
      setState(ST_OFF, nowMs, "auto_bright");                 // Вимикає світло через високу освітленість
    else if (nowMs - gLastMotion > AUTO_OFF_MS)               // Перевіряє перевищення ліміту очікування руху
      setState(ST_OFF, nowMs, "auto_timeout");                // Вимикає світло за таймером бездіяльності
  }                                                           // Закриває гілку автоматичного керування
  else if (gMode == MODE_AI)                                  // Перевіряє виконання інтелектуального режиму
  {                                                           // Відкриває гілку моделі прогнозування
    if (gState == ST_OFF)                                     // Перевіряє стан вимкненого освітлення
    {                                                         // Відкриває блок аналізу на ввімкнення
      if (in.aiProb >= AI_ON_TH && in.dark && in.motion)      // Перевіряє високу ймовірність темряву та рух
        setState(ST_ON, nowMs, "ai_habit_on");                // Вмикає світло за рішенням алгоритму
    }                                                         // Закриває блок аналізу на ввімкнення
    else                                                      // Обробляє стан коли освітлення вже активне
    {                                                         // Відкриває блок аналізу на скидання
      const bool stale = (nowMs - gLastMotion > AUTO_OFF_MS); // Визначає застарілість сигналу присутності людини
      if (!in.dark || in.aiProb <= AI_OFF_TH || stale)        // Перевіряє фактори вимкнення за моделлю
        setState(ST_OFF, nowMs, stale ? "ai_timeout" : (!in.dark ? "ai_bright" : "ai_habit_off"));  // Вимикає навантаження
    }                                                         // Закриває блок аналізу на скидання
  }                                                           // Закриває гілку інтелектуального режиму

  FsmOutput o;                                                // Створює локальний об'єкт вихідних даних
  o.mode = gMode;                                             // Записує актуальний режим у структуру
  o.state = gState;                                           // Записує підсумковий стан у структуру
  o.lampOn = (gState == ST_ON);                               // Формує булевий стан виходу
  o.reason = gReason;                                         // Передає назву поточної події
  return o;                                                   // Повертає результат виконання кроку
}                                                             // Закриває блок такту автомата

static bool gDark = false;                                    // Зберігає ознаку низької освітленості
static bool gMotion = false;                                  // Зберігає цифровий рівень сигналу руху
static bool gBtnShort = false;                                // Прапорець зафіксованого короткого кліку
static bool gBtnLong = false;                                 // Прапорець зафіксованого утримання кнопки
static int gAdc = 0;                                          // Зберігає розрядність напруги з фоторезистора
static float gProb = 0.f;                                     // Зберігає вихідне значення ймовірності моделі
static FsmOutput gOut = {MODE_AUTO, ST_OFF, false, "boot"};   // Ініціалізує збережені вихідні параметри

static uint8_t gHour = 19;                                    // Зберігає поточну годину доби для симуляції
static uint8_t gMin = 0;                                      // Зберігає поточну хвилину для симуляції
static uint8_t gWday = 2;                                     // Зберігає поточний індекс дня тижня
static uint32_t gLastSimMin = 0;                              // Зберігає час останнього приросту хвилини
static uint32_t gLastTelem = 0;                               // Зберігає таймкод останнього логування
static uint32_t gLastTs = 0;                                  // Зберігає таймкод сесії ThingSpeak
static uint32_t gLastBlynk = 0;                               // Зберігає час циклу оновлення віджетів

static bool gBtnLast = true;                                  // Зберігає попереднє фізичне значення виводу кнопки
static uint32_t gBtnDownAt = 0;                               // Фіксує час переходу в натиснутий стан
static uint32_t gBtnEdgeAt = 0;                               // Фіксує момент останньої зміни сигналу лінії
static bool gBtnArmed = false;                                // Прапорець готовності до реєстрації відпускання
static bool gBtnLongSent = false;                             // Прапорець блокування повтору довгого кліку

static void pushBlynk()                                       // Передає значення змінних на дашборд застосунку
{                                                             // Відкриває функцію синхронізації Blynk
  Blynk.virtualWrite(V0, gOut.lampOn ? "ON" : "OFF");         // Відправляє рядок поточного стану світла
  Blynk.virtualWrite(V1, gAdc);                               // Відправляє дані вимірювання фотосенсора
  Blynk.virtualWrite(V2, gMotion ? "motion" : "clear");       // Відправляє статус сенсора присутності
  Blynk.virtualWrite(V3, gProb);                              // Відправляє коефіцієнт впевненості моделі
  Blynk.virtualWrite(V4, modeName(gOut.mode));                // Відправляє назву поточного режиму роботи
}                                                             // Закриває функцію синхронізації Blynk

BLYNK_WRITE(V5)                                               // Отримує команду натискання віртуальної кнопки
{                                                             // Відкриває обробник віртуального піна V5
  int val = param.asInt();                                    // Зчитує надіслане числове значення
  if (val == 1)                                               // Реагує виключно на фронт натискання
  {                                                           // Відкриває блок виконання команди перемикання
    const uint32_t now = millis();                            // Зчитує системний час надходження команди
    applyBtnToggle(now, "blynk_toggle");                      // Інвертує навантаження та фіксує ручний режим
    Serial.printf("[Blynk] V5 toggle => Lamp %s\r\n", (gState == ST_ON) ? "ON" : "Off");  // Виводить новий стан
    pushBlynk();                                              // Негайно надсилає оновлені дані в застосунок
  }                                                           // Закриває блок виконання команди перемикання
}                                                             // Закриває обробник віртуального піна V5

BLYNK_WRITE(V6)                                               // Отримує команду зміни режиму з перемикача
{                                                             // Відкриває обробник віртуального піна V6
  int val = param.asInt();                                    // Зчитує індекс обраного положення
  const uint32_t now = millis();                              // Фіксує час отримання команди
  if (val == 0)                                               // Перевіряє вибір першого положення
    fsmSetMode(MODE_AUTO, now);                               // Вмикає режим автоматичної реакції на датчики
  else if (val == 1)                                          // Перевіряє вибір другого положення
    fsmSetMode(MODE_MANUAL, now);                             // Вмикає режим прямого ручного керування
  else                                                        // Обробляє третє доступне положення
    fsmSetMode(MODE_AI, now);                                 // Вмикає режим прогнозування на базі моделі
  Serial.printf("[Blynk] V6 mode => %s\r\n", modeName(gMode));// Виводить у порт підтвердження встановлення режиму
  pushBlynk();                                                // Оновлює статус режиму на панелі Blynk
}                                                             // Закриває обробник віртуального піна V6

static void setRelay(bool on)                                 // Перемикає цифровий стан керованого виводу реле
{                                                             // Відкриває функцію встановлення піна
#if RELAY_ACTIVE_HIGH                                         // Перевіряє налаштування полярності сигналу
  digitalWrite(PIN_RELAY, on ? HIGH : LOW);                   // Виставляє прямий логічний рівень
#else                                                         // Використовує зворотну полярність сигналу
  digitalWrite(PIN_RELAY, on ? LOW : HIGH);                   // Виставляє інвертований логічний рівень
#endif                                                        // Закриває директиву вибору полярності
}                                                             // Закриває функцію встановлення піна

static void updateLightHysteresis(int adc)                    // Виконує перерахунок зони гістерезису датчика світла
{                                                             // Відкриває функцію оновлення гістерезису
  if (adc >= ADC_DARK_ON)                                     // Перевіряє досягнення порогу настання сутінків
    gDark = true;                                             // Встановлює прапорець недостатнього освітлення
  else if (adc <= ADC_BRIGHT_OFF)                             // Перевіряє досягнення порогу яскравого світла
    gDark = false;                                            // Скидає прапорець настання сутінків
}                                                             // Закриває функцію оновлення гістерезису

static void pollButton(uint32_t now)                          // Сканує фізичний контакт кнопки з фільтрацією перешкод
{                                                             // Відкриває функцію обробки кнопки
  gBtnShort = false;                                          // Очищує імпульс короткого натискання
  gBtnLong = false;                                           // Очищує імпульс довгого натискання
  const bool up = digitalRead(PIN_BTN);                       // Зчитує електричний рівень на вході піна
  if (up == gBtnLast)                                         // Порівнює стан з попереднім опитуванням
  {                                                           // Відкриває гілку статичного стану
    if (!up && gBtnArmed && !gBtnLongSent && (now - gBtnDownAt >= BTN_LONG_MS))   // Перевіряє ліміт утримання
    {                                                         // Відкриває блок фіксації довгого натискання
      gBtnLong = true;                                        // Генерує прапорець утримання клавіші
      gBtnLongSent = true;                                    // Блокує багаторазову генерацію сигналу
    }                                                         // Закриває блок фіксації довгого натискання
    return;                                                   // Виходить якщо змін рівня не зафіксовано
  }                                                           // Закриває гілку статичного стану
  if (now - gBtnEdgeAt < BTN_DEBOUNCE_MS)                     // Відсікає високочастотний брязкіт контактів
    return;                                                   // Ігнорує передчасну зміну логічного сигналу
  gBtnEdgeAt = now;                                           // Оновлює мітку останнього фронту сигналу
  gBtnLast = up;                                              // Зберігає оновлений стабільний рівень
  if (!up)                                                    // Визначає момент притискання кнопки до землі
  {                                                           // Відкриває блок фіксації натискання
    gBtnDownAt = now;                                         // Зберігає час старту притискання
    gBtnArmed = true;                                         // Активує готовність до аналізу відпускання
    gBtnLongSent = false;                                     // Скидає ознаку відправленого довгого кліку
  }                                                           // Закриває блок фіксації натискання
  else if (gBtnArmed)                                         // Визначає факт розмикання контактів кнопки
  {                                                           // Відкриває блок реєстрації відпускання
    if (!gBtnLongSent)                                        // Перевіряє чи не було зафіксовано утримання
      gBtnShort = true;                                       // Генерує подію звичайного короткого перемикання
    gBtnArmed = false;                                        // Деактивує прапорець очікування розмикання
  }                                                           // Закриває блок реєстрації відпускання
}                                                             // Закриває функцію обробки кнопки

static void applyCmd(const String &c)                             // Розбирає рядкові директиви з послідовного порту
{                                                                 // Відкриває диспетчер текстових команд
  const uint32_t now = millis();                                  // Фіксує системний час отримання команди
  AiFeatures f{gHour, gWday, (uint8_t)gMotion, (uint8_t)gDark};   // Готує параметри стану для моделі ШІ
  if (c == "on")                                                  // Перевіряє команду примусового ввімкнення
  {                                                               // Відкриває блок ручного ввімкнення
    gMode = MODE_MANUAL;                                          // Призначає ручний режим керування
    fsmForce(ST_ON, now, "cmd_on");                               // Задає активний стан навантаження
  }                                                               // Закриває блок ручного ввімкнення
  else if (c == "off")                                            // Перевіряє команду примусового вимкнення
  {                                                               // Відкриває блок ручного вимкнення
    gMode = MODE_MANUAL;                                          // Призначає ручний режим керування
    fsmForce(ST_OFF, now, "cmd_off");                             // Задає пасивний стан навантаження
  }                                                               // Закриває блок ручного вимкнення
  else if (c == "mode:manual")                                    // Перевіряє команду переходу в ручний режим
    fsmSetMode(MODE_MANUAL, now);                                 // Активує ручне керування
  else if (c == "mode:auto")                                      // Перевіряє команду автоматичного режиму
    fsmSetMode(MODE_AUTO, now);                                   // Активує автоматичне керування за сенсорами
  else if (c == "mode:ai")                                        // Перевіряє команду інтелектуального режиму
    fsmSetMode(MODE_AI, now);                                     // Активує керування за прогнозом нейромережі
  else if (c == "learn:on")                                       // Перевіряє команду позачергового навчання
    habitLearn(f, 1.f);                                           // Проводить коригування вагових коефіцієнтів
  else if (c.startsWith("time:"))                                 // Перевіряє команду встановлення віртуального часу
  {                                                               // Відкриває блок парсингу часу
    int hh = c.substring(5, 7).toInt();                           // Виділяє числове значення години
    int mm = c.substring(8, 10).toInt();                          // Виділяє числове значення хвилини
    if (hh >= 0 && hh < 24)                                       // Перевіряє коректність діапазону годин
      gHour = (uint8_t)hh;                                        // Зберігає введену годину в змінну
    if (mm >= 0 && mm < 60)                                       // Перевіряє коректність діапазону хвилин
      gMin = (uint8_t)mm;                                         // Зберігає введену хвилину в змінну
  }                                                               // Закриває блок парсингу часу
}                                                                 // Закриває диспетчер текстових команд

static void maybeThingSpeak(uint32_t now)                     // Передає пакет спостережень на хмарний сервер ThingSpeak
{                                                             // Відкриває блок вивантаження в хмару
  if (!THINGSPEAK_KEY[0])                                     // Перевіряє наявність сконфігурованого ключа API
    return;                                                   // Скасовує відправку якщо ключ не вказано
  if (now - gLastTs < THINGSPEAK_MS)                          // Перевіряє захисний тайм-аут лімітів ThingSpeak
    return;                                                   // Очікує настання дозволеного вікна зв'язку
  if (WiFi.status() != WL_CONNECTED)                          // Перевіряє наявність активного мережевого з'єднання
    return;                                                   // Перериває передачу за відсутності мережі
  gLastTs = now;                                              // Оновлює мітку успішного початку сесії зв'язку
  String url = "http://api.thingspeak.com/update?api_key=";   // Формує початкову адресу HTTP запиту
  url += THINGSPEAK_KEY;                                      // Додає ідентифікатор авторизації
  url += "&field1=" + String(gAdc);                           // Додає виміряне значення освітленості
  url += "&field2=" + String(gMotion ? 1 : 0);                // Додає значення активності з датчика руху
  url += "&field3=" + String(gOut.lampOn ? 1 : 0);            // Додає фактичний стан роботи реле
  url += "&field4=" + String(gProb, 3);                       // Додає коефіцієнт розрахунку моделі ШІ
  HTTPClient httpc;                                           // Створює екземпляр мережевого HTTP клієнта
  httpc.begin(url);                                           // Ініціалізує з'єднання з віддаленим сервером
  int code = httpc.GET();                                     // Виконує надсилання даних методом GET
  if (code == 200)                                            // Перевіряє стандартний код успішної відповіді
    Serial.printf("[ThingSpeak] Data sent OK (light=%d, motion=%d, lamp=%d, prob=%.3f)\r\n",  // Повідомляє про передачу
                  gAdc,                                       // Передає аргумент сенсора світла
                  gMotion ? 1 : 0,                            // Передає аргумент сенсора присутності
                  gOut.lampOn ? 1 : 0,                        // Передає аргумент активності лампи
                  gProb);                                     // Передає аргумент ймовірності звички
  else                                                        // Фіксує код збою або мережеву помилку
    Serial.printf("[ThingSpeak] Send failed, HTTP %d\r\n", code);   // Повідомляє про невдалу спробу запиту
  httpc.end();                                                // Звільняє виділені мережеві ресурси
}                                                             // Закриває блок вивантаження в хмару

static void handleSerial()                                    // Обробляє вхідні символи терміналу послідовного порту
{                                                             // Відкриває функцію читання порту
  if (!Serial.available())                                    // Перевіряє наявність отриманих байтів у буфері
    return;                                                   // Завершує роботу якщо нових даних немає
  String line = Serial.readStringUntil('\n');                 // Зчитує рядок символів до переходу на новий
  line.trim();                                                // Видаляє непотрібні пробільні символи
  if (line.startsWith("t "))                                  // Перевіряє префікс налаштування часу
    applyCmd("time:" + line.substring(2));                    // Передає фрагмент часу на парсинг
  else if (line == "on" || line == "off")                     // Перевіряє базові команди комутації
    applyCmd(line);                                           // Виконує пряму дію ввімкнення або вимкнення
  else if (line == "auto")                                    // Перевіряє текстову команду режиму auto
    applyCmd("mode:auto");                                    // Задає виконання автоматичного режиму
  else if (line == "manual")                                  // Перевіряє текстову команду режиму manual
    applyCmd("mode:manual");                                  // Задає виконання ручного режиму
  else if (line == "ai")                                      // Перевіряє команду ввімкнення режиму ai
    applyCmd("mode:ai");                                      // Задає виконання алгоритму ШІ
  else if (line == "learn")                                   // Перевіряє команду виклику навчання
    applyCmd("learn:on");                                     // Запускає тренування вагових коефіцієнтів
}                                                             // Закриває функцію читання порту

void setup()                                                  // Виконує первинну конфігурацію периферії та модулів
{                                                             // Відкриває блок налаштування системи
  Serial.begin(115200);                                       // Встановлює швидкість обміну послідовного порту
  delay(200);                                                 // Формує захисну паузу на перехідні процеси

  pinMode(PIN_RELAY, OUTPUT);                                 // Переводить вивід реле в режим цифрового виходу
  pinMode(PIN_PIR, INPUT);                                    // Переводить вивід PIR-датчика в режим входу
  pinMode(PIN_BTN, INPUT_PULLUP);                             // Активує внутрішній підтягуючий резистор кнопки
  setRelay(false);                                            // Гарантує вимкнений стан навантаження при старті

  analogReadResolution(12);                                   // Встановлює 12-бітну роздільну здатність АЦП
  fsmInit();                                                  // Скидає змінні логіки кінцевого автомата
  habitInit();                                                // Ініціалізує ваги моделі передбачення звичок

  Serial.printf("Wi-Fi %s", WIFI_SSID);                       // Сповіщає про початок встановлення Wi-Fi зв'язку
  Blynk.begin(BLYNK_AUTH_TOKEN, WIFI_SSID, WIFI_PASS);        // Авторизується та відкриває сесію в сервісі Blynk
  if (WiFi.status() == WL_CONNECTED)                          // Перевіряє стан отримання локальної IP-адреси
  {                                                           // Відкриває блок успішної мережевої конфігурації
    Serial.print("\r\nIP ");                                  // Друкує префікс для призначеної IP-адреси
    Serial.println(WiFi.localIP());                           // Друкує мережеву адресу мікроконтролера
  }                                                           // Закриває блок успішної мережевої конфігурації
  else                                                        // Фіксує відсутність відповіді точки доступу
  {                                                           // Відкриває блок роботи без мережі
    Serial.print("\r\nWi-Fi timeout (offline FSM still runs)\r\n"); // Повідомляє про перехід в офлайн-режим
  }                                                           // Закриває блок роботи без мережі
  Serial.print("Serial: t HH:MM | on | off | auto | manual | ai | learn\r\n");  // Друкує доступний перелік команд
}                                                             // Закриває блок налаштування системи

void loop()                                                   // Головний циклічний процес обслуговування завдань
{                                                             // Відкриває тіло основного циклу програми
  const uint32_t now = millis();                              // Отримує поточний час роботи процесора
  handleSerial();                                             // Обробляє чергу команд у терміналі
  Blynk.run();                                                // Забезпечує фоновий зв'язок із сервером Blynk

  gAdc = analogRead(PIN_LDR);                                 // Оцифровує рівень напруги з фоторезистора
  updateLightHysteresis(gAdc);                                // Розраховує поточний рівень темряви з гістерезисом
  gMotion = digitalRead(PIN_PIR);                             // Зчитує стан детектора присутності людей

  pollButton(now);                                            // Виконує перевірку стану контактів тактової кнопки
  static bool prevMotion = false;                             // Зберігає стан датчика руху попередньої ітерації
  if (gMotion != prevMotion)                                  // Порівнює факт зміни сигналу датчика присутності
  {                                                           // Відкриває блок індикації зміни активності
    Serial.printf("[DBG] PIR: %s -> %s\r\n",                  // Виводить службове повідомлення про рух
                  prevMotion ? "motion" : "clear",            // Підставляє попередній статус сенсора
                  gMotion ? "motion" : "clear");              // Підставляє актуальний статус сенсора
    prevMotion = gMotion;                                     // Синхронізує збережений стан руху
  }                                                           // Закриває блок індикації зміни активності
  if (gBtnShort && !gOut.lampOn)                              // Визначає вмикання лампи за ініціативою користувача
  {                                                           // Відкриває блок онлайн-донавчання моделі
    AiFeatures f{gHour, gWday, (uint8_t)gMotion, (uint8_t)gDark}; // Фіксує умови в момент ввімкнення світла
    habitLearn(f, 1.f);                                       // Підлаштовує ваги алгоритму під нову звичку
  }                                                           // Закриває блок онлайн-донавчання моделі

  if (now - gLastSimMin >= SIM_MINUTE_EVERY_MS)               // Відраховує інтервал внутрішнього модельного часу
  {                                                           // Відкриває блок оновлення віртуального годинника
    gLastSimMin = now;                                        // Фіксує таймкод початку нової хвилини
    if (++gMin >= 60)                                         // Додає хвилину та перевіряє настання нової години
    {                                                         // Відкриває блок зміни поточної години
      gMin = 0;                                               // Обнуляє лічильник хвилин
      uint8_t prevH = gHour;                                  // Запам'ятовує попередню годину для розрахунку згасання
      gHour = (gHour + 1) % 24;                               // Інкрементує годину в межах добового кола
      habitDecayHour(prevH);                                  // Зменшує вагу старих звичок за минулу годину
      if (gHour == 0)                                         // Перевіряє завершення повного добового циклу
        gWday = (gWday + 1) % 7;                              // Змінює порядковий номер дня тижня
    }                                                         // Закриває блок зміни поточної години
  }                                                           // Закриває блок оновлення віртуального годинника

  AiFeatures feat{gHour, gWday, (uint8_t)gMotion, (uint8_t)gDark};  // Збирає вхідний вектор параметрів для моделі ШІ
  gProb = habitPredict(feat);                                       // Обчислює поточну ймовірність потреби увімкнення

  FsmInput in{gDark, gMotion, gBtnShort, gBtnLong, gProb};        // Комплектує структуру подій для кінцевого автомата
  gOut = fsmTick(in, now);                                        // Виконує один крок переходів скінченного автомата
  setRelay(gOut.lampOn);                                          // Передає логічний стан на фізичне реле

  if (gBtnShort)                                                  // Перевіряє наявність сигналу короткого кліку
  {                                                               // Відкриває блок логування реакції кнопки
    Serial.printf("[DBG] Button SHORT => Lamp %s\r\n",            // Друкує результат спрацювання перемикача
                  gOut.lampOn ? "ON" : "OFF");                    // Виводить новий статус стану лампи
    pushBlynk();                                                  // Миттєво синхронізує зміни з мобільним застосунком
  }                                                               // Закриває блок логування реакції кнопки
  if (gBtnLong)                                                   // Перевіряє подію циклічної зміни режимів
  {                                                               // Відкриває блок логування довгого натискання
    Serial.printf("[DBG] Button LONG => mode %s (lamp %s)\r\n",   // Друкує новий обраний режим
                  modeName(gOut.mode),                            // Виводить назву активного режиму
                  gOut.lampOn ? "ON" : "OFF");                    // Виводить стан навантаження при перемиканні
    pushBlynk();                                                  // Оновлює перемикач режимів у застосунку
  }                                                               // Закриває блок логування довгого натискання

  if (now - gLastTelem >= TELEMETRY_MS)                           // Перевіряє настання інтервалу передачі телеметрії
  {                                                               // Відкриває блок періодичного логування параметрів
    gLastTelem = now;                                             // Зберігає мітку останнього сеансу виведення
    Serial.printf("Light:%d %s %s | %02u:%02u | %s | %s | Lamp:%s | %s\r\n", // Форматує рядок повної телеметрії
                  gAdc,                                           // Виводить цифровий відлік АЦП
                  gDark ? "night" : "day",                        // Виводить статус зовнішнього освітлення
                  gMotion ? "motion" : "clear",                   // Виводить статус наявності людини в кімнаті
                  gHour,                                          // Виводить модельну годину
                  gMin,                                           // Виводить модельну хвилину
                  modeName(gOut.mode),                            // Виводить текстову назву режиму
                  stateName(gOut.state),                          // Виводить текстову назву стану лампи
                  gOut.lampOn ? "ON" : "OFF",                     // Виводить стан силового реле
                  gOut.reason);                                   // Виводить причину переходу в даний стан
    maybeThingSpeak(now);                                         // Передає дані на платформу аналітики
  }                                                               // Закриває блок періодичного логування параметрів

  if (now - gLastBlynk >= TELEMETRY_MS)                       // Перевіряє таймер оновлення даних у додатку
  {                                                           // Відкриває блок періодичної передачі в Blynk
    gLastBlynk = now;                                         // Оновлює мітку успішного зв'язку з Blynk
    pushBlynk();                                              // Оновлює значення віджетів на смартфоні
  }                                                           // Закриває блок періодичної передачі в Blynk

  delay(10);                                                  // Забезпечує паузу диспетчера завдань мікроконтролера
}                                                             // Закриває тіло основного циклу програми