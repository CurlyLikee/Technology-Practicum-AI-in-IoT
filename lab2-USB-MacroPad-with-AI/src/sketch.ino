#include <Arduino.h>                    // Підключення базової бібліотеки фреймворку Arduino для мікроконтролера ESP32
#include <Wire.h>                       // Підключення бібліотеки для взаємодії по апаратній шині I2C
#include <Adafruit_GFX.h>               // Підключення базової графічної бібліотеки геометричних фігур та шрифтів
#include <Adafruit_SSD1306.h>           // Підключення бібліотеки ініціалізації та керування дисплеєм SSD1306
#include <WiFi.h>                       // Підключення бібліотеки керування бездротовим мережевим інтерфейсом
#include <HTTPClient.h>                 // Підключення бібліотеки клієнта передачі даних за протоколом HTTP
#include "ai_logic.h"                   // Підключення заголовного файлу аналітичного модуля та оцінки контексту

#define SCREEN_WIDTH 128                // Ширина матриці дисплея у пікселях
#define SCREEN_HEIGHT 64                // Висота матриці дисплея у пікселях
#define OLED_RESET -1                   // Позначення використання спільної лінії скидання контролера екрана
#define SCREEN_ADDRESS 0x3C             // Базова адреса пристрою відображення інформації на шині послідовного зв'язку
#define NUM_BUTTONS 16                  // Загальна кількість комутаційних клавіш матриці
#define DEBOUNCE_DELAY 50               // Інтервал програмної фільтрації брязкоту контактів у мілісекундах
#define PROFILE_SWITCH_ROW 2            // Номер координатного рядка матриці для кнопки зміни режиму
#define PROFILE_SWITCH_COL 0            // Номер координатного стовпчика матриці для кнопки зміни режиму
#define AI_SUGGESTION_INTERVAL 10000    // Часовий проміжок між генераціями рекомендацій у мілісекундах

const char *WIFI_SSID = "Wokwi-GUEST";  // Ідентифікатор віртуальної бездротової мережі середовища моделювання
const char *WIFI_PASS = "";             // Пароль підключення до бездротової мережі

const char *THINGSPEAK_API_KEY = "P2GUU44FA1KRLZR0";              // Авторизаційний ключ публікації даних у хмарний канал
const char *THINGSPEAK_URL = "http://api.thingspeak.com/update";  // Шлях кінцевої точки відправки пакетів телеметрії

unsigned long lastThingSpeakSend = 0;                             // Часова мітка попереднього циклу зв'язку з хмарним сервісом
const unsigned long THINGSPEAK_INTERVAL = 16000;                  // Періодичність вивантаження стану системи у мілісекундах
int lastSentButton = 0;                                           // Змінна збереження порядкового номера натиснутого елемента
int currentProfile = 0;                                           // Індекс обраної активної схеми призначень команд

Adafruit_SSD1306 display(SCREEN_WIDTH, SCREEN_HEIGHT, &Wire, OLED_RESET);   // Створення екземпляра класу інтерфейсу дисплея
bool displayAvailable = false;                                              // Змінна готовності та успішної відповіді дисплея на шині

const int rowPins[4] = {13, 12, 14, 27};            // Масив номерів вихідних контактів мікроконтролера для вибору рядка
const int colPins[4] = {26, 25, 33, 32};            // Масив номерів вхідних контактів мікроконтролера для опитування стовпчиків

unsigned long lastDebounceTime[4][4] = {{0}};       // Таблиця збереження моментів фіксації перехідних процесів
int lastButtonState[4][4] = {{0}};                  // Таблиця попередніх виміряних рівнів напруги клавіш
int buttonState[4][4] = {{0}};                      // Таблиця підтверджених сталих станів кнопок матриці

#define NUM_PROFILES 3                              // Кількість конфігурацій макросів пристрою
#define MACRO_NAME_LENGTH 32                        // Граничний розмір буфера рядка текстової назви дії
#define PROFILE_NAME_LENGTH 16                      // Граничний розмір буфера рядка ідентифікатора профілю

struct MacroProfile                                 // Початок оголошення типу структури профілю призначень
{                                                   // Відкриття блоку опису полів структури
  char name[PROFILE_NAME_LENGTH];                   // Буфер зберігання символьного імені поточного режиму
  char macros[NUM_BUTTONS][MACRO_NAME_LENGTH];      // Двовимірний символьний масив послідовностей команд для кнопок
  char ai_context[32];                              // Текстовий маркер відповідного середовища для аналітичної моделі
};                                                  // Закриття блоку опису полів структури з крапкою з комою

MacroProfile profiles[NUM_PROFILES] =                               // Оголошення та початок визначення масиву конфігурацій
    {                                                               // Відкриття списку елементів масиву
        {                                                           // Відкриття опису першого системного профілю
            "General",                                              // Текстовий ідентифікатор базового робочого режиму
            {                                                       // Відкриття списку шістнадцяти призначень
                "Ctrl+C", "Ctrl+V", "Ctrl+X", "Ctrl+Z",             // Призначення команд буфера обміну для кнопок першого рядка
                "Alt+Tab", "Win+D", "Win+L", "PrintScr",            // Призначення навігаційних та системних функцій другого рядка
                "F1", "F2", "F3", "F4",                             // Призначення функціональних дій для кнопок третього рядка
                "Vol+", "Vol-", "Mute", "Play/Pause"                // Призначення функцій керування медіа для четвертого рядка
            },                                                      // Закриття списку дій першого профілю
            "default"                                               // Ініціалізація параметра базового контексту
        },                                                          // Закриття опису першого профілю
        {                                                           // Відкриття опису профілю програмування
            "Coding",                                               // Текстовий ідентифікатор режиму розробки коду
            {                                                       // Відкриття списку дій другого профілю
                "Ctrl+S", "Ctrl+O", "Ctrl+F", "Ctrl+H",             // Призначення функцій файлів та пошуку для першого рядка
                "Ctrl+Shift+F", "Ctrl+/", "Ctrl+D", "Ctrl+Shift+K", // Призначення команд редактора для другого рядка
                "F5", "F9", "F10", "F11",                           // Призначення дій налагоджувача для третього рядка
                "Ctrl+`", "Ctrl+B", "Ctrl+Shift+X", "Ctrl+P"        // Призначення дій виклику панелей для четвертого рядка
            },                                                      // Закриття списку дій другого профілю
            "vscode"                                                // Встановлення маркера редактора коду як робочого оточення
        },                                                          // Закриття опису другого профілю
        {                                                           // Відкриття опису профілю ігор
            "Gaming",                                               // Текстовий ідентифікатор ігрового режиму
            {                                                       // Відкриття списку дій третього профілю
                "1", "2", "3", "4",                                 // Призначення цифрових сигналів для кнопок першого рядка
                "Q", "W", "E", "R",                                 // Призначення клавіш дій для кнопок другого рядка
                "Space", "Shift", "Ctrl", "Alt",                    // Призначення допоміжних модифікаторів для третього рядка
                "F5", "F9", "Esc", "Tab"                            // Призначення службових дій для кнопок четвертого рядка
            },                                                      // Закриття списку дій третього профілю
            "game"                                                  // Встановлення маркера ігрового застосунку
        }                                                           // Закриття опису третього профілю
};                                                                  // Завершення ініціалізації масиву профілів

void connectWiFi()                                                          // Початок оголошення підпрограми підключення до бездротової мережі
{                                                                           // Відкриття тіла функції бездротового зв'язку
  Serial.print("Connecting to Wi-Fi");                                      // Виведення тексту початку спроби з'єднання у термінал
  WiFi.begin(WIFI_SSID, WIFI_PASS);                                         // Старт процедури підключення радіомодуля до точки доступу
  unsigned long startTime = millis();                                       // Фіксація початкового часу для контролю тривалості спроби
  while (WiFi.status() != WL_CONNECTED && millis() - startTime < 8000)      // Опитування статусу мережі з обмеженням за часом
  {                                                                         // Відкриття циклу очікування авторизації
    delay(500);                                                             // Очікування пів секунди між кроками перевірки стану
    Serial.print(".");                                                      // Виведення крапки індикації процесу з'єднання
  }                                                                         // Закриття циклу очікування авторизації
  if (WiFi.status() == WL_CONNECTED)                                        // Перевірка факту підтвердження з'єднання з мережею
  {                                                                         // Відкриття гілки успішного підключення
    Serial.println();                                                       // Чистий перехід на новий рядок
    Serial.println("Wi-Fi connected! IP: " + WiFi.localIP().toString());    // Виведення отриманої адреси вузла у мережі
  }                                                                         // Закриття гілки успішного підключення
  else                                                                      // Перехід до альтернативної гілки у разі тайм-ауту
  {                                                                         // Відкриття гілки обробки відсутності мережі
    Serial.println("\nWi-Fi unavailable; continuing offline");              // Сповіщення про перехід пристрою в автономну роботу
    WiFi.disconnect(true);                                                  // Повне відключення модуля бездротового зв'язку
  }                                                                         // Закриття гілки обробки відсутності мережі
}                                                                           // Закриття функції підключення до бездротової мережі

void sendTelemetryToThingSpeak()                                            // Початок оголошення функції відправки даних у хмару
{                                                                           // Відкриття тіла функції відправки телеметрії
  if (millis() - lastThingSpeakSend < THINGSPEAK_INTERVAL)                  // Контроль дотримання мінімального періоду між транзакціями
  {                                                                         // Відкриття гілки дострокового повернення
    return;                                                                 // Завершення виконання за відсутності потреби передачі
  }                                                                         // Закриття гілки дострокового повернення

  if (WiFi.status() == WL_CONNECTED)                                         // Перевірка наявності активного зв'язку перед передачею
  {                                                                          // Відкриття блоку мережевого обміну
    HTTPClient http;                                                         // Створення локального екземпляра мережевого клієнта

    String url = String(THINGSPEAK_URL) + "?api_key=" + THINGSPEAK_API_KEY + // Складання базової адреси та ключа запису
                 "&field1=" + String(lastSentButton) +                       // Додавання параметра першого каналу з кодом кнопки
                 "&field2=" + String(currentProfile) +                       // Додавання параметра другого каналу з індексом режиму
                 "&field3=" + String(patternData.totalPresses);              // Додавання параметра третього каналу з лічильником дій

    http.begin(url);                                                         // Ініціалізація HTTP клієнта за сформованим посиланням
    int httpResponseCode = http.GET();                                       // Виконання мережевого запиту методом GET з фіксацією відповіді

    if (httpResponseCode > 0)                                                // Перевірка отримання коректного статусу від сервера
    {                                                                        // Відкриття блоку звіту про успіх
      Serial.println("----------------------------------------");            // Друк верхньої межі текстового звіту
      Serial.println("[ThingSpeak HTTP] Telemetry successfully published!"); // Інформаційне повідомлення про успішну фіксацію
      Serial.print("Payload -> Last Key: ");                                 // Виведення підпису значення коду клавіші
      Serial.print(lastSentButton);                                          // Виведення збереженого коду клавіші
      Serial.print(" | Profile ID: ");                                       // Виведення підпису ідентифікатора профілю
      Serial.print(currentProfile);                                          // Виведення поточного номера конфігурації дій
      Serial.print(" | Total Presses: ");                                    // Виведення підпису підрахунку подій
      Serial.println(patternData.totalPresses);                              // Виведення загальної кількості дій
      Serial.println("----------------------------------------");            // Друк нижньої межі текстового звіту
    }                                                                         // Закриття блоку звіту про успіх
    else                                                                           // Перехід до обробки ситуації апаратного або логічного збою
    {                                                                              // Відкриття блоку звіту про помилку
      Serial.print("[ThingSpeak HTTP] Failed to publish telemetry. Error code: "); // Виведення тексту сповіщення про збій зв'язку
      Serial.println(httpResponseCode);                                            // Виведення числового коду помилки клієнта
    }                                                                              // Закриття блоку звіту про помилку
    http.end();                                                                    // Звільнення пам'яті та закриття клієнтської сесії
  }                                                                                // Закриття блоку мережевого обміну

  lastThingSpeakSend = millis();                                                   // Оновлення часу здійснення попереднього звернення до сервера
}                                                                                  // Закриття функції відправки даних у хмару

const char *getCurrentProfileName()                                                // Початок функції зчитування імені поточного режиму
{                                                                                  // Відкриття блоку повернення імені режиму
  return profiles[currentProfile].name;                                            // Повернення символьного рядка назви поточної конфігурації
}                                                                                  // Закриття блоку повернення імені режиму

const char *getAIContext()                                                         // Початок функції зчитування контексту поточного режиму
{                                                                                  // Відкриття блоку повернення контексту
  return profiles[currentProfile].ai_context;                                      // Повернення рядка контексту для роботи класифікатора
}                                                                                  // Закриття блоку повернення контексту

void initDisplay()                                                          // Початок оголошення підпрограми налаштування пристрою відображення
{                                                                           // Відкриття тіла функції налаштування дисплея
  Wire.begin(21, 22);                                                       // Конфігурація ліній даних та тактування інтерфейсу I2C

  displayAvailable = display.begin(SSD1306_SWITCHCAPVCC, SCREEN_ADDRESS);   // Спроба старту панелі за основною адресою
  if (!displayAvailable)                                                    // Перевірка невдачі запуску за основним каналом адресації
  {                                                                         // Відкриття блоку спроби роботи з резервною адресою
    displayAvailable = display.begin(SSD1306_SWITCHCAPVCC, 0x3D);           // Спроба запуску дисплея за альтернативною адресою
  }                                                                         // Закриття блоку перевірки резервної адреси
  if (!displayAvailable)                                                    // Перевірка відсутності відповіді екрана за обома адресами
  {                                                                         // Відкриття блоку сповіщення про збій
    Serial.println(F("OLED not found; buttons remain active"));             // Повідомлення про роботу виключно блоку клавіш
    return;                                                                 // Завершення виконання функції у разі відсутності модуля
  }                                                                         // Закриття блоку сповіщення про збій

  display.clearDisplay();                       // Заповнення буфера порожніми значеннями пікселів
  display.setTextSize(1);                       // Встановлення базового масштабу символів шрифту
  display.setTextColor(SSD1306_WHITE);          // Встановлення білого кольору відображення інформації
  display.setCursor(0, 0);                      // Повернення курсора на початок системи координат
  display.display();                            // Запис початкового буфера в пам'ять контролера екрана

  Serial.println("OLED display initialized");   // Підтвердження коректного запуску блоку виводу інформації
}                                               // Закриття функції налаштування дисплея

void showWelcomeScreen()                        // Початок функції показу початкової заставки
{                                               // Відкриття блоку відображення заставки
  if (!displayAvailable)                        // Перевірка наявності зв'язку з екраном
  {                                             // Відкриття гілки блокування роботи з відсутнім екраном
    return;                                     // Переривання процедури за відсутності підключення дисплея
  }                                             // Закриття гілки блокування
  display.clearDisplay();                       // Очищення робочого буфера перед побудовою тексту
  display.setTextSize(1);                       // Встановлення стандартного розміру шрифту для заставки
  display.setTextColor(SSD1306_WHITE);          // Вибір білого кольору літер
  display.setCursor(0, 0);                      // Встановлення координат виводу у вихідну позицію
  display.println("Smart Macro Pad");           // Виведення заголовка проєкту на екран
  display.println("16 Keys + AI");              // Виведення підпису апаратної структури та інтелектуальної системи
  display.println("Ready!");                    // Повідомлення про готовність модуля до зчитування клавіш
  display.display();                            // Передача буфера на панель для фізичного показу
  delay(2000);                                  // Очікування дві секунди для візуального контролю запуску
}                                               // Закриття блоку відображення заставки

void showMacroGrid(const char *profileName)     // Початок функції відмальовки базової інформаційної панелі
{                                               // Відкриття тіла функції побудови інтерфейсу панелі
  if (!displayAvailable)                        // Перевірка доступності матриці дисплея
  {                                             // Відкриття перевірки наявності апаратного модуля
    return;                                     // Завершення виконання підпрограми у разі несправності або відсутності модуля
  }                                             // Закриття перевірки наявності модуля
  display.clearDisplay();                       // Очищення вмісту буфера від попередніх зображень

  display.fillRect(0, 0, SCREEN_WIDTH, 14, SSD1306_WHITE);    // Формування верхньої прямокутної інверсної плашки
  display.setTextColor(SSD1306_BLACK);                        // Встановлення чорного кольору літер для контрасту на білому фоні
  display.setTextSize(1);                                     // Встановлення одиничного кегля шрифту
  display.setCursor(4, 3);                                    // Зміщення координат друку всередину верхньої плашки
  display.print("MODE: ");                                    // Виведення текстової позначки назви режиму
  display.print(profileName);                                 // Виведення найменування активного профілю

  display.setTextColor(SSD1306_WHITE);                        // Перемикання кольору на білий для основного інформаційного поля
  display.setCursor(0, 20);                                   // Встановлення координат початку другого інформаційного рядка
  display.print("Status : HID Online");                       // Відображення статусу емуляції пристрою введення

  display.setCursor(0, 32);                                   // Встановлення координат початку третього інформаційного рядка
  display.print("Context: ");                                 // Друк підпису параметра контексту застосунків
  display.println(getAIContext());                            // Виведення назви робочого контексту активного профілю

  display.setCursor(0, 44);                                   // Встановлення координат четвертого інформаційного рядка
  display.print("Keys   : 16 Ready");                         // Відображення готовності всіх клавіш до спрацьовування

  display.drawFastHLine(0, 54, SCREEN_WIDTH, SSD1306_WHITE);  // Побудова горизонтальної лінії візуального розмежування
  display.setCursor(0, 56);                                   // Встановлення координат нижнього рядка підказки
  display.print("Press B9: Next Profile");                    // Текст підказки щодо призначення клавіші перемикання

  display.display();                                          // Оновлення зображення на фізичній матриці дисплея
}                                                             // Закриття функції побудови панелі

void showAISuggestion(const char *suggestion)                 // Початок функції виводу інтелектуальної підказки на екран
{                                                             // Відкриття блоку показу підказки
  if (!displayAvailable)                                      // Перевірка працездатності модуля відображення
  {                                                           // Відкриття умови блокування
    return;                                                   // Завершення виконання підпрограми за відсутності екрана
  }                                                           // Закриття умови блокування

  display.clearDisplay();                                     // Скидання буфера для нового інформаційного кадру
  display.setTextSize(1);                                     // Встановлення звичайного розміру тексту
  display.setTextColor(SSD1306_WHITE);                        // Вибір білого кольору для виводу підказки
  display.setCursor(0, 0);                                    // Позиціонування на початку верхнього рядка
  display.println("AI Suggestion:");                          // Виведення службової мітки аналітичного блоку
  display.println("----------------");                        // Формування роздільної лінії символами
  display.println(suggestion);                                // Виведення тексту згенерованої рекомендації
  display.display();                                          // Фізична пересилка буфера на матрицю дисплея
}                                                             // Закриття блоку показу підказки

void showButtonPress(int buttonIndex, const char *macro)      // Початок функції демонстрації натискання кнопки
{                                                             // Відкриття тіла функції індикації дії
  if (!displayAvailable)                                      // Перевірка можливості роботи з апаратним екраном
  {                                                           // Відкриття умови блокування
    return;                                                   // Завершення виконання у разі відсутності модуля
  }                                                           // Закриття умови блокування

  display.clearDisplay();                                     // Очищення буфера від попереднього зображення
  display.setTextSize(1);                                     // Вибір стандартного розміру літер
  display.setTextColor(SSD1306_WHITE);                        // Встановлення білого кольору символів
  display.setCursor(0, 0);                                    // Встановлення початкових координат виводу
  display.print("Button ");                                   // Виведення статичного слова номера кнопки
  display.print(buttonIndex + 1);                             // Виведення номера кнопки у зручній формі від одиниці
  display.println(" pressed");                                // Друк повідомлення про фіксацію замикання
  display.print("Macro: ");                                   // Виведення підпису призначеної дії
  display.println(macro);                                     // Виведення назви надісланого макросу
  display.display();                                          // Оновлення зображення на фізичному екрані
}                                                             // Закриття функції індикації дії

void initButtons()                                            // Початок оголошення підпрограми конфігурації матриці кнопок
{                                                             // Відкриття тіла функції налаштування ліній матриці
  for (int i = 0; i < 4; i++)                                 // Організація циклу перебору чотирьох ліній вихідних сигналів
  {                                                           // Відкриття циклу налаштування рядків
    pinMode(rowPins[i], OUTPUT);                              // Встановлення режиму виходу для лінії рядка
    digitalWrite(rowPins[i], HIGH);                           // Встановлення високого рівня пасивного стану
  }                                                           // Закриття циклу налаштування рядків

  for (int i = 0; i < 4; i++)                                 // Організація циклу перебору чотирьох ліній вхідних сигналів
  {                                                           // Відкриття циклу налаштування стовпчиків
    pinMode(colPins[i], INPUT_PULLUP);                        // Конфігурація входу з внутрішнім підтягувальним резистором
  }                                                           // Закриття циклу налаштування стовпчиків

  for (int row = 0; row < 4; row++)                           // Організація циклу обходу рядків масивів збереження стану
  {                                                           // Відкриття зовнішнього циклу рядків
    for (int col = 0; col < 4; col++)                         // Організація циклу обходу стовпчиків масивів збереження стану
    {                                                         // Відкриття внутрішнього циклу стовпчиків
      lastButtonState[row][col] = HIGH;                       // Ініціалізація попереднього значення високим рівнем
      buttonState[row][col] = HIGH;                           // Ініціалізація підтвердженого значення високим рівнем
    }                                                         // Закриття внутрішнього циклу стовпчиків
  }                                                           // Закриття зовнішнього циклу рядків

  Serial.println("Matrix buttons initialized");         // Виведення повідомлення про завершення конфігурації матриці
}                                                             // Закриття функції налаштування ліній матриці

int readMatrixButton(int row, int col)                        // Початок функції зчитування окремого перетину матриці з фільтрацією брязкоту
{                                                             // Відкриття тіла функції опитування клавіші
  if (row < 0 || row >= 4 || col < 0 || col >= 4)             // Перевірка виходу параметрів за межі фізичних розмірів матриці
  {                                                           // Відкриття блоку некоректних координат
    return HIGH;                                              // Повернення значення розімкненого стану для некоректних індексів
  }                                                           // Закриття блоку некоректних координат

  for (int i = 0; i < 4; i++)                                 // Цикл встановлення активного логічного рівня на обраній лінії
  {                                                           // Відкриття циклу керування рядками
    digitalWrite(rowPins[i], (i == row) ? LOW : HIGH);        // Притискання цільового рядка до нуля та подача одиниці на решту
  }                                                           // Закриття циклу керування рядками

  delayMicroseconds(10);                                        // Затримка для стабілізації перехідного процесу напруги на контактах

  int reading = digitalRead(colPins[col]);                      // Фіксація миттєвого логічного рівня на обраному стовпчику

  if (reading != lastButtonState[row][col])                     // Виявлення факту зміни електричного рівня сигналу
  {                                                             // Відкриття гілки зміни сигналу
    lastDebounceTime[row][col] = millis();                      // Оновлення системного часу початку процесу брязкоту
    lastButtonState[row][col] = reading;                        // Запам'ятовування нового значення для наступних перевірок
  }                                                             // Закриття гілки зміни сигналу

  if ((millis() - lastDebounceTime[row][col]) > DEBOUNCE_DELAY) // Контроль перевищення тривалості стабільності сигналу над часом брязкоту
  {                                                             // Відкриття блоку фіксації стабільного сигналу
    if (reading != buttonState[row][col])                       // Перевірка зміни підтвердженого рівня відносно попереднього
    {                                                           // Відкриття блоку оновлення підтвердженого стану
      buttonState[row][col] = reading;                          // Збереження нового стабільного значення контакту
      return buttonState[row][col];                             // Повернення оновленого логічного стану лінії
    }                                                           // Закриття блоку оновлення підтвердженого стану
  }                                                             // Закриття блоку фіксації стабільного сигналу
  return HIGH;                                                  // Повернення високого рівня за відсутності підтверджених змін
}                                                               // Закриття функції опитування клавіші

bool isMatrixButtonPressed(int row, int col)                    // Початок функції перевірки факту замикання контакту
{                                                               // Відкриття тіла функції перевірки натискання
  return readMatrixButton(row, col) == LOW;                     // Повернення істини у разі виявлення активного низького рівня
}                                                               // Закриття функції перевірки натискання

int getPressedButton()                                          // Початок функції послідовного сканування всіх кнопок клавіатури
{                                                               // Відкриття тіла функції загального сканування
  for (int row = 0; row < 4; row++)                             // Зовнішній перебір рядків матриці
  {                                                             // Відкриття циклу рядків
    for (int col = 0; col < 4; col++)                           // Внутрішній перебір стовпчиків матриці
    {                                                           // Відкриття циклу стовпчиків
      if (isMatrixButtonPressed(row, col))                      // Перевірка наявності натискання у поточній комірці
      {                                                         // Відкриття умови виявлення активної кнопки
        return row * 4 + col;                                   // Розрахунок та повернення лінійного номера знайденої кнопки
      }                                                         // Закриття умови виявлення активної кнопки
    }                                                           // Закриття циклу стовпчиків
  }                                                             // Закриття циклу рядків
  return -1;                                                    // Повернення ознаки відсутності будь-яких натиснутих кнопок
}                                                               // Закриття функції загального сканування

const char *getMacro(int buttonIndex)                           // Початок функції вибірки команди за номером клавіші
{                                                               // Відкриття тіла функції вибірки команди
  if (buttonIndex >= 0 && buttonIndex < NUM_BUTTONS)            // Контроль коректності діапазону номера кнопки
  {                                                             // Відкриття блоку валідного індексу
    return profiles[currentProfile].macros[buttonIndex];        // Повернення вказівника на макрос активної конфігурації
  }                                                             // Закриття блоку валідного індексу
  return "";                                                    // Повернення порожнього тексту у разі неприпустимого індексу
}                                                               // Закриття функції вибірки команди

void nextProfile()                                              // Початок процедури зміни активного набору макросів
{                                                               // Відкриття тіла функції зміни набору
  currentProfile = (currentProfile + 1) % NUM_PROFILES;         // Циклічний інкремент індексу профілю за модулем
}                                                               // Закриття функції зміни набору

void sendMacroCommand(const char *macro)                        // Початок функції надсилання команди на комп'ютер
{                                                               // Відкриття тіла функції надсилання команди
  Serial.print("[HID COMMAND] Executed: ");                     // Виведення службового маркера виконання в термінал
  Serial.println(macro);                                        // Друк надісланої послідовності дій у послідовний порт
}                                                               // Закриття функції надсилання команди

void handleButtonPress(int buttonIndex)                         // Початок процедури обробки сигналу від натиснутої клавіші
{                                                               // Відкриття тіла функції диспетчеризації події
  if (buttonIndex < 0 || buttonIndex >= NUM_BUTTONS)            // Перевірка діапазону вхідного індексу кнопки
  {                                                             // Відкриття блоку відсікання помилкових кодів
    return;                                                     // Переривання виконання при некоректному значенні номера
  }                                                             // Закриття блоку відсікання помилкових кодів

  lastSentButton = buttonIndex + 1;                             // Фіксація номера останньої клавіші для відправки телеметрії

  const char *macro = getMacro(buttonIndex);                    // Отримання назви закріпленої команди з таблиці
  recordButtonPress(buttonIndex);                               // Передача інформації про натискання у статистичний аналізатор

  Serial.print("Button ");                                      // Друк префікса номера елемента
  Serial.print(buttonIndex + 1);                                // Друк порядкового номера клавіші від одиниці
  Serial.print(" pressed - Macro: ");                           // Друк зв'язувального фрагмента тексту
  Serial.println(macro);                                        // Виведення назви призначеної команди у консоль

  sendMacroCommand(macro);                                      // Виклик функції виконання команди вхідного інтерфейсу
  showButtonPress(buttonIndex, macro);                          // Запуск індикації спрацьовування на екрані пристрою
}                                                               // Закриття функції диспетчеризації події

void handleProfileSwitch()                                                      // Початок підпрограми контролю службової клавіші зміни розкладки
{                                                                               // Відкриття блоку обробки перемикання
  static bool btn9WasPressed = false;                                           // Збереження стану перемикача між викликами циклу
  bool isDown = isMatrixButtonPressed(PROFILE_SWITCH_ROW, PROFILE_SWITCH_COL);  // Зчитування фізичного рівня на кнопці перемикання

  if (isDown && !btn9WasPressed)                            // Фіксація моменту первинного замикання контактів
  {                                                         // Відкриття блоку спрацьовування фронту
    btn9WasPressed = true;                                  // Блокування повторного виклику до моменту відпускання
    nextProfile();                                          // Перемикання на наступний за чергою профіль команд
    showMacroGrid(getCurrentProfileName());                 // Оновлення робочого інтерфейсу на дисплеї

    Serial.println("=================================");    // Виведення лінії оформлення блоку
    Serial.print("PROFILE SWITCHED TO: ");                  // Текст повідомлення про зміну робочого режиму
    Serial.println(getCurrentProfileName());                // Виведення імені активного профілю
    Serial.println("=================================");    // Виведення завершальної лінії оформлення
  }                                                         // Закриття блоку спрацьовування фронту
  else if (!isDown)                                         // Фіксація розмикання контактів кнопки перемикання
  {                                                         // Відкриття блоку відновлення готовності
    btn9WasPressed = false;                                 // Дозвіл на наступне спрацьовування перемикача
  }                                                         // Закриття блоку відновлення готовності
}                                                           // Закриття підпрограми контролю службової клавіші

void updateDisplay()                                        // Початок процедури скидання тимчасової індикації екрана
{                                                           // Відкриття тіла функції поновлення екрана
  static unsigned long lastDisplayUpdate = 0;               // Збереження мітки часу попереднього скидання
  static int lastProfile = -1;                              // Збереження індексу профілю попереднього кадру

  if (currentProfile != lastProfile || millis() - lastDisplayUpdate > 5000) // Контроль зміни режиму або виходу за інтервал утримання кадру
  {                                                                         // Відкриття блоку перемальовки головного табло
    showMacroGrid(getCurrentProfileName());                                 // Відображення головного інформаційного табло
    lastProfile = currentProfile;                                           // Синхронізація запам'ятованого значення профілю
    lastDisplayUpdate = millis();                                           // Оновлення мітки часу останнього виводу табло
  }                                                                         // Закриття блоку перемальовки головного табло
}                                                                           // Закриття функції поновлення екрана

unsigned long lastAISuggestionTime = 0;                                     // Змінна збереження часу попередньої генерації підказки

void showAISuggestions()                                                    // Початок підпрограми формування та відображення порад
{                                                                           // Відкриття блоку роботи з порадами
  if (millis() - lastAISuggestionTime >= AI_SUGGESTION_INTERVAL)            // Перевірка настання планового інтервалу для нової підказки
  {                                                                         // Відкриття блоку періодичного опитування аналітики
    const char *context = detectContext();                                  // Отримання визначеного системою контексту з аналітичного модуля
    const char *suggestion = generateSuggestion(context);                   // Складання текстової рекомендації на основі виявленого контексту

    Serial.print("AI Context: ");                                           // Виведення підпису параметра типу поточного контексту
    Serial.println(context);                                                // Виведення визначеного типу контексту в консоль
    Serial.print("AI Suggestion: ");                                        // Виведення підпису згенерованої рекомендації
    Serial.println(suggestion);                                             // Друк тексту підказки для оптимізації роботи

    showAISuggestion(suggestion);                                           // Виведення сформованої підказки на екран дисплея
    lastAISuggestionTime = millis();                                        // Фіксація мітки часу останнього виклику генерації
  }                                                                         // Закриття блоку періодичного опитування аналітики
}                                                                           // Закриття підпрограми формування порад

void setup()                                                                // Головна підпрограма налаштування системи при запуску
{                                                                           // Відкриття блоку конфігурації платформи
  Serial.begin(115200);                                                     // Налаштування швидкості інформаційного каналу передачі даних
  delay(1000);                                                              // Пауза для встановлення стабільного живлення компонентів

  Serial.println("=================================");                      // Друк верхньої рамки стартового сповіщення
  Serial.println("AI Macro Pad");                                           // Виведення офіційного найменування пристрою
  Serial.println("=================================");                      // Друк розділювача стартового сповіщення

  connectWiFi();                                            // Виклик підпрограми підключення до бездротової мережі
  initDisplay();                                            // Виклик процедури конфігурації модуля відображення інформації
  showWelcomeScreen();                                      // Виведення початкової графічної заставки
  initButtons();                                            // Налаштування виводів мікроконтролера під роботу з матрицею кнопок
  initAI();                                                 // Ініціалізація внутрішніх структур модуля машинного навчання

  showMacroGrid(getCurrentProfileName());                   // Виведення базового інформаційного табло

  Serial.println("System ready!");                          // Інформаційне сповіщення про повну готовність до роботи
  Serial.println("Press any button to send macros");        // Інструкція з надсилання команд у термінал
  Serial.println("Press button 9 to switch profiles");      // Інструкція щодо перемикання наборів дій
  Serial.println("=================================");      // Друк нижньої межі сповіщення готовності
}                                                           // Закриття підпрограми конфігурації платформи

void loop()                                                 // Головний циклічний процес виконання системних завдань
{                                                           // Відкриття тіла головного нескінченного циклу
  sendTelemetryToThingSpeak();                              // Перевірка таймера та вивантаження даних телеметрії на сервер

  int pressedButton = getPressedButton();                                 // Зчитування коду поточної затиснутої кнопки матриці
  int switchButtonIndex = PROFILE_SWITCH_ROW * 4 + PROFILE_SWITCH_COL;    // Визначення індексу кнопки перемикання режимів

  if (pressedButton == switchButtonIndex)                                 // Обробка події кнопки зміни профілю після єдиного сканування матриці
  {                                                                       // Відкриття обробки службової кнопки
    nextProfile();                                                        // Перехід до наступного профілю рівно один раз за натискання
    showMacroGrid(getCurrentProfileName());                               // Оновлення інформації на OLED після перемикання
    Serial.print("PROFILE SWITCHED TO: ");                                // Виведення одного короткого повідомлення про новий профіль
    Serial.println(getCurrentProfileName());                              // Друк назви активного профілю
  }                                                                       // Закриття обробки службової кнопки
  else if (pressedButton != -1)                                           // Обробка звичайних кнопок після єдиного сканування матриці
  {                                                                       // Відкриття обробки кліку робочої кнопки
    handleButtonPress(pressedButton);                                     // Виконання та індикація макросу для зафіксованої кнопки
  }                                                                       // Закриття обробки кліку робочої кнопки

  updateDisplay();                                                        // Планове поновлення стану табло та очищення після індикації дії
  showAISuggestions();                                                    // Опитування таймера та виведення рекомендацій оптимізації

  delay(10);                                                              // Апаратне розвантаження обчислювального ядра між ітераціями циклу
}                                                                         // Закриття головного нескінченного циклу