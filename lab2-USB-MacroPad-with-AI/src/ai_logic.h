#ifndef AI_LOGIC_H                              // Перевірка відсутності попереднього підключення заголовного файлу
#define AI_LOGIC_H                              // Визначення макросу для запобігання повторній компіляції модуля

#include <Arduino.h>                            // Підключення стандартної бібліотеки функцій та типів фреймворку

#define MAX_SUGGESTIONS 5                       // Гранична кількість доступних варіантів текстових порад
#define SUGGESTION_LENGTH 64                    // Максимальна довжина рядка повідомлення рекомендації

struct ButtonPattern                            // Оголошення структури для збереження одиничної події натискання
{                                               // Відкриття опису полів структури події
  int buttonIndex;                              // Числовий індекс клавіші в діапазоні від нуля до п'ятнадцяти
  unsigned long timestamp;                      // Часова мітка моменту фіксації натискання в мілісекундах
};                                              // Закриття опису полів структури події

struct UsagePattern                             // Оголошення структури накопичення статистичних даних роботи
{                                               // Відкриття опису полів структури статистики
  int buttonCounts[16];                         // Масив кількості спрацьовувань окремо для кожної клавіші
  unsigned long lastUsed[16];                   // Масив міток часу останнього використання кожної клавіші
  int totalPresses;                             // Лічильник сумарної кількості взаємодій за поточний сеанс
  unsigned long sessionStart;                   // Час запуску аналітичного модуля та відліку тривалості сесії
};                                              // Закриття опису полів структури статистики

UsagePattern patternData = {0};                 // Створення та обнулення глобальної структури статистики
ButtonPattern recentPatterns[10];               // Кільцевий масив історії останніх десяти натискань
int patternIndex = 0;                           // Вказівник поточної позиції для запису в кільцевий буфер

void initAI()                                       // Оголошення підпрограми початкового налаштування аналітичного модуля
{                                                   // Відкриття тіла функції ініціалізації аналітики
  memset(&patternData, 0, sizeof(UsagePattern));    // Заповнення нульовими значеннями всієї структури даних
  patternData.sessionStart = millis();              // Фіксація поточного системного часу як старту сесії
  Serial.println("AI system initialized");          // Виведення повідомлення про готовність модуля в термінал
}                                                   // Закриття функції початкового налаштування аналітики

void recordButtonPress(int buttonIndex)             // Оголошення функції реєстрації натискання клавіші в аналітиці
{                                                   // Відкриття тіла функції фіксації натискання
  if (buttonIndex >= 0 && buttonIndex < 16)         // Перевірка належності індексу клавіші допустимому діапазону
  {                                                 // Відкриття блоку обробки валідного індексу
    patternData.buttonCounts[buttonIndex]++;        // Інкремент персонального лічильника використання даної кнопки
    patternData.lastUsed[buttonIndex] = millis();   // Оновлення часу останньої активації відповідної клавіші
    patternData.totalPresses++;                     // Збільшення загальної кількості зафіксованих натискань

    recentPatterns[patternIndex].buttonIndex = buttonIndex;   // Збереження коду кнопки в кільцевий буфер
    recentPatterns[patternIndex].timestamp = millis();        // Запис поточної часової мітки у відповідний елемент буфера
    patternIndex = (patternIndex + 1) % 10;                   // Циклічний зсув індексу буфера за модулем десять
  }                                                           // Закриття блоку обробки валідного індексу
}                                                             // Закриття функції реєстрації натискання

const char *detectContext()                                               // Оголошення функції визначення поточного контексту застосунків
{                                                                         // Відкриття тіла функції класифікатора контексту
  unsigned long currentTime = millis();                                   // Зчитування поточного часу роботи мікроконтролера
  unsigned long sessionDuration = currentTime - patternData.sessionStart; // Розрахунок поточної тривалості робочого сеансу

  if (sessionDuration < 10000)                                // Перевірка тривалості початкового етапу накопичення інформації
  {                                                           // Відкриття гілки початкового стану
    return "initial_setup";                                   // Повернення ідентифікатора стартового калібрування системи
  }                                                           // Закриття гілки початкового стану

  int codingButtons = 0;                                      // Змінна підрахунку викликів клавіш блоку програмування
  int generalButtons = 0;                                     // Змінна підрахунку викликів клавіш системного блоку
  int gamingButtons = 0;                                      // Змінна підрахунку викликів клавіш ігрового блоку

  for (int i = 0; i < 16; i++)                                // Цикл аналізу частот використання всіх шістнадцяти клавіш
  {                                                           // Відкриття циклу розподілу клавіш за групами
    if (i >= 0 && i <= 7)
      codingButtons += patternData.buttonCounts[i];           // Додавання натискань перших двох рядків до групи кодування
    else if (i >= 8 && i <= 11)
      generalButtons += patternData.buttonCounts[i];          // Додавання натискань третього рядка до системної групи
    else
      gamingButtons += patternData.buttonCounts[i];           // Додавання натискань четвертого рядка до ігрової групи
  }                                                           // Закриття циклу розподілу клавіш

  if (codingButtons > generalButtons && codingButtons > gamingButtons)        // Перевірка домінування активності кнопок групи програмування
  {                                                                           // Відкриття гілки переважання дій кодування
    return "coding";                                                          // Класифікація поточного середовища як середовище розробки
  }                                                                           // Закриття гілки дій кодування
  else if (gamingButtons > codingButtons && gamingButtons > generalButtons)   // Перевірка домінування активності кнопок ігрової групи
  {                                                                           // Відкриття гілки переважання ігрових дій
    return "gaming";                                                          // Класифікація поточного середовища як ігровий процес
  }                                                                           // Закриття гілки ігрових дій
  else                                                                        // Обробка ситуації переважання загальних дій або рівності показників
  {                                                                           // Відкриття гілки за замовчуванням
    return "general";                                                         // Класифікація поточного режиму як базове робоче оточення
  }                                                                           // Закриття гілки за замовчуванням
}                                                                             // Закриття функції визначення контексту

const char *generateSuggestion(const char *context)                           // Оголошення функції підбору рекомендацій за контекстом
{                                                                             // Відкриття тіла функції формування порад
  static char suggestion[SUGGESTION_LENGTH];                                  // Статичний буфер для збереження сформованого тексту

  if (strcmp(context, "coding") == 0)                                         // Порівняння переданого контексту з режимом програмування
  {                                                                           // Відкриття гілки вибору підказки для кодування
    strcpy(suggestion, "Try Ctrl+Shift+F for formatting");                    // Копіювання поради щодо швидкого форматування коду
  }                                                                           // Закриття гілки підказки для кодування
  else if (strcmp(context, "gaming") == 0)                                    // Порівняння переданого контексту з ігровим режимом
  {                                                                           // Відкриття гілки вибору підказки для ігор
    strcpy(suggestion, "Use number keys for quick actions");                  // Копіювання поради щодо застосування швидких дій
  }                                                                           // Закриття гілки підказки для ігор
  else if (strcmp(context, "general") == 0)                                   // Порівняння переданого контексту із загальним режимом
  {                                                                           // Відкриття гілки підказки для щоденної роботи
    strcpy(suggestion, "Alt+Tab to switch windows");                          // Копіювання поради щодо перемикання вікон операційної системи
  }                                                                           // Закриття гілки підказки для щоденної роботи
  else                                                                        // Вибір тексту за замовчуванням для невизначеного або початкового стану
  {                                                                           // Відкриття гілки базової підказки
    strcpy(suggestion, "Press any button to start");                          // Копіювання запрошення до початку роботи з клавішами
  }                                                                           // Закриття гілки базової підказки

  return suggestion;                                                          // Повернення сформованого рядка текстової рекомендації
}                                                                             // Закриття функції підбору рекомендацій

const char *getPatternBasedSuggestion()                     // Оголошення функції генерації поради на базі статистики
{                                                           // Відкриття тіла функції статистичної підказки
  static char suggestion[SUGGESTION_LENGTH];                // Статичний буфер зберігання результуючого рядка

  if (patternData.totalPresses < 5)                         // Перевірка наявності мінімальної бази натискань для висновків
  {                                                         // Відкриття гілки недостатньої кількості даних
    strcpy(suggestion, "Keep pressing to learn patterns");  // Повідомлення про необхідність продовження збору статистики
    return suggestion;                                      // Дострокове повернення інформаційного рядка
  }                                                         // Закриття гілки недостатньої кількості даних

  int mostUsedButton = 0;                                   // Змінна збереження номера найчастіше натиснутої клавіші
  int maxCount = 0;                                         // Змінна фіксації максимальної кількості спрацьовувань

  for (int i = 0; i < 16; i++)                              // Перебір масиву лічильників для пошуку максимуму
  {                                                         // Відкриття циклу пошуку найпопулярнішої клавіші
    if (patternData.buttonCounts[i] > maxCount)             // Перевірка перевищення поточного максимального значення
    {                                                       // Відкриття блоку оновлення максимуму
      maxCount = patternData.buttonCounts[i];               // Збереження нового пікового значення лічильника
      mostUsedButton = i;                                   // Запам'ятовування індексу відповідної кнопки
    }                                                       // Закриття блоку оновлення максимуму
  }                                                         // Закриття циклу пошуку

  snprintf(suggestion, SUGGESTION_LENGTH, "Most used: Button %d (%d times)",  // Запис відформатованого тексту з номером і лічильником
           mostUsedButton + 1, maxCount);                                     // Передача номера кнопки від одиниці та кількості дій

  return suggestion;                                                          // Повернення сформованого текстового повідомлення аналітики
}                                                                             // Закриття функції статистичної підказки

void printAIStats()                                               // Оголошення діагностичної функції виводу аналітики в термінал
{                                                                 // Відкриття тіла функції друку статистики
  Serial.println("AI Statistics:");                               // Друк заголовка статистичного блоку
  Serial.print("Total presses: ");                                // Виведення позначення параметра сумарних дій
  Serial.println(patternData.totalPresses);                       // Друк загальної кількості зареєстрованих взаємодій
  Serial.print("Session duration: ");                             // Виведення позначення тривалості робочого сеансу
  Serial.print((millis() - patternData.sessionStart) / 1000);     // Розрахунок та друк секунд від моменту старту системи
  Serial.println(" seconds");                                     // Друк одиниці вимірювання часу
  Serial.print("Detected context: ");                             // Виведення назви поля визначеного контексту
  Serial.println(detectContext());                                // Виклик класифікатора та друк його результату

  Serial.println("Button usage:");                      // Заголовок таблиці використання окремих клавіш
  for (int i = 0; i < 16; i++)                          // Цикл опитування лічильників для виводу активних кнопок
  {                                                     // Відкриття циклу друку натискань
    if (patternData.buttonCounts[i] > 0)                // Фільтрація виведення лише активованих клавіш
    {                                                   // Відкриття блоку друку активної клавіші
      Serial.print("  Button ");                        // Друк текстового префікса назви кнопки зі зміщенням
      Serial.print(i + 1);                              // Виведення фізичного номера клавіші від одиниці
      Serial.print(": ");                               // Друк розділювального символу
      Serial.println(patternData.buttonCounts[i]);      // Друк сумарної кількості зафіксованих дій для кнопки
    }                                                   // Закриття блоку друку активної клавіші
  }                                                     // Закриття циклу друку натискань
}                                                       // Закриття функції друку статистики

float calculateButtonFrequency(int buttonIndex)         // Оголошення функції обчислення емпіричної ймовірності натискання
{                                                       // Відкриття тіла функції розрахунку відносної частоти
  if (patternData.totalPresses == 0)
    return 0.0;                                                                     // Повернення нульової ймовірності за повної відсутності дій
  return (float)patternData.buttonCounts[buttonIndex] / patternData.totalPresses;   // Розрахунок частки використання кнопки від загальної суми дій
}                                                                                   // Закриття функції розрахунку ймовірності

int predictNextButton()                             // Оголошення алгоритму передбачення наступної найімовірнішої клавіші
{                                                   // Відкриття тіла функції прогнозування
  int maxCount = 0;                                 // Змінна фіксації найбільшої ваги серед усіх кнопок
  int predictedButton = -1;                         // Ініціалізація індексу прогнозованої кнопки значенням відсутності результату

  for (int i = 0; i < 16; i++)                      // Перебір накопичених значень лічильників за всіма клавішами
  {                                                 // Відкриття циклу пошуку найімовірнішого кандидата
    if (patternData.buttonCounts[i] > maxCount)     // Перевірка наявності більшої активності за кнопкою
    {                                               // Відкриття блоку перепризначення лідера
      maxCount = patternData.buttonCounts[i];       // Оновлення максимального значення частоти
      predictedButton = i;                          // Призначення кнопки з найбільшою частотою як прогнозованої
    }                                               // Закриття блоку перепризначення лідера
  }                                                 // Закриття циклу пошуку

  return predictedButton;                           // Повернення індексу передбаченої кнопки або мінус одиниці
}                                                   // Закриття функції прогнозування

bool isPatternDetected()                            // Оголошення функції детектування повторюваних циклічних дій
{                                                   // Відкриття тіла функції перевірки регулярних патернів
  if (patternIndex < 5)
    return false;                                   // Блокування аналізу за недостатньої заповненості кільцевого буфера

  int patternCount = 0;                                                       // Лічильник збігів між двома послідовними серіями натискань
  for (int i = 0; i < 5; i++)                                                 // Поелементне порівняння двох підряд зафіксованих послідовностей
  {                                                                           // Відкриття циклу пошуку еквівалентних подій
    if (recentPatterns[i].buttonIndex == recentPatterns[i + 5].buttonIndex)   // Перевірка тотожності номерів кнопок зі зміщенням у п'ять кроків
    {                                                                         // Відкриття блоку фіксації збігу
      patternCount++;                                                         // Збільшення кількості зафіксованих однакових пар дій
    }                                                                         // Закриття блоку фіксації збігу
  }                                                                           // Закриття циклу пошуку

  return patternCount >= 3;                         // Підтвердження наявності стійкого патерну при трьох або більше збігах
}                                                   // Закриття функції перевірки регулярних патернів
#endif                                              // Завершення умовної компіляції заголовного файлу модуля