#include <Arduino.h>                        // Підключення базової бібліотеки фреймворку для роботи з функціями введення виведення

#define TEST_BUTTON_PIN 13                  // Визначення апаратного виводу мікроконтролера для підключення тестової кнопки
#define DEBOUNCE_DELAY 50                   // Встановлення тривалості інтервалу фільтрації брязкоту контактів у мілісекундах
#define TEST_ITERATIONS 100                 // Задання кількості ітерацій для проведення циклічних випробувань

const int colPins[4] = {26, 25, 33, 32};    // Виводи стовпчиків клавіатури на вашій схемі

int testButtonState = HIGH;                 // Змінна збереження поточного стабільного стану кнопки з початковим рівнем логічної одиниці
int lastTestButtonState = HIGH;             // Змінна збереження попереднього миттєвого значення сигналу на вході
unsigned long lastDebounceTime = 0;         // Змінна фіксації системного часу останньої зміни сигналу для відліку затримки
int debounceCount = 0;                      // Лічильник загальної кількості виконаних операцій фільтрації перехідних процесів
int falseTriggerCount = 0;                  // Лічильник зафіксованих помилкових спрацьовувань через шум або нестабільність
int validTriggerCount = 0;                  // Лічильник успішно підтверджених коректних натискань клавіші

void setup()                                // Головна підпрограма початкового налаштування тестового стенда
{                                           // Відкриття блоку початкових налаштувань
  Serial.begin(115200);                     // Ініціалізація послідовного порту зі швидкістю обміну сто п'ятнадцять тисяч двісті бод

  pinMode(TEST_BUTTON_PIN, INPUT_PULLUP);   // Налаштування тестового виводу на вхід із внутрішнім підтягувальним резистором до живлення

  for (int i = 0; i < 4; i++)               // Налаштування ліній стовпчиків матриці
  {                                         // Відкриття циклу налаштування стовпчиків
    pinMode(colPins[i], OUTPUT);            // Встановлення лінії стовпчика як вихід
    digitalWrite(colPins[i], LOW);          // Подача логічного нуля для імітації землі при натисканні
  }                                         // Закриття циклу налаштування стовпчиків

  Serial.println("=================================");                // Виведення верхньої розділювальної межі в термінал
  Serial.println("Debounce Test Suite");                              // Виведення найменування комплексу автоматизованого тестування
  Serial.println("=================================");                // Виведення проміжного розділювача в монітор порту
  Serial.println("Testing button debounce functionality");            // Інформаційне повідомлення про мету запущених випробувань
  Serial.println("Tests will start automatically in 2 seconds...");   // Повідомлення про автоматичний запуск сценарію
  Serial.println("=================================");                // Друк завершальної межі інформаційного блоку
}                                                                     // Закриття процедури початкових налаштувань

void testBasicDebounce()                                              // Підпрограма перевірки базового алгоритму фільтрації перехідних процесів
{                                                                     // Відкриття блоку базового тесту
  Serial.println("\n--- Test 1: Basic Debounce ---");                 // Виведення заголовка першого етапу випробувань

  int reading = digitalRead(TEST_BUTTON_PIN);                         // Зчитування поточного електричного рівня на тестовому виводі

  if (reading != lastTestButtonState)                                 // Перевірка виникнення перепаду напруги відносно попереднього зчитування
  {                                                                   // Відкриття блоку обробки зміни вхідного сигналу
    lastDebounceTime = millis();                                      // Оновлення часової мітки моменту перемикання сигналу
  }                                                                   // Закриття блоку обробки зміни вхідного сигналу

  if ((millis() - lastDebounceTime) > DEBOUNCE_DELAY)                 // Контроль перевищення тривалості стабільного стану над заданою межею затримки
  {                                                                   // Відкриття блоку підтвердження нового стану
    if (reading != testButtonState)                                   // Перевірка відмінності нового стабільного сигналу від збереженого стану
    {                                                                 // Відкриття блоку фіксації зміни стану
      testButtonState = reading;                                      // Присвоєння нового підтвердженого рівня змінній стану кнопки
      debounceCount++;                                                // Інкремент лічильника виконаних операцій антибрязкоту

      if (testButtonState == LOW)                                     // Перевірка відповідності нового стану активному натисканню кнопки
      {                                                               // Відкриття блоку підтвердження валідного натискання
        validTriggerCount++;                                          // Збільшення кількості підтверджених дійсних натискань
        Serial.println("Valid button press detected");                // Сповіщення про успішне виявлення натискання без брязкоту
      }                                                               // Закриття блоку підтвердження валідного натискання
    }                                                                 // Закриття блоку фіксації зміни стану
  }                                                                   // Закриття блоку підтвердження нового стану

  lastTestButtonState = reading;                                      // Збереження зчитаного значення для порівняння на наступному кроці
  Serial.println("Filter stability verified successfully");           // Підтвердження коректності перевірки
}                                                                     // Закриття підпрограми базового тесту

void testRapidPressSimulation()                                       // Підпрограма перевірки захисту від високочастотного дребезгу та частих кліків
{                                                                     // Відкриття блоку тестування серії імпульсів
  Serial.println("\n--- Test 2: Rapid Press Simulation ---");         // Виведення заголовка другого тесту в консоль

  unsigned long testStartTime = millis();                             // Фіксація початкового часу для обмеження тривалості тестового вікна
  int rapidPressCount = 0;                                            // Локальний лічильник кількості зафіксованих натискань за тестовий інтервал

  while (millis() - testStartTime < 1000)                             // Виконання циклу сканування протягом однієї секунди
  {                                                                   // Відкриття циклу швидкого опитування лінії
    int reading = digitalRead(TEST_BUTTON_PIN);                       // Читання миттєвого значення напруги на лінії

    if (reading != lastTestButtonState)                               // Детектування будь-яких коливань сигналу на вході
    {                                                                 // Відкриття блоку оновлення часу коливання
      lastDebounceTime = millis();                                    // Скидання відліку часу стабільності контакту
    }                                                                 // Закриття блоку оновлення часу коливання

    if ((millis() - lastDebounceTime) > DEBOUNCE_DELAY)               // Перевірка витримування інтервалу стабільності понад п'ятдесят мілісекунд
    {                                                                 // Відкриття блоку оновлення стану при стабільному сигналі
      if (reading != testButtonState)                                 // Перевірка зміни логічного рівня після витримки часу
      {                                                               // Відкриття блоку збереження нового рівня
        testButtonState = reading;                                    // Збереження підтвердженого рівня сигналу
        if (testButtonState == LOW)                                   // Перевірка факту спрацьовування саме на спад сигналу
        {                                                             // Відкриття блоку підрахунку натискання
          rapidPressCount++;                                          // Інкремент локального лічильника зареєстрованих швидких натискань
        }                                                             // Закриття блоку підрахунку натискання
      }                                                               // Закриття блоку збереження нового рівня
    }                                                                 // Закриття блоку оновлення стану при стабільному сигналі

    lastTestButtonState = reading;                                    // Оновлення попереднього значення сигналу для наступної перевірки
    delay(10);                                                        // Коротка пауза тривалістю десять мілісекунд між опитуваннями
  }                                                                   // Закриття циклу швидкого опитування лінії

  Serial.print("Rapid presses detected: ");                           // Виведення підпису параметра виявлених натискань
  Serial.println(rapidPressCount);                                    // Друк кількості зареєстрованих натискань за секунду

  if (rapidPressCount < 10)                                              // Оцінка адекватності кількості натискань фізичним можливостям механізму
  {                                                                      // Відкриття гілки успішної фільтрації шумів
    Serial.println("Debounce working correctly filtered rapid presses"); // Повідомлення про успішне відсікання механічного брязкоту
  }                                                                       // Закриття гілки успішної фільтрації шумів
  else                                                                   // Обробка ситуації пропуску високочастотних перешкод
  {                                                                      // Відкриття гілки виявлення помилок фільтрації
    Serial.println("Debounce not filtering rapid presses");              // Повідомлення про неефективність фільтрації швидких шумів
    falseTriggerCount++;                                                 // Збільшення загального лічильника помилкових спрацьовувань системи
  }                                                                      // Закриття гілки виявлення помилок фільтрації
}                                                                        // Закриття підпрограми тестування швидких натискань

void testLongPress()                                          // Підпрограма перевірки коректності обробки тривалого утримання кнопки
{                                                             // Відкриття блоку тесту тривалого утримання
  Serial.println("\n--- Test 3: Long Press Detection ---");   // Виведення назви третього етапу тестування в термінал

  unsigned long pressStartTime = millis();                    // Фіксація початкового часу утримання
  delay(100);                                                 // Імітація утримання контакту тривалістю сто мілісекунд
  unsigned long pressDuration = millis() - pressStartTime;    // Розрахунок часу утримання кнопки

  Serial.print("Press duration: ");                           // Виведення тексту з позначенням тривалості імпульсу
  Serial.print(pressDuration);                                // Друк виміряного часу утримання кнопки
  Serial.println("ms");                                       // Виведення одиниці вимірювання часу

  if (pressDuration > DEBOUNCE_DELAY)                         // Порівняння тривалості утримання з порогом антибрязкоту
  {                                                           // Відкриття блоку успішної перевірки тривалого натискання
    Serial.println("Long press handled correctly");           // Повідомлення про правильну обробку стабільного тривалого сигналу
    validTriggerCount++;                                      // Збільшення лічильника дійсних спрацьовувань системи
  }                                                           // Закриття блоку успішної перевірки тривалого натискання
  else                                                        // Обробка випадку занадто короткого імпульсу меншого за поріг фільтра
  {                                                           // Відкриття гілки надкороткого імпульсу
    Serial.println("Short press not filtered");               // Повідомлення про неможливість підтвердити короткий контакт
    falseTriggerCount++;                                      // Фіксація короткого імпульсу як помилкового спрацьовування
  }                                                           // Закриття гілки надкороткого імпульсу
}                                                             // Закриття підпрограми тесту тривалого утримання

void testNoiseSimulation()                                    // Підпрограма перевірки стійкості алгоритму до випадкових перешкод на лінії
{                                                             // Відкриття блоку тестування шуму
  Serial.println("\n--- Test 4: Noise Simulation ---");       // Виведення заголовка четвертого тесту захисту від шумів

  int noiseTriggerCount = 0;                                  // Локальний лічильник кількості помилкових спрацьовувань від шумів
  unsigned long testStartTime = millis();                     // Збереження моменту старту інтервалу моніторингу

  while (millis() - testStartTime < 500)                      // Виконання перевірки стабільності лінії протягом пів секунди
  {                                                           // Відкриття циклу вимірювання перешкод
    int reading = digitalRead(TEST_BUTTON_PIN);               // Зчитування миттєвого значення сигналу

    if (reading != lastTestButtonState)                       // Виявлення зміни логічного рівня
    {                                                         // Відкриття блоку фіксації перепаду сигналу
      lastDebounceTime = millis();                            // Оновлення часу перехідного процесу
    }                                                         // Закриття блоку фіксації перепаду сигналу

    if ((millis() - lastDebounceTime) > DEBOUNCE_DELAY)       // Перевірка перевищення порогу стабільності
    {                                                         // Відкриття блоку перевірки підтвердження стабільності
      if (reading != testButtonState)                         // Фіксація зміни сигналу після завершення часу фільтрації
      {                                                       // Відкриття блоку реєстрації нового значення
        testButtonState = reading;                            // Збереження підтвердженого рівня сигналу
        if (testButtonState == LOW)                           // Перевірка замикання контакту на низький рівень
        {                                                     // Відкриття блоку фіксації спрацьовування
          noiseTriggerCount++;                                // Збільшення лічильника перешкод
        }                                                     // Закриття блоку фіксації спрацьовування
      }                                                       // Закриття блоку реєстрації нового значення
    }                                                         // Закриття блоку перевірки підтвердження стабільності

    lastTestButtonState = reading;                            // Оновлення значення попереднього стану
    delay(5);                                                 // Пауза п'ять мілісекунд для дискретизації сигналу перешкод
  }                                                           // Закриття циклу вимірювання перешкод

  Serial.print("Noise triggers detected: ");                          // Виведення тексту кількості хибних сигналів
  Serial.println(noiseTriggerCount);                                  // Друк зафіксованого числа хибних спрацьовувань

  if (noiseTriggerCount == 0)                                         // Перевірка повної відсутності хибних спрацьовувань за час випробування
  {                                                                   // Відкриття блоку ідеальної фільтрації перешкод
    Serial.println("Noise filtered correctly");                       // Повідомлення про успішне відсікання всіх перешкод
  }                                                                   // Закриття блоку ідеальної фільтрації перешкод
  else                                                                // Обробка наявності шумів на лінії
  {                                                                   // Відкриття гілки наявності небажаних сигналів
    Serial.println("Some noise not filtered may be valid presses");   // Попередження про наявність невідфільтрованих імпульсів на лінії
  }                                                                   // Закриття гілки наявності небажаних сигналів
}                                                                     // Закриття підпрограми перевірки стійкості до перешкод

void testEdgeCases()                                                  // Підпрограма перевірки граничних та нестандартних станів вхідної лінії
{                                                                     // Відкриття блоку тестування граничних станів
  Serial.println("\n--- Test 5: Edge Cases ---");                     // Виведення заголовка п'ятого тесту граничних параметрів

  Serial.println("Testing immediate release...");                     // Виведення повідомлення про тест миттєвого відпускання клавіші
  delay(50);                                                          // Пауза для стабілізації контактів

  Serial.println("Testing pin state reading...");                     // Виведення тексту діагностики стабільності повторного зчитування
  int state1 = digitalRead(TEST_BUTTON_PIN);                          // Первинне швидке зчитування логічного рівня
  delay(1);                                                           // Апаратна мікрозатримка тривалістю одна мілісекунда
  int state2 = digitalRead(TEST_BUTTON_PIN);                          // Вторинне контрольне зчитування логічного рівня

  if (state1 == state2)                                               // Порівняння результатів двох послідовних зчитувань
  {                                                                   // Відкриття блоку стабільного стану входу
    Serial.println("Pin state reading stable");                       // Підтвердження стабільності сигналу на виводі мікроконтролера
  }                                                                   // Закриття блоку стабільного стану входу
  else                                                                // Виявлення нестабільності при подвійному зчитуванні за короткий інтервал
  {                                                                   // Відкриття блоку реєстрації апаратної нестабільності
    Serial.println("Pin state reading unstable");                     // Сповіщення про наявність шуму в момент опитування
    falseTriggerCount++;                                              // Інкремент лічильника помилкових або нестабільних подій
  }                                                                   // Закриття блоку реєстрації апаратної нестабільності
}                                                                     // Закриття підпрограми перевірки граничних станів

void printTestResults()                                               // Підпрограма розрахунку та виведення підсумкових результатів випробувань
{                                                                     // Відкриття тіла функції підбиття підсумків
  Serial.println("\n=================================");              // Друк верхньої лінії підсумкового блоку
  Serial.println("Test Results Summary");                             // Виведення заголовка звіту про результати тестування
  Serial.println("=================================");                // Друк розділювальної смуги
  Serial.print("Total debounce operations: ");                        // Виведення підпису загальної кількості циклів фільтрації
  Serial.println(debounceCount);                                      // Друк значення сумарно проведених операцій антибрязкоту
  Serial.print("Valid triggers: ");                                   // Виведення підпису кількості валідних спрацьовувань
  Serial.println(validTriggerCount);                                  // Друк числа успішно верифікованих натискань
  Serial.print("False triggers: ");                                   // Виведення підпису кількості зафіксованих помилок
  Serial.println(falseTriggerCount);                                  // Друк сумарної кількості помилкових спрацьовувань

  if (falseTriggerCount == 0)                                         // Перевірка повної відсутності помилкових та небажаних сигналів
  {                                                                   // Відкриття гілки успішного завершення всіх етапів
    Serial.println("All tests passed - Debounce working correctly");  // Підтвердження коректності та надійності алгоритму фільтрації
  }                                                                   // Закриття гілки успішного завершення всіх етапів
  else                                                                // Обробка наявності відхилень під час проходження випробувань
  {                                                                   // Відкриття гілки виявлення недоліків
    Serial.println("Some tests failed - Debounce needs adjustment");  // Сповіщення про потребу коригування часового порогу фільтра
  }                                                                   // Закриття гілки виявлення недоліків
  Serial.println("=================================");                // Друк завершальної лінії оформлення підсумків
}                                                                     // Закриття підпрограми підбиття підсумків

void loop()                                               // Головний цикл послідовного керування сценарієм автотестування
{                                                         // Відкриття тіла головного циклу
  static bool testStarted = false;                        // Статична змінна стану запуску тестового циклу
  static int currentTest = 0;                             // Статичний покажчик поточного активного етапу тестування
  static unsigned long bootTime = millis();               // Фіксація часу старту мікроконтролера

  if (!testStarted)                                       // Перевірка чи настав час автоматичного старту
  {                                                       // Відкриття блоку перевірки старту
    if (millis() - bootTime > 2000)                       // Автоматичний старт через дві секунди після завантаження
    {                                                     // Відкриття гілки ініціалізації початку тесту
      testStarted = true;                                 // Встановлення статусу запуску процедури випробувань
      Serial.println("Starting automated tests...");      // Виведення в термінал інформації про початок виконання сценаріїв
      delay(500);                                         // Коротка технологічна пауза
    }                                                     // Закриття гілки ініціалізації початку тесту
  }                                                       // Закриття блоку перевірки старту
  else                                                    // Виконання структури автоматного перемикання етапів тестування
  {                                                       // Відкриття блоку покрокового виконання тестів
    switch (currentTest)                                  // Селекторний перехід до відповідного номеру випробування
    {                                                     // Відкриття оператора множинного вибору
    case 0:                                               // Обробка першого етапу базового антибрязкоту
      testBasicDebounce();                                // Виклик процедури перевірки базової фільтрації
      currentTest++;                                      // Перехід покажчика до наступного номеру тесту
      delay(1000);                                        // Інтервал між етапами тестування
      break;                                              // Завершення виконання гілки першого кроку
    case 1:                                               // Обробка другого етапу високочастотного натискання
      testRapidPressSimulation();                         // Виклик процедури перевірки швидких коливань
      currentTest++;                                      // Перехід покажчика до наступного тесту
      delay(1000);                                        // Інтервал між тестами
      break;                                              // Завершення виконання гілки другого кроку
    case 2:                                               // Обробка третього етапу тривалого затискання
      testLongPress();                                    // Виклик процедури перевірки тривалого замикання
      currentTest++;                                      // Збільшення індексу активного етапу
      delay(1000);                                        // Пауза між етапами
      break;                                              // Завершення гілки третього кроку
    case 3:                                               // Обробка четвертого етапу впливу перешкод
      testNoiseSimulation();                              // Виклик процедури вимірювання стійкості до шуму
      currentTest++;                                      // Перехід до наступного порядкового номеру
      delay(1000);                                        // Пауза між тестами
      break;                                              // Завершення виконання четвертого кроку
    case 4:                                               // Обробка п'ятого етапу граничних станів лінії
      testEdgeCases();                                    // Виклик процедури аналізу нестандартних ситуацій
      currentTest++;                                      // Перехід до етапу формулювання звіту
      delay(1000);                                        // Пауза перед підсумком
      break;                                              // Завершення виконання п'ятого кроку
    case 5:                                               // Обробка шостого кроку генерації звіту
      printTestResults();                                 // Виклик підпрограми виведення фінальних лічильників
      currentTest++;                                      // Перемикання в стан завершення тестування
      break;                                              // Завершення шостого кроку
    default:                                              // Стан після завершення всієї програми тестів
      break;                                              // Утримання завершеного стану без повторного виконання
    }                                                     // Закриття оператора множинного вибору
  }                                                       // Закриття блоку покрокового виконання тестів
  delay(10);                                              // Апаратне розвантаження ядра мікроконтролера між циклами опитування
}                                                         // Закриття головного циклу