#include <WiFi.h>                                                                       // підключення бібліотеки для роботи з мережею бездротового зв'язку
#include <HTTPClient.h>                                                                 // підключення клієнта протоколу передачі даних для відправки запитів
#include <Adafruit_GFX.h>                                                               // підключення базової графічної бібліотеки для малювання фігур та тексту
#include <Adafruit_ILI9341.h>                                                           // підключення спеціалізованого драйвера кольорового дисплея
#include <TinyGPS++.h>                                                                  // підключення бібліотеки обробки протоколу навігаційних даних модуля
#include "ai_advisor.h"                                                                 // підключення власного заголовкового файлу інтелектуального асистента

const char* ssid = "Wokwi-GUEST";                                                       // назва точки доступу віртуальної бездротової мережі симулятора
const char* password = "";                                                              // пароль доступу до бездротової мережі симулятора
const char* thingSpeakServer = "http://api.thingspeak.com/update";                      // мережева адреса сервера хмарного сервісу
const char* apiKey = "VHNQB2O5LSBM4WYP";                                                // персональний секретний ключ запису даних у канал
const unsigned long THINGSPEAK_INTERVAL = 20000;                                        // інтервал відправки телеметрії двадцять секунд

#define TFT_CS 15                                                                       // визначення піна вибору чіпа дисплея на платі мікроконтролера
#define TFT_RST 4                                                                       // визначення піна скидання та перезавантаження контролера дисплея
#define TFT_DC 2                                                                        // визначення піна вибору передачі команд або графічних даних
#define TFT_MOSI 23                                                                     // визначення піна передачі послідовних даних по інтерфейсу
#define TFT_SCK 18                                                                      // визначення піна тактового сигналу шини послідовного зв'язку
#define TFT_MISO 19                                                                     // визначення піна прийому даних зворотного каналу шини зв'язку
#define TRIG_PIN 25                                                                     // визначення виводу мікроконтролера для передачі ультразвукового імпульсу
#define ECHO_PIN 26                                                                     // визначення виводу мікроконтролера для прийому відбитого луна сигналу
#define BUZZER_PIN 32                                                                   // визначення виводу керування звуковим випромінювачем
#define GPS_RX_PIN 16                                                                   // визначення апаратного виводу прийому послідовних навігаційних даних
#define GPS_TX_PIN 17                                                                   // визначення виводу передачі команд налаштування модуля навігації

Adafruit_ILI9341 tft = Adafruit_ILI9341(TFT_CS, TFT_DC, TFT_RST);                       // ініціалізація екземпляра об'єкта дисплея
TinyGPSPlus gps;                                                                        // створення екземпляра парсера навігаційних повідомлень
AiEcoAdvisor aiAdvisor;                                                                 // створення екземпляра класу інтелектуальної системи оцінки водіння
float distance = 400.0;                                                                 // змінна поточної виміряної дистанції до перешкоди в сантиметрах
float speed = 0.0;                                                                      // змінна поточної швидкості пересування автомобіля у кілометрах на годину
double latitude = 50.4501;                                                              // географічна широта поточного місцезнаходження автомобіля
double longitude = 30.5234;                                                             // географічна довгота поточного місцезнаходження автомобіля
float tripDistance = 0.0;                                                               // змінна накопиченого пробігу поточної поїздки у кілометрах
unsigned long lastSensorRead = 0;                                                       // часова мітка останнього опитування апаратних датчиків
unsigned long lastDisplayUpdate = 0;                                                    // часова мітка попереднього оновлення кадрів на дисплеї
unsigned long lastThingSpeakUpdate = 0;                                                 // часова мітка попередньої передачі пакетів у хмару
unsigned long lastAiAdviceTime = 0;                                                     // часова мітка останнього оновлення рекомендації водієві
const unsigned long AI_ADVICE_INTERVAL = 6000;                                          // інтервал генерації нових текстових підказок
unsigned long lastConsoleStatusTime = 0;                                                // часова мітка останнього виведення звіту в порт
bool wifiConnected = false;                                                             // логічний прапорець успішного встановлення бездротового з'єднання

void connectToWiFi();                                                                   // прототип функції первинного підключення до бездротової мережі
void readSensors();                                                                     // прототип функції опитування ультразвукового датчика та навігатора
void parkingSensor();                                                                   // прототип алгоритму генерації звукових імпульсів парктроніка
void drawDashboardLayout();                                                             // прототип функції побудови статичної розмітки екрана
void updateDashboardValues();                                                           // прототип функції динамічного оновлення цифрових показників
void drawAiAdviceCard();                                                                // прототип функції відмальовування картки з текстом рекомендацій
void printStatusRow(const char *k1, const char *v1, const char *k2, const char *v2);    // прототип допоміжної функції друку рядка таблиці
void printConsoleStatus();                                                              // прототип функції виведення таблиці стану системи в термінал
void sendToThingSpeak();                                                                // прототип функції відправки шести полів телеметрії на хмарний сервер

void setup() {                                                                          // головна функція початкового налаштування мікроконтролера та периферії
  Serial.begin(115200);                                                                 // налаштування швидкості передачі даних головного послідовного порту
  Serial.println();                                                                     // виведення порожнього рядка для відокремлення системних повідомлень
  Serial.println("======================");                                             // виведення верхньої рамки назви системи у термінал
  Serial.println("AI VEHICLE MONITORING SYSTEM");                                       // виведення заголовка проекту в консоль
  Serial.println("======================");                                             // виведення нижньої рамки назви системи у термінал
  Serial.println("System starting...");                                                 // виведення повідомлення про початок завантаження
  Serial.println();                                                                     // виведення порожнього рядка для форматування тексту
  Serial2.begin(9600, SERIAL_8N1, GPS_RX_PIN, GPS_TX_PIN);                              // ініціалізація порту модуля навігації
  pinMode(TRIG_PIN, OUTPUT);                                                            // конфігурація піна імпульсу датчика відстані як виходу
  pinMode(ECHO_PIN, INPUT);                                                             // конфігурація піна прийому луни датчика відстані як входу
  ledcSetup(0, 2000, 8);                                                                // ініціалізація каналу генерації звукової частоти
  ledcAttachPin(BUZZER_PIN, 0);                                                         // закріплення виводу зумера за апаратним каналом
  ledcWriteTone(0, 0);                                                                  // початковий нульовий стан звукового випромінювача
  tft.begin();                                                                          // ініціалізація апаратного зв'язку з графічним контролером дисплея
  tft.setRotation(1);                                                                   // встановлення горизонтальної альбомної орієнтації зображення
  tft.fillScreen(ILI9341_BLACK);                                                        // очищення робочої області екрана чорним кольором
  tft.setTextColor(ILI9341_CYAN);                                                       // вибір бірюзового кольору для промальовування тексту
  tft.setTextSize(3);                                                                   // вибір великого масштабу шрифту для головного логотипа
  tft.setCursor(30, 70);                                                                // позиціонування курсора для відображення верхнього напису
  tft.println("ECO-DRIVE AI");                                                          // виведення назви інтелектуальної системи на дисплей
  tft.setTextSize(2);                                                                   // вибір середнього розміру шрифту для підзаголовка проекту
  tft.setTextColor(ILI9341_WHITE);                                                      // вибір білого контрастного кольору для тексту опису
  tft.setCursor(30, 115);                                                               // позиціонування текстового курсора для другого інформаційного рядка
  tft.println("On-Board Computer");                                                     // виведення назви пристрою бортового комп'ютера на дисплей
  tft.setTextColor(ILI9341_GREEN);                                                      // вибір приємного зеленого кольору для індикації статусу
  tft.setCursor(30, 150);                                                               // позиціонування курсора для виведення статусу ініціалізації
  tft.println("System starting...");                                                    // виведення повідомлення про перебіг завантаження на екран
  delay(1800);                                                                          // пауза для візуального сприйняття користувачем заставки старту
  connectToWiFi();                                                                      // виклик підпрограми підключення до бездротової мережі зв'язку
  aiAdvisor.begin();                                                                    // запуск внутрішнього алгоритму інтелектуального помічника водія
  drawDashboardLayout();                                                                // побудова статичних рамок та розмітки панелі приладів
  readSensors();                                                                        // первинне опитування всіх апаратних сенсорів системи
  aiAdvisor.processTelemetry(speed, distance);                                          // первинний аналіз параметрів руху модулем
  printConsoleStatus();                                                                 // первинне виведення поточної таблиці телеметрії в консоль
  lastSensorRead = millis();                                                            // ініціалізація таймера періодичного опитування датчиків
  lastDisplayUpdate = millis();                                                         // ініціалізація таймера регулярного оновлення дисплея
  lastThingSpeakUpdate = millis();                                                      // початковий відлік таймера хмарної синхронізації
  lastAiAdviceTime = millis();                                                          // ініціалізація таймера оновлення рекомендацій асистента
  lastConsoleStatusTime = millis();                                                     // ініціалізація таймера формування текстових звітів
}                                                                                       // завершення виконання функції початкового налаштування

void loop() {                                                                           // головний нескінченний цикл виконання робочих завдань мікроконтролера
  while (Serial2.available() > 0) {                                                     // цикл перевірки наявності байтів від модуля навігації
    char c = Serial2.read();                                                            // зчитування чергового байта послідовного потоку повідомлення
    gps.encode(c);                                                                      // передача отриманого байта у бібліотеку аналізу навігаційних речень
  }                                                                                     // завершення циклу обробки вхідного навігаційного потоку
  parkingSensor();                                                                      // виклик функції аналізу небезпечного наближення та генерації звуку
  if (millis() - lastSensorRead >= 300) {                                               // перевірка настання інтервалу опитування сенсорів
    readSensors();                                                                      // виклик оновлення показників датчика дистанції та навігатора
    aiAdvisor.processTelemetry(speed, distance);                                        // аналіз нової швидкості та дистанції модулем
    lastSensorRead = millis();                                                          // оновлення часової мітки останнього зняття вимірювань
  }                                                                                     // завершення блоку періодичного опитування датчиків
  if (millis() - lastAiAdviceTime >= AI_ADVICE_INTERVAL) {                              // перевірка інтервалу для нової поради
    aiAdvisor.updateAdvice(speed, distance);                                            // формування оновленого тексту поради водієві
    drawAiAdviceCard();                                                                 // перемальовування картки з новою підказкою на екрані
    lastAiAdviceTime = millis();                                                        // фіксація моменту останнього оновлення рекомендації
  }                                                                                     // завершення блоку періодичного оновлення порад
  if (millis() - lastConsoleStatusTime >= 2000) {                                       // перевірка інтервалу формування звіту в консоль
    printConsoleStatus();                                                               // виведення структурованої таблиці параметрів у термінал
    lastConsoleStatusTime = millis();                                                   // оновлення мітки часу останнього виведення звіту
  }                                                                                     // завершення блоку періодичного друку в консоль
  if (millis() - lastDisplayUpdate >= 400) {                                            // перевірка настання часу оновлення даних екрана
    updateDashboardValues();                                                            // перемальовування динамічних цифрових значень приладів
    lastDisplayUpdate = millis();                                                       // оновлення часової мітки останньої перемальовки екрана
  }                                                                                     // завершення блоку регулярного оновлення дисплея
  bool syncDue = millis() - lastThingSpeakUpdate >= THINGSPEAK_INTERVAL;                // перевірка настання інтервалу передачі даних
  if (wifiConnected && syncDue) {                                                       // перевірка наявності мережі та готовності до відправки
    sendToThingSpeak();                                                                 // виклик функції формування та відправки телеметрії в інтернет
    lastThingSpeakUpdate = millis();                                                    // збереження часу останнього успішного циклу відправки
  }                                                                                     // завершення блоку відправки хмарних даних
}                                                                                       // завершення головного робочого циклу програми

void connectToWiFi() {                                                                  // функція процедури підключення до точки бездротового доступу
  tft.fillScreen(ILI9341_BLACK);                                                        // заливка екрана чорним фоном перед виведенням статусу
  tft.setTextColor(ILI9341_YELLOW);                                                     // вибір жовтого кольору тексту для індикації очікування
  tft.setTextSize(2);                                                                   // вибір середнього розміру шрифту для читабельності повідомлення
  tft.setCursor(20, 80);                                                                // встановлення курсора у початкову точку виведення тексту
  tft.println("Connecting WiFi...");                                                    // виведення інформації про спробу підключення до мережі
  tft.setCursor(20, 110);                                                               // зміщення курсора на наступний інформаційний рядок екрана
  tft.print("SSID: ");                                                                  // виведення префікса назви мережі бездротового зв'язку
  tft.println(ssid);                                                                    // відображення назви цільової точки доступу на екрані
  WiFi.begin(ssid, password);                                                           // запуск процедури з'єднання з бездротовою мережею
  int attempts = 0;                                                                     // ініціалізація лічильника спроб очікування відповіді від роутера
  while (WiFi.status() != WL_CONNECTED && attempts < 15) {                              // цикл перевірки статусу з'єднання
    delay(400);                                                                         // апаратна пауза між періодичними опитуваннями стану зв'язку
    Serial.print(".");                                                                  // виведення крапки прогресу підключення у послідовний порт
    tft.print(".");                                                                     // дублювання символу крапки процесу очікування на екрані дисплея
    attempts++;                                                                         // збільшення лічильника здійснених спроб підключення
  }                                                                                     // завершення циклу перевірки стану з'єднання
  if (WiFi.status() == WL_CONNECTED) {                                                  // перевірка успішного встановлення зв'язку з мережею
    wifiConnected = true;                                                               // встановлення глобального прапорця наявності інтернет зв'язку
    Serial.println();                                                                   // виведення порожнього рядка для повернення каретки
    Serial.println("[WiFi] Connected! IP: " + WiFi.localIP().toString());               // повідомлення про успішне встановлення з'єднання
    tft.setTextColor(ILI9341_GREEN);                                                    // вибір зеленого кольору для успішного статусу зв'язку
    tft.setCursor(20, 150);                                                             // позиціонування курсора для повідомлення про успішне з'єднання
    tft.println("WiFi Connected!");                                                     // виведення підтвердження з'єднання на панель приладів
    tft.setCursor(20, 180);                                                             // позиціонування курсора для виведення мережевої адреси
    tft.print("IP: ");                                                                  // виведення префікса мережевої адреси на дисплей
    tft.println(WiFi.localIP());                                                        // виведення отриманої мережевої адреси мікроконтролера
  } else {                                                                              // гілка дій у разі вичерпання ліміту спроб з'єднання
    wifiConnected = false;                                                              // скидання прапорця зв'язку у значення відсутності інтернету
    Serial.println();                                                                   // виведення порожнього рядка для вирівнювання
    Serial.println("[WiFi] Running in offline simulation mode.");                       // повідомлення про роботу системи в автономному режимі
    tft.setTextColor(ILI9341_RED);                                                      // вибір червоного кольору для індикації помилки зв'язку
    tft.setCursor(20, 150);                                                             // позиціонування курсора для виведення офлайн статусу
    tft.println("WiFi Offline Mode");                                                   // виведення повідомлення про автономну роботу на дисплей
  }                                                                                     // завершення умовного блоку перевірки підключення
  delay(1200);                                                                          // пауза для ознайомлення користувача зі статусом мережі
}                                                                                       // завершення виконання підпрограми підключення до мережі

void readSensors() {                                                                    // функція опитування апаратних вимірювальних перетворювачів
  digitalWrite(TRIG_PIN, LOW);                                                          // встановлення початкового низького рівня на виводі пуску
  delayMicroseconds(2);                                                                 // мікросекундна пауза для гарантованого формування фронту
  digitalWrite(TRIG_PIN, HIGH);                                                         // подача високого рівня сигналу генерації зондувального ультразвуку
  delayMicroseconds(10);                                                                // формування імпульсу запуску тривалістю десять мікросекунд
  digitalWrite(TRIG_PIN, LOW);                                                          // повернення лінії запуску імпульсу в низький стан
  long duration = pulseIn(ECHO_PIN, HIGH, 26000);                                       // очікування та вимірювання тривалості сигналу відбитої хвилі
  if (duration == 0) {                                                                  // перевірка випадку неотримання відповіді відлуння сенсора
    distance = 400.0;                                                                   // присвоєння граничної максимальної вимірюваної відстані
  } else {                                                                              // випадок успішного прийому відбитої ультразвукової хвилі
    distance = (float)duration * 0.0343 / 2.0;                                          // розрахунок відстані в сантиметрах за формулою швидкості звуку
    if (distance > 400.0) distance = 400.0;                                             // відсікання значень що виходять за фізичні межі сенсора
  }                                                                                     // завершення блоку розрахунку дистанції далекоміра
  if (gps.location.isValid()) {                                                         // перевірка коректності та достовірності супутникових даних
    latitude = gps.location.lat();                                                      // збереження поточної координати географічної широти
    longitude = gps.location.lng();                                                     // збереження оновленої координати географічної довготи
  }                                                                                     // завершення перевірки координат геопозиціонування
  if (gps.speed.isValid()) {                                                            // перевірка актуальності показника швидкості від супутника
    speed = gps.speed.kmph();                                                           // зчитування швидкості автомобіля в кілометрах на годину
  } else {                                                                              // робота програмного генератора реалістичного профілю швидкості
    static unsigned long lastSimStep = 0;                                               // таймер перемикання кроків симуляції дорожнього циклу
    static int simPhase = 0;                                                            // індекс поточної активної фази імітаційного графіка руху
    if (millis() - lastSimStep > 2200) {                                                // перевірка інтервалу зміни поточної фази руху
      simPhase = (simPhase + 1) % 8;                                                    // циклічний перехід до наступного швидкісного етапу
      lastSimStep = millis();                                                           // оновлення часової мітки моменту перемикання етапу
    }                                                                                   // завершення блоку таймера зміни етапу симуляції
    switch (simPhase) {                                                                 // вибір значення швидкості відповідно до поточної фази циклу
      case 0: speed = 0.0; break;                                                       // імітація повної зупинки транспорту перед світлофором
      case 1: speed = 25.0; break;                                                      // плавний розгін та початок руху в щільному міському потоці
      case 2: speed = 58.0; break;                                                      // оптимальний розмірений швидкісний режим міської магістралі
      case 3: speed = 64.0; break;                                                      // динамічне прискорення в межах дозволеного міського ліміту
      case 4: speed = 96.0; break;                                                      // рух на високій швидкості по заміському шосе
      case 5: speed = 72.0; break;                                                      // комфортний крейсерський екологічний темп їзди трасою
      case 6: speed = 40.0; break;                                                      // поступове плавне сповільнення перед дорожнім перехрестям
      case 7: speed = 10.0; break;                                                      // повільне підкочування під час паркувального маневру
    }                                                                                   // завершення вибору швидкості для поточної фази
  }                                                                                     // завершення блоку програмного розрахунку швидкості
  tripDistance += (speed / 3600.0) * 0.3;                                               // інтегрування швидкості для нарощування сумарного кілометражу
}                                                                                       // завершення тіла функції опитування сенсорів

void parkingSensor() {                                                                  // функція звукового супроводу наближення до перешкод
  static unsigned long lastBeep = 0;                                                    // таймер збереження моменту попереднього звукового сигналу
  static bool buzzerActive = false;                                                     // прапорець активного стану звукового випромінювача
  unsigned long now = millis();                                                         // збереження поточного системного часу в мілісекундах
  if (distance < 30.0) {                                                                // перевірка попадання в зону критичної небезпеки зіткнення
    if (now - lastBeep > 140) {                                                         // генерація максимально частих тривожних імпульсів
      ledcWriteTone(0, 2500);                                                           // подача високого тону частотою дві з половиною тисячі герц
      buzzerActive = true;                                                              // встановлення ознаки подачі звукового сигналу
      lastBeep = now;                                                                   // оновлення мітки часу поданого звукового імпульсу
    } else if (buzzerActive && now - lastBeep > 80) {                                   // перевірка завершення тривалості короткого звукового імпульсу
      ledcWriteTone(0, 0);                                                              // вимкнення генерації тону після завершення імпульсу
      buzzerActive = false;                                                             // скидання прапорця активності звукового сигналу
    }                                                                                   // завершення блоку імпульсу критичної зони
  } else if (distance < 60.0) {                                                         // перевірка середньої дистанції підвищеної уваги
    if (now - lastBeep > 280) {                                                         // генерація попереджувальних імпульсів середньої частоти
      ledcWriteTone(0, 2000);                                                           // подача звукового тону частотою дві тисячі герц
      buzzerActive = true;                                                              // фіксація активності звукового сигналу
      lastBeep = now;                                                                   // збереження часу випромінювання звукового імпульсу
    } else if (buzzerActive && now - lastBeep > 100) {                                  // перевірка завершення звучання середнього імпульсу
      ledcWriteTone(0, 0);                                                              // вимкнення звукового сигналу після імпульсу
      buzzerActive = false;                                                             // скидання ознаки активності звуку
    }                                                                                   // завершення блоку імпульсу середньої зони
  } else if (distance < 100.0) {                                                        // перевірка далекої зони виявлення перешкоди
    if (now - lastBeep > 550) {                                                         // генерація рідкісних орієнтовних звукових клацань
      ledcWriteTone(0, 1500);                                                           // подача м'якого тону частотою півтори тисячі герц
      buzzerActive = true;                                                              // збереження ознаки відтворення звуку
      lastBeep = now;                                                                   // фіксація моменту подачі сигналу далекої зони
    } else if (buzzerActive && now - lastBeep > 120) {                                  // перевірка завершення звучання далекого імпульсу
      ledcWriteTone(0, 0);                                                              // припинення подачі тону далекої зони
      buzzerActive = false;                                                             // скидання статусу активності звуку
    }                                                                                   // завершення блоку імпульсу далекої зони
  } else {                                                                              // зона абсолютної безпеки понад сто сантиметрів
    if (buzzerActive) {                                                                 // перевірка необхідності одноразового вимкнення звуку
      ledcWriteTone(0, 0);                                                              // повне вимкнення звуку за відсутності перешкоди
      buzzerActive = false;                                                             // скидання прапорця активності звукового сигналу
    }                                                                                   // завершення блоку одноразового вимкнення
  }                                                                                     // завершення логіки багаторівневого звукового парктроніка
}                                                                                       // завершення тіла функції звукового парктроніка

void printStatusRow(const char *k1, const char *v1, const char *k2, const char *v2) {   // допоміжна функція форматованого друку рядка таблиці
  char row[96];                                                                         // буфер для формування вирівняного рядка таблиці
  snprintf(row, sizeof(row), "%-14s %-12s   %-14s %s", k1, v1, k2, v2);                 // форматування колонок таблиці телеметрії
  Serial.println(row);                                                                  // виведення сформованого рядка таблиці в консоль
}                                                                                       // завершення тіла функції виведення рядка таблиці

void printConsoleStatus() {                                                             // функція форматування та виведення звіту телеметрії в термінал
  char val1[16];                                                                        // буфер для збереження текстового представлення першого показника
  char val2[32];                                                                        // буфер для форматованого запису другого виміряного показника
  Serial.println();                                                                     // друк порожнього рядка для візуального відділення блоків інформації
  Serial.println("SYSTEM TELEMETRY");                                                   // виведення головного заголовка телеметричного звіту
  Serial.println();                                                                     // виведення порожнього рядка перед таблицею параметрів
  snprintf(val1, sizeof(val1), "%4.1f km/h", speed);                                    // форматування поточної швидкості
  float curAccel = aiAdvisor.getAcceleration();                                         // отримання поточної величини прискорення
  snprintf(val2, sizeof(val2), "%4.1f km/h/s", curAccel);                               // форматування розгону
  printStatusRow("Speed:", val1, "Accel:", val2);                                       // виведення сформованого рядка швидкості та прискорення
  snprintf(val1, sizeof(val1), "%d cm", (int)distance);                                 // форматування виміряної дистанції
  const char* obsStr = "SAFE";                                                          // базовий текстовий статус безпечного оточення
  if (distance < 30.0) obsStr = "STOP! CRITICAL";                                       // статус критичного наближення
  else if (distance < 60.0) obsStr = "WARNING";                                         // статус небезпечного зближення
  else if (distance < 100.0) obsStr = "CAUTION";                                        // статус попередження про перешкоду
  printStatusRow("Distance:", val1, "Obstacle:", obsStr);                               // виведення дистанції та попередження про перешкоду
  snprintf(val1, sizeof(val1), "%d%%", (int)aiAdvisor.getEcoScore());                   // форматування балу екології
  const char *driveState = aiAdvisor.getStateName();                                    // отримання текстового найменування стану водіння
  printStatusRow("AI Eco-Score:", val1, "Drive State:", driveState);                    // виведення оцінки водіння та стану асистента
  snprintf(val1, sizeof(val1), "%4.2f km", tripDistance);                               // форматування накопиченого пробігу
  const char *wfStr = wifiConnected ? "ONLINE" : "OFFLINE";                             // текстовий статус з єднання з бездротовою мережею
  const char *gpsStr = gps.location.isValid() ? "FIX" : "SIM";                          // текстовий статус фіксації супутникового сигналу
  snprintf(val2, sizeof(val2), "WiFi: %s | GPS: %s", wfStr, gpsStr);                    // форматування комбінованого мережевого статусу
  printStatusRow("Trip:", val1, "Network:", val2);                                      // виведення показників пробігу та стану зв язку
  unsigned long timeSinceCloud = millis() - lastThingSpeakUpdate;                       // розрахунок часу що минув від останньої відправки
  int secondsLeft = (THINGSPEAK_INTERVAL - timeSinceCloud) / 1000;                      // розрахунок кількості секунд до нової відправки
  if (secondsLeft < 0) secondsLeft = 0;                                                 // запобігання відображенню від'ємного часу
  snprintf(val1, sizeof(val1), "in %ds", secondsLeft);                                  // форматування зворотного відліку
  printStatusRow("Cloud Sync:", val1, "Server:", "ThingSpeak IoT");                     // виведення статусу хмарної синхронізації
  Serial.println();                                                                     // виведення порожнього рядка для розділення інформаційних блоків
  Serial.println("AI Driving Advice:");                                                 // заголовок секції порад інтелектуального помічника
  Serial.println(aiAdvisor.getAdvice());                                                // виведення актуального тексту підказки водієві
  Serial.println();                                                                     // завершальний порожній рядок блоку звіту телеметрії
}                                                                                       // завершення тіла функції виведення статусу в консоль

void drawDashboardLayout() {                                                            // функція малювання статичних графічних елементів панелі
  tft.fillScreen(ILI9341_BLACK);                                                        // очищення всієї площі екрана суцільним чорним кольором
  tft.fillRect(0, 0, 320, 24, 0x10A2);                                                  // створення верхньої декоративної плашки заголовка
  tft.setTextColor(ILI9341_CYAN);                                                       // вибір яскравого бірюзового кольору шрифту для шапки
  tft.setTextSize(2);                                                                   // встановлення середнього кегля шрифту заголовка екрана
  tft.setCursor(8, 4);                                                                  // встановлення координат текстового покажчика верхнього рядка
  tft.print("AI CAR MONITOR");                                                          // друк назви програмного комплексу в шапці дисплея
  tft.drawFastHLine(0, 24, 320, ILI9341_DARKCYAN);                                      // малювання тонкої горизонтальної роздільної лінії під шапкою
  tft.drawRoundRect(4, 28, 100, 78, 6, ILI9341_WHITE);                                  // побудова прямокутного контуру віджета спідометра
  tft.drawRoundRect(110, 28, 100, 78, 6, ILI9341_WHITE);                                // малювання рамки блоку оцінки екологічності водіння
  tft.drawRoundRect(216, 28, 100, 78, 6, ILI9341_WHITE);                                // створення контуру віджета вимірювача дистанції далекоміра
  tft.setTextSize(1);                                                                   // перехід на базовий шрифт для заголовків віджетів
  tft.setTextColor(ILI9341_LIGHTGREY);                                                  // сірий спокійний колір для службових підписів даних
  tft.setCursor(14, 34);                                                                // встановлення позиції для назви блоку швидкості
  tft.print("SPEED (KM/H)");                                                            // виведення заголовка та одиниць вимірювання швидкості
  tft.setCursor(120, 34);                                                               // встановлення позиції курсора для блоку екології
  tft.print("ECO-SCORE");                                                               // виведення напису рейтингу акуратності водія
  tft.setCursor(224, 34);                                                               // позиціонування курсора для назви блоку далекоміра
  tft.print("OBSTACLE (CM)");                                                           // друк назви параметра відстані до перешкоди
  tft.drawRoundRect(4, 110, 312, 40, 6, ILI9341_DARKGREY);                              // малювання рамки для блоку зведеної поїздки та координат
  tft.drawRoundRect(4, 154, 312, 78, 6, 0x03EF);                                        // побудова широкої рамки картки інтелектуальних рекомендацій
  tft.fillRect(6, 156, 308, 18, 0x0210);                                                // заливка темного заголовного фону блоку порад асистента
  tft.setTextColor(ILI9341_CYAN);                                                       // вибір бірюзового кольору для маркування картки асистента
  tft.setCursor(10, 161);                                                               // встановлення курсора на позицію підпису інтелекту
  tft.print("EDGE AI ECO-DRIVE ADVISOR");                                               // виведення найменування модуля аналізу стилю керування
}                                                                                       // завершення процедури побудови інтерфейсу приладової дошки

void updateDashboardValues() {                                                          // функція динамічного оновлення показників датчиків на екрані
  tft.fillRect(200, 4, 114, 16, 0x10A2);                                                // очищення прямокутної області статусу мережі у шапці
  tft.setTextSize(1);                                                                   // вибір компактного кегля шрифту для індикації зв'язку
  tft.setCursor(205, 8);                                                                // встановлення координат позиціонування статусу інтернету
  if (wifiConnected) {                                                                  // перевірка наявності підключення до бездротової мережі зв'язку
    tft.setTextColor(ILI9341_GREEN);                                                    // вибір зеленого кольору шрифту для активного з'єднання
    tft.print("WiFi: ONLINE");                                                          // виведення повідомлення про активну роботу хмарної передачі
  } else {                                                                              // випадок відсутності бездротового з'єднання з мережею
    tft.setTextColor(ILI9341_RED);                                                      // вибір червоного кольору для індикації автономного режиму
    tft.print("WiFi: OFFLINE");                                                         // сповіщення про локальний режим роботи без інтернету
  }                                                                                     // завершення блоку виведення мережевого стану
  tft.fillRect(10, 52, 88, 48, ILI9341_BLACK);                                          // очищення поля виведення цифрового значення швидкості
  tft.setTextSize(4);                                                                   // перехід на великий шрифт для швидкого сприйняття швидкості
  if (speed > 90.0) {                                                                   // перевірка перевищення встановленого швидкісного ліміту
    tft.setTextColor(ILI9341_RED);                                                      // червоний колір для позначення небезпечного перевищення
  } else if (speed > 80.0 || (speed < 20.0 && speed > 0.0)) {                           // перевірка наближення до ліміту або занадто повільного руху
    tft.setTextColor(ILI9341_YELLOW);                                                   // жовтий колір для привернення уваги водія на дорозі
  } else {                                                                              // безпечний діапазон оптимальної швидкості транспортного засобу
    tft.setTextColor(ILI9341_GREEN);                                                    // зелений колір безпечного та екологічного темпу руху
  }                                                                                     // завершення блоку вибору кольорової індикації швидкості
  tft.setCursor(14, 56);                                                                // встановлення курсора для виведення цілого числа швидкості
  tft.print((int)speed);                                                                // друк розрахованої швидкості автомобіля на панелі
  tft.fillRect(116, 52, 88, 48, ILI9341_BLACK);                                         // стирання попередніх даних блоку оцінки водіння
  float currentScore = aiAdvisor.getEcoScore();                                         // зчитування поточного значення накопиченого рейтингу водія
  if (currentScore < 50.0f) {                                                           // перевірка незадовільного рівня оцінки стилю водіння
    tft.setTextColor(ILI9341_RED);                                                      // червоний колір низького балу екологічності водіння
  } else if (currentScore < 80.0f) {                                                    // перевірка помірного рівня оцінки економічності руху
    tft.setTextColor(ILI9341_YELLOW);                                                   // жовтий колір середнього показника збереження ресурсів
  } else {                                                                              // відмінний рівень екологічного та плавного керування
    tft.setTextColor(ILI9341_GREEN);                                                    // зелений колір зразкового стилю керування автомобілем
  }                                                                                     // завершення вибору колірної шкали рейтингу водія
  tft.setTextSize(4);                                                                   // великий розмір символів для швидкого сприйняття рейтингу
  tft.setCursor(120, 56);                                                               // встановлення координат текстового курсора для балів
  tft.print((int)currentScore);                                                         // виведення цілого значення відсотка оцінки на дисплей
  tft.fillRect(222, 52, 88, 48, ILI9341_BLACK);                                         // очищення вікна відображення показників парктроніка
  if (distance < 35.0) {                                                                // перевірка небезпечної дистанції парктроніка для вибору кольору
    tft.setTextColor(ILI9341_RED);                                                      // червоний сигнал тривоги при критичному зближенні
  } else if (distance < 70.0) {                                                         // перевірка наближення до перешкоди для жовтого кольору індикації
    tft.setTextColor(ILI9341_YELLOW);                                                   // жовтий сигнал попередження про помірну дистанцію
  } else {                                                                              // зона безпечної відстані до найближчого об'єкта
    tft.setTextColor(ILI9341_GREEN);                                                    // зелений колір безпечного простору для маневрування
  }                                                                                     // завершення аналізу колірної індикації далекоміра
  tft.setTextSize(4);                                                                   // вибір великого масштабу шрифту для мітки дистанції
  tft.setCursor(226, 56);                                                               // встановлення початкових координат виведення сантиметрів
  if (distance >= 350.0) {                                                              // перевірка виходу дистанції за межі надійного виявлення
    tft.print(">3m");                                                                   // індикація вільного простору понад три метри
  } else {                                                                              // випадок знаходження об'єкта в зоні прямої видимості сенсора
    tft.print((int)distance);                                                           // виведення цілого значення відстані в сантиметрах
  }                                                                                     // завершення виведення інформації про дистанцію
  tft.fillRect(10, 116, 300, 28, ILI9341_BLACK);                                        // очищення інформаційного рядка пробігу та координат
  tft.setTextSize(1);                                                                   // встановлення стандартного розміру системного шрифту
  tft.setTextColor(ILI9341_WHITE);                                                      // контрастний білий колір для технічних параметрів
  tft.setCursor(14, 120);                                                               // позиціонування курсора для першого рядка навігаційних даних
  tft.print("Trip: ");                                                                  // друк мітки накопиченого кілометражу поїздки
  tft.print(tripDistance, 2);                                                           // виведення значення пройденого шляху з двома знаками дробу
  tft.print(" km | Accel: ");                                                           // друк роздільника та префікса розрахованого прискорення
  float currentAccel = aiAdvisor.getAcceleration();                                     // отримання актуального динамічного прискорення
  if (currentAccel > 0.1) tft.print("+");                                               // друк знака плюс для позитивного розгону машини
  tft.print(currentAccel, 1);                                                           // відображення величини прискорення з точністю десятих
  tft.print(" m/s2");                                                                   // друк одиниці вимірювання фізичного прискорення
  tft.setCursor(14, 134);                                                               // перехід на другий інформаційний рядок для виведення GPS
  tft.print("GPS: ");                                                                   // виведення заголовка блоку супутникових координат
  if (gps.location.isValid()) {                                                         // перевірка достовірності отриманого сигналу супутників
    tft.print(latitude, 4);                                                             // виведення координати широти з чотирма знаками дробу
    tft.print(", ");                                                                    // розділовий символ між координатами широти та довготи
    tft.print(longitude, 4);                                                            // друк довготи поточного положення на місцевості
  } else {                                                                              // випадок відсутності фіксації супутникового сигналу
    tft.setTextColor(ILI9341_ORANGE);                                                   // помаранчевий колір попередження про пошук супутників
    tft.print("Acquiring Satellites... Sim Active");                                    // повідомлення про процес синхронізації супутників
  }                                                                                     // завершення блоку відображення координат супутника
}                                                                                       // завершення процедури динамічного оновлення екрана

void drawAiAdviceCard() {                                                               // функція відмальовування картки з рекомендацією водієві на екрані
  tft.fillRect(6, 178, 308, 52, ILI9341_BLACK);                                         // стирання попереднього тексту поради всередині рамки
  tft.setTextSize(1);                                                                   // вибір звичайного масштабу шрифту для читання підказки
  DriveState state = aiAdvisor.getState();                                              // зчитування поточного машинного стану динаміки авто
  switch (state) {                                                                      // вибір індикаторного кольору відповідно до рівня загрози
    case DRIVE_HARSH_ACCEL:                                                             // різкий набір швидкості водієм на ділянці
    case DRIVE_HARSH_BRAKE:                                                             // різке аварійне гальмування автомобіля
      tft.setTextColor(ILI9341_YELLOW);                                                 // жовтий колір попередження про неекологічну дію
      break;                                                                            // вихід з блоку оператора вибору кольору
    case DRIVE_TAILGATING:                                                              // небезпечне зближення з попереднім автомобілем
    case DRIVE_HIGH_SPEED:                                                              // перевищення безпечного ліміту швидкості
      tft.setTextColor(ILI9341_RED);                                                    // червоний колір критичної небезпеки та ризику
      break;                                                                            // вихід з блоку оператора вибору кольору
    case DRIVE_IDLING:                                                                  // тривала робота двигуна без руху автомобіля
      tft.setTextColor(ILI9341_ORANGE);                                                 // помаранчевий колір попередження про перевитрату пального
      break;                                                                            // вихід з блоку оператора вибору кольору
    case DRIVE_OPTIMAL_ECO:                                                             // зразкове плавне керування транспортним засобом
    default:                                                                            // базовий оптимальний режим руху за замовчуванням
      tft.setTextColor(ILI9341_GREEN);                                                  // зелений колір схвалення стилю керування
      break;                                                                            // вихід з блоку оператора вибору кольору
  }                                                                                     // завершення процедури вибору кольору картки
  tft.setCursor(12, 180);                                                               // встановлення початкових координат виведення статусу
  tft.print("STATUS: ");                                                                // текстовий префікс виведення режиму роботи асистента
  tft.println(aiAdvisor.getStateName());                                                // друк назви зафіксованого динамічного стану
  tft.setTextColor(ILI9341_WHITE);                                                      // білий колір для основного тексту рекомендації
  String text = aiAdvisor.getAdvice();                                                  // отримання сформованого тексту поради від помічника
  int curY = 196;                                                                       // початкова вертикальна координата для виведення тексту
  int startIdx = 0;                                                                     // індекс початку поточної виділеної частини рядка
  while (startIdx < text.length() && curY < 225) {                                      // цикл розбиття тексту поради на рядки за розміром картки
    int lineLen = 38;                                                                   // максимальна місткість символів в одному екранному рядку
    if (startIdx + lineLen >= text.length()) {                                          // перевірка чи вміщується залишок текстового повідомлення
      lineLen = text.length() - startIdx;                                               // призначення довжини за фактичною кількістю символів
    } else {                                                                            // пошук позиції пробілу для виключення розриву слів
      int spaceIdx = text.lastIndexOf(' ', startIdx + lineLen);                         // пошук останнього пробілу перед межею рядка
      if (spaceIdx > startIdx) {                                                        // перевірка знаходження коректного роздільника слів
        lineLen = spaceIdx - startIdx;                                                  // корекція довжини для уникнення розриву слова
      }                                                                                 // завершення корекції довжини рядка по слову
    }                                                                                   // завершення розрахунку довжини поточного рядка
    String line = text.substring(startIdx, startIdx + lineLen);                         // вирізання чергового рядка відформатованого тексту
    line.trim();                                                                        // видалення зайвих пробільних символів на початку та в кінці фрагмента
    tft.setCursor(12, curY);                                                            // встановлення координат для друку поточного рядка на дисплеї
    tft.print(line);                                                                    // виведення відформатованого рядка рекомендації водієві на екран
    startIdx += lineLen;                                                                // переміщення вказівника на наступну частину вхідного тексту
    if (startIdx < text.length() && text.charAt(startIdx) == ' ') startIdx++;           // пропуск пробілу перед наступним словом
    curY += 16;                                                                         // збільшення координати висоти для переходу на наступний рядок
  }                                                                                     // завершення циклу переносу слів повідомлення
}                                                                                       // завершення тіла функції формування картки порад помічника

void sendToThingSpeak() {                                                               // функція відправки зібраної телеметрії на хмарний сервер
  if (WiFi.status() != WL_CONNECTED) {                                                  // перевірка активного підключення до бездротової мережі
    wifiConnected = false;                                                              // скидання прапорця наявності зв'язку
    Serial.println("[ThingSpeak] WiFi disconnected, reconnecting...");                  // повідомлення про спробу повторного підключення
    WiFi.reconnect();                                                                   // ініціалізація процедури повторного підключення до мережі
    return;                                                                             // вихід якщо відсутнє з'єднання з бездротовою мережею
  }                                                                                     // закриття блоку перевірки підключення до мережі
  wifiConnected = true;                                                                 // підтвердження активного статусу підключення до інтернету
  HTTPClient http;                                                                      // створення локального екземпляра клієнта мережевих запитів
  String url = String(thingSpeakServer) + "?api_key=" + apiKey;                         // формування адреси запиту
  url += "&field1=" + String(speed, 1);                                                 // додавання значення поточної швидкості автомобіля
  url += "&field2=" + String(distance, 0);                                              // додавання виміряної дистанції до перешкоди
  url += "&field3=" + String(aiAdvisor.getEcoScore(), 1);                               // додавання балу стилю водіння
  url += "&field4=" + String(tripDistance, 2);                                          // додавання накопиченого кілометражу поїздки
  url += "&field5=" + String(latitude, 6);                                              // додавання географічної широти автомобіля
  url += "&field6=" + String(longitude, 6);                                             // додавання географічної довготи автомобіля
  Serial.println();                                                                     // виведення порожнього рядка для естетичного оформлення виведення
  Serial.println("[ThingSpeak] Uploading telemetry to cloud...");                       // повідомлення про відправку
  http.setTimeout(12000);                                                               // встановлення максимального часу очікування дванадцять секунд
  if (http.begin(url)) {                                                                // ініціалізація мережевого запиту за прямою веб адресою
    int httpCode = http.GET();                                                          // виконання мережевого запиту передачі телеметричних параметрів
    if (httpCode == 200) {                                                              // перевірка успішного коду прийняття пакета сервером
      String resp = http.getString();                                                   // зчитування номера створеного запису у каналі сервісу
      Serial.println("[ThingSpeak] Cloud update success! Entry #" + resp);              // підтвердження успішного завантаження даних
    } else if (httpCode > 0) {                                                          // обробка числових кодів помилок відповіді від сервера
      Serial.println("[ThingSpeak] HTTP Code: " + String(httpCode));                    // виведення числового коду помилки сервера
    } else {                                                                            // випадок збою мережевого з'єднання або таймауту
      Serial.println("[ThingSpeak] Connection: " + http.errorToString(httpCode));       // виведення розшифрованого текстового опису помилки
    }                                                                                   // завершення аналізу коду помилки
    http.end();                                                                         // закриття поточного сеансу та звільнення задіяних системних ресурсів
  } else {                                                                              // випадок неможливості ініціалізації клієнта
    Serial.println("[ThingSpeak] Failed to connect to server.");                        // сповіщення про неможливість відкриття з'єднання
  }                                                                                     // закриття блоку помилки ініціалізації
  Serial.println();                                                                     // виведення фінального порожнього рядка після циклу синхронізації
}                                                                                       // завершення тіла функції вивантаження телеметрії на хмарний сервер