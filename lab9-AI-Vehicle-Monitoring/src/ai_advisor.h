#ifndef AI_ADVISOR_H                                                                    // директива захисту від повторного включення заголовка
#define AI_ADVISOR_H                                                                    // визначення унікального макросу заголовкового файлу
#include <Arduino.h>                                                                    // підключення базової бібліотеки фреймворку Ардуіно

enum DriveState {                                                                       // перелік можливих динамічних станів руху транспортного засобу
  DRIVE_OPTIMAL_ECO,                                                                    // стан оптимального екологічного та плавного водіння
  DRIVE_HARSH_ACCEL,                                                                    // стан зафіксованого різкого прискорення автомобіля
  DRIVE_HARSH_BRAKE,                                                                    // стан зафіксованого різкого екстреного гальмування
  DRIVE_TAILGATING,                                                                     // стан небезпечного зближення з попереднім авто на швидкості
  DRIVE_HIGH_SPEED,                                                                     // стан руху з перевищенням швидкості понад дев'яносто кілометрів на годину
  DRIVE_IDLING                                                                          // стан тривалого простою автомобіля з увімкненим двигуном
};                                                                                      // завершення оголошення переліку станів водіння

class AiEcoAdvisor {                                                                    // оголошення класу інтелектуального асистента водія
private:                                                                                // секція приватних змінних та внутрішніх методів класу
  float ecoScore;                                                                       // поточний бал економічності та стилю керування у відсотках
  float prevSpeed;                                                                      // значення швидкості автомобіля на попередній ітерації опитування
  float acceleration;                                                                   // поточне розраховане прискорення або сповільнення машини
  unsigned long lastSpeedTime;                                                          // часова мітка останнього вимірювання швидкості
  unsigned long idleStartTime;                                                          // часова мітка моменту початку зупинки автомобіля
  unsigned long lastAdviceTime;                                                         // часова мітка останньої генерації поради водієві
  DriveState currentDriveState;                                                         // поточний активний стан динаміки водіння
  String advice;                                                                        // текстове повідомлення з порадою асистента для відображення
public:                                                                                 // секція публічних методів для виклику з головної програми
  AiEcoAdvisor() {                                                                      // конструктор за замовчуванням для ініціалізації об'єкта
    ecoScore = 95.0f;                                                                   // встановлення базового початкового балу економічності
    prevSpeed = 0.0f;                                                                   // скидання попередньої швидкості до нульового значення
    acceleration = 0.0f;                                                                // скидання початкового прискорення до нуля
    lastSpeedTime = 0;                                                                  // ініціалізація часу останнього вимірювання швидкості
    idleStartTime = 0;                                                                  // скидання таймера простою на холостому ходу
    lastAdviceTime = 0;                                                                 // скидання таймера останньої згенерованої поради
    currentDriveState = DRIVE_OPTIMAL_ECO;                                              // встановлення початкового оптимального стану
    advice = "AI: Drive smoothly to optimize fuel consumption.";                        // базовий текст поради
  }                                                                                     // завершення тіла конструктора класу

  void begin() {                                                                        // метод запуску та початкової ініціалізації системи оцінки
    ecoScore = 95.0f;                                                                   // встановлення стартової оцінки екологічності водія
    prevSpeed = 0.0f;                                                                   // обнулення показника попередньої швидкості
    acceleration = 0.0f;                                                                // встановлення нульового значення прискорення
    lastSpeedTime = millis();                                                           // фіксація поточного часу старту вимірювання швидкості
    idleStartTime = 0;                                                                  // скидання початкового часу роботи на холостих обертах
    lastAdviceTime = millis();                                                          // фіксація часу першого формування поради
    currentDriveState = DRIVE_OPTIMAL_ECO;                                              // призначення оптимального стану руху
    advice = "AI: System ready. Drive smoothly for eco score.";                         // текст готовності системи
  }                                                                                     // завершення тіла методу ініціалізації

  void processTelemetry(float speed, float distance) {                                  // метод аналізу вхідної телеметрії
    unsigned long now = millis();                                                       // отримання поточної кількості мілісекунд від запуску
    float dt = (now - lastSpeedTime) / 1000.0f;                                         // розрахунок часового проміжку в секундах
    if (dt < 0.25f) return;                                                             // вихід якщо з моменту попереднього розрахунку минуло замало часу
    acceleration = (speed - prevSpeed) / dt;                                            // математичний розрахунок поточного прискорення
    prevSpeed = speed;                                                                  // збереження поточної швидкості для наступного кроку
    lastSpeedTime = now;                                                                // збереження часу поточного розрахунку динаміки
    DriveState newState = DRIVE_OPTIMAL_ECO;                                            // початкове припущення нового стану
    if (distance < 50.0f && speed > 15.0f) {                                            // перевірка небезпечного зближення на швидкості
      newState = DRIVE_TAILGATING;                                                      // фіксація стану небезпечної дистанції
      ecoScore -= 4.0f;                                                                 // зменшення балу економічності за створення небезпеки
    }                                                                                   // завершення блоку перевірки дистанції
    else if (acceleration > 10.0f) {                                                    // перевірка наявності надмірно різкого розгону
      newState = DRIVE_HARSH_ACCEL;                                                     // фіксація стану агресивного прискорення
      ecoScore -= 5.0f;                                                                 // штрафне зниження балу за перевитрату палива при розгоні
    }                                                                                   // завершення блоку перевірки різкого прискорення
    else if (acceleration < -14.0f) {                                                   // перевірка виявлення екстреного гальмування
      newState = DRIVE_HARSH_BRAKE;                                                     // фіксація стану різкого гальмування
      ecoScore -= 4.5f;                                                                 // штрафне зниження балу за неплавне уповільнення
    }                                                                                   // завершення блоку перевірки різкого гальмування
    else if (speed > 90.0f) {                                                           // перевірка руху на підвищеній неекономічній швидкості
      newState = DRIVE_HIGH_SPEED;                                                      // фіксація стану руху на високій швидкості
      ecoScore -= 1.5f;                                                                 // штрафне зниження балу за високий аеродинамічний опір
    }                                                                                   // завершення блоку перевірки високої швидкості
    else if (speed < 1.0f) {                                                            // перевірка повної зупинки або стоянки машини
      if (idleStartTime == 0) idleStartTime = now;                                      // засікання часу початку нерухомого стану
      if (now - idleStartTime > 15000) {                                                // перевірка чи триває зупинка понад п'ятнадцять секунд
        newState = DRIVE_IDLING;                                                        // фіксація стану тривалого простою двигуна
        ecoScore -= 1.0f;                                                               // поступове зниження балу за роботу двигуна без руху
      }                                                                                 // завершення блоку перевірки тривалості простою
    }                                                                                   // завершення блоку перевірки зупинки
    else {                                                                              // гілка обробки нормального стабільного руху автомобіля
      idleStartTime = 0;                                                                // скидання лічильника простою під час активного руху
      newState = DRIVE_OPTIMAL_ECO;                                                     // призначення оптимального режиму керування
      if (speed >= 45.0f && speed <= 80.0f && distance > 100.0f) {                      // умови ідеальної їзди
        ecoScore += 0.6f;                                                               // заохочувальне нарахування балів за зразкове водіння
      }                                                                                 // завершення блоку нарахування заохочення
    }                                                                                   // завершення гілки стандартного руху
    ecoScore = constrain(ecoScore, 10.0f, 100.0f);                                      // обмеження оцінки в межах від десяти до ста
    if (newState != currentDriveState) {                                                // перевірка зміни динамічного стану автомобіля
      currentDriveState = newState;                                                     // оновлення поточного стану на нововизначений
      updateAdvice(speed, distance);                                                    // виклик оновлення тексту поради відповідно до змін
    }                                                                                   // завершення блоку обробки зміни стану
  }                                                                                     // завершення тіла методу обробки телеметрії

  void updateAdvice(float speed, float distance) {                                      // метод формування змісту поради водієві
    switch (currentDriveState) {                                                        // вибір відповідного тексту згідно з поточним станом
      case DRIVE_TAILGATING:                                                            // варіант для небезпечного наближення до авто попереду
        advice = "AI: Tailgating! Keep safe distance to avoid harsh braking.";          // текст поради
        break;                                                                          // вихід з оператора вибору
      case DRIVE_HARSH_ACCEL:                                                           // варіант для зафіксованого агресивного прискорення
        advice = "AI: Harsh acceleration! Smooth throttle saves 15% fuel.";             // текст поради
        break;                                                                          // вихід з оператора вибору
      case DRIVE_HARSH_BRAKE:                                                           // варіант для виявленого різкого екстреного гальмування
        advice = "AI: Harsh braking! Anticipate traffic to coast smoothly.";            // текст поради
        break;                                                                          // вихід з оператора вибору
      case DRIVE_HIGH_SPEED:                                                            // варіант для руху на високій швидкості понад ліміт
        advice = "AI: High speed >90km/h. Drag cuts MPG. Keep 70-80 km/h.";             // текст поради
        break;                                                                          // вихід з оператора вибору
      case DRIVE_IDLING:                                                                // варіант для тривалого холостого ходу без руху
        advice = "AI: Long idle detected. Turn off engine (Start-Stop).";               // текст поради
        break;                                                                          // вихід з оператора вибору
      case DRIVE_OPTIMAL_ECO:                                                           // варіант для зразкового екологічного водіння
      default:                                                                          // варіант за замовчуванням при звичайному русі
        if (ecoScore > 85.0f) {                                                         // перевірка високого рівня набраних балів водіння
          advice = "AI: Excellent eco-drive! Speed and distance optimal.";              // похвала водієві
        } else {                                                                        // гілка якщо бал нижчий за вісімдесят п'ять відсотків
          advice = "AI: Steady cruising. Keep gentle throttle to raise score.";         // підказка
        }                                                                               // завершення вибору поради для оптимального режиму
        break;                                                                          // вихід з оператора вибору
    }                                                                                   // завершення конструкції вибору станів
  }                                                                                     // завершення тіла методу оновлення порад
  float getEcoScore() const { return ecoScore; }                                        // метод повернення поточного балу стилю
  float getAcceleration() const { return acceleration; }                                // повернення розрахованого прискорення
  DriveState getState() const { return currentDriveState; }                             // метод отримання поточного стану
  String getAdvice() const { return advice; }                                           // метод отримання текстової поради асистента
  String getAdviceEN() const { return advice; }                                         // метод повернення поради англійською мовою
  const char* getStateName() const {                                                    // метод повернення текстової назви поточного стану
    switch (currentDriveState) {                                                        // вибір скороченої назви для виведення на екран та в консоль
      case DRIVE_HARSH_ACCEL: return "HARSH ACCEL";                                     // скорочена назва різкого розгону
      case DRIVE_HARSH_BRAKE: return "HARSH BRAKE";                                     // скорочена назва різкого гальмування
      case DRIVE_TAILGATING: return "TAILGATING ";                                      // скорочена назва небезпечної дистанції
      case DRIVE_HIGH_SPEED: return "HIGH SPEED ";                                      // скорочена назва небезпечної швидкості
      case DRIVE_IDLING: return "IDLE RUN   ";                                          // скорочена назва холостого ходу двигуна
      default: return "ECO OPTIMAL";                                                    // текстова назва оптимального екологічного водіння
    }                                                                                   // завершення блоку співставлення назв
  }                                                                                     // завершення методу отримання назви стану
};                                                                                      // завершення опису структури класу інтелектуального помічника
#endif                                                                                  // закриття директиви захисту від повторного підключення файлу