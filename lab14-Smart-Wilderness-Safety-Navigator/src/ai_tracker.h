#ifndef AI_TRACKER_H                                                                    // захист від повторного підключення заголовкового файлу
#define AI_TRACKER_H                                                                    // оголошення макросу заголовкового файлу модуля штучного інтелекту

#include <Arduino.h>                                                                    // підключення базового фреймворку з типами даних та функціями часу
#include <math.h>                                                                       // підключення математичної бібліотеки для тригонометричних розрахунків

const double EARTH_RADIUS_METERS = 6371000.0;                                           // радіус нашої планети у метрах для формули обчислення дистанції
const double STATIONARY_SPEED_THRESHOLD = 1.2;                                          // поріг швидкості у кілометрах за годину для фіксації зупинки
const double FAST_MOTION_SPEED_THRESHOLD = 6.0;                                         // поріг швидкості у кілометрах за годину для бігу або їзди транспортом
const double GPS_NOISE_JITTER_METERS = 3.5;                                             // радіус стаціонарного шуму антени для фільтрації дрейфу координат
const double SIGNIFICANT_MOVE_METERS = 5.0;                                             // мінімальна дистанція переміщення у метрах для запису нової точки логу
const uint32_t INACTIVITY_WARNING_SECONDS = 60;                                         // час нерухомості у секундах для переходу у статус спостереження
const uint32_t INACTIVITY_CRITICAL_SECONDS = 180;                                       // час нерухомості у секундах для фіксації підозри на травму

enum MotionActivity {                                                                   // перелік класифікованих станів фізичної активності мандрівника
  MOTION_STATIONARY = 0,                                                                // стан спокою або тривалого привалу без істотного руху
  MOTION_WALKING = 1,                                                                   // стан штатної пішої ходи гірською або лісовою стежкою
  MOTION_FAST_MOVING = 2                                                                // стан швидкого переміщення бігом або на транспортному засобі
};                                                                                      // завершення переліку станів фізичної активності

enum RiskGrade {                                                                        // рівні небезпеки поточного стану згідно з висновком штучного інтелекту
  RISK_MINIMAL = 0,                                                                     // мінімальний ризик у безпечній зоні базового табору
  RISK_ELEVATED = 1,                                                                    // помірний ризик під час руху відомим гірським маршрутом
  RISK_HAZARDOUS = 2,                                                                   // підвищений ризик через тривалу зупинку або складний рельєф
  RISK_CRITICAL = 3                                                                     // критичний рівень загрози життю через падіння або сигнал лиха
};                                                                                      // завершення переліку рівнів небезпеки

struct GeozoneProfile {                                                                 // структура опису географічної зони та притаманного їй рівня ризику
  double centerLat;                                                                     // географічна широта центральної точки зони
  double centerLon;                                                                     // довгота центральної точки контрольної зони
  double radiusMeters;                                                                  // радіус охоплення зони у метрах
  const char* title;                                                                    // текстова назва сектору для журналу подій та дайджесту
  float inherentRisk;                                                                   // коефіцієнт внутрішньої небезпеки зони від нуля до одиниці
  bool inside;                                                                          // прапорець перебування мандрівника всередині визначеного радіуса
};                                                                                      // завершення структури опису географічної зони

struct TrackerAnalytics {                                                               // структура результатів комплексного інженерного аналізу штучним інтелектом
  MotionActivity activity = MOTION_STATIONARY;                                          // поточний визначений стан активності мандрівника за замовчуванням
  RiskGrade riskGrade = RISK_MINIMAL;                                                   // підсумковий ступінь загрози безпеці туриста за замовчуванням
  float riskScorePercent = 0.0f;                                                        // числова оцінка ризику у відсотках від нуля до ста
  uint32_t stationaryDurationSec = 0;                                                   // тривалість поточної нерухомості мандрівника у секундах
  bool traumaSuspected = false;                                                         // прапорець виявлення аномальної знерухомленості як ймовірної травми
  uint32_t adaptiveIntervalMs = 8000;                                                   // розрахований адаптивний інтервал запису на накопичувач у мілісекундах
  const char* currentZoneName = "Base Camp Alpha";                                      // назва активної географічної зони знаходження мандрівника
  double smoothedSpeedKmh = 0.0;                                                        // згладжена швидкість руху після фільтрації стаціонарного шуму
  double totalDistanceMeters = 0.0;                                                     // загальна подолана дистанція за весь час поточної експедиції
};                                                                                      // завершення структури результатів аналізу

class ExpeditionAIEngine {                                                              // клас інтелектуального модуля фільтрації та оцінки ризиків маршруту
private:                                                                                // приватні змінні внутрішнього стану математичної моделі
  double prevLat;                                                                       // попередня збережена широта для фільтрації та приросту шляху
  double prevLon;                                                                       // попередня збережена довгота для фільтрації та приросту шляху
  double lastLoggedLat;                                                                 // широта останньої точки успішно записаної на картку пам'яті
  double lastLoggedLon;                                                                 // довгота останньої точки успішно записаної на картку пам'яті
  double cumulativeDistance;                                                            // накопичена сума пройденого шляху у метрах
  double filteredSpeedKmh;                                                              // експоненційно згладжена швидкість мандрівника
  uint32_t stationaryStartTime;                                                         // системний час початку періоду повної відсутності переміщення
  MotionActivity prevActivity;                                                          // попередній зафіксований стан фізичної активності туриста
  bool isInitialized;                                                                   // прапорець первинного захоплення координат та старту моделі
  GeozoneProfile geozones[3];                                                           // масив контрольних географічних секторів експедиційного маршруту

public:                                                                                 // публічні інженерні методи обробки телеметрії
  ExpeditionAIEngine() {                                                                // конструктор екземпляра інтелектуального рушія оцінки безпеки
    prevLat = 0.0;                                                                      // скидання початкової широти попереднього положення
    prevLon = 0.0;                                                                      // скидання початкової довготи попереднього положення
    lastLoggedLat = 0.0;                                                                // скидання широти останнього запису на зовнішній накопичувач
    lastLoggedLon = 0.0;                                                                // скидання довготи останнього запису на зовнішній накопичувач
    cumulativeDistance = 0.0;                                                           // початкова нульова сума пройденої дистанції
    filteredSpeedKmh = 0.0;                                                             // початкова нульова згладжена швидкість
    stationaryStartTime = 0;                                                            // скидання таймера спостереження за нерухомим станом
    prevActivity = MOTION_STATIONARY;                                                   // початковий стан спокою мандрівника у вихідній точці
    isInitialized = false;                                                              // початковий стан очікування супутникової фіксації
    geozones[0] = {50.4501, 30.5234, 70.0, "Base Camp Alpha", 0.05f, false};            // сектор базового табору з мінімальним рівнем ризику
    geozones[1] = {50.4515, 30.5245, 200.0, "Highland Ridge", 0.70f, false};            // гірський хребет помірної складності проходження
    geozones[2] = {50.4535, 30.5265, 300.0, "Hazard Canyon", 1.80f, false};             // небезпечна зона глибокої ущелини з високим ризиком травматизму
  }                                                                                     // завершення конструктора рушія аналізу телеметрії

  void begin() {                                                                        // метод старту та первинної ініціалізації таймерів штучного інтелекту
    stationaryStartTime = millis();                                                     // фіксація базового часу старту системи для обліку спокою
    prevActivity = MOTION_STATIONARY;                                                   // скидання попереднього стану руху на відпочинок
    isInitialized = false;                                                              // очікування першого достовірного пакету від супутників
  }                                                                                     // завершення методу ініціалізації рушія

  double calculateHaversineMeters(double lat1, double lon1, double lat2, double lon2) { // сферичний розрахунок дистанції між двома координатами на Землі
    double deltaLat = (lat2 - lat1) * PI / 180.0;                                       // переведення різниці широт у радіани
    double deltaLon = (lon2 - lon1) * PI / 180.0;                                       // переведення різниці довгот у радіани
    double radLat1 = lat1 * PI / 180.0;                                                 // переведення першої широти у радіани
    double radLat2 = lat2 * PI / 180.0;                                                 // переведення другої широти у радіани
    double sinHalfLat = sin(deltaLat / 2.0);                                            // половинний синус різниці широт для сферичної тригонометрії
    double sinHalfLon = sin(deltaLon / 2.0);                                            // половинний синус різниці довгот для сферичної тригонометрії
    double a = sinHalfLat * sinHalfLat +                                                // перша складова розрахунку квадрата довжини хорди
               cos(radLat1) * cos(radLat2) * sinHalfLon * sinHalfLon;                   // друга складова тригонометричної формули сфери
    if (a > 1.0) a = 1.0;                                                               // захист від виходу за межі одиниці через похибки обчислень
    if (a < 0.0) a = 0.0;                                                               // захист від від'ємного значення під знаком кореня
    double c = 2.0 * atan2(sqrt(a), sqrt(1.0 - a));                                     // кутова відстань між точками у радіанах
    return EARTH_RADIUS_METERS * c;                                                     // переведення кутової відстані у лінійні метри на поверхні
  }                                                                                     // завершення функції розрахунку сферичної дистанції

  bool isSignificantMovement(double currentLat, double currentLon) {                    // перевірка реального зміщення для виключення дублювання рядків у лозі
    if (lastLoggedLat == 0.0 && lastLoggedLon == 0.0) {                                 // якщо запис на накопичувач ще жодного разу не проводився
      return true;                                                                      // обов'язковий запис первинної координати старту маршруту
    }                                                                                   // завершення блоку перевірки першого запису
    double dist = calculateHaversineMeters(                                             // початок обчислення зміщення від останньої збереженої точки
      lastLoggedLat, lastLoggedLon, currentLat, currentLon);                            // передача координат останнього запису та поточного положення
    return (dist >= SIGNIFICANT_MOVE_METERS);                                           // порівняння пройденої відстані з порогом значущого руху
  }                                                                                     // завершення методу перевірки зміщення для запису

  void markTrackPointLogged(double lat, double lon) {                                   // фіксація географічних координат останнього успішного запису
    lastLoggedLat = lat;                                                                // оновлення контрольної широти збереженої точки
    lastLoggedLon = lon;                                                                // оновлення контрольної довготи збереженої точки
  }                                                                                     // завершення методу фіксації збереженої точки

  TrackerAnalytics processTelemetry(double currentLat, double currentLon,               // початок списку аргументів функції обробки телеметрії
                                   double currentAlt, double rawSpeedKmh,               // передача висоти над рівнем моря та поточної швидкості
                                   int sats, bool sosTriggered = false) {               // завершення передачі параметрів супутників та тривоги
    uint32_t now = millis();                                                            // фіксація поточної системної часової мітки у мілісекундах
    TrackerAnalytics result;                                                            // екземпляр структури для повернення розрахованих аналітичних показників
    if (!isInitialized) {                                                               // якщо це перший достовірний виклик аналітичного циклу
      prevLat = currentLat;                                                             // запам'ятовування стартової широти
      prevLon = currentLon;                                                             // запам'ятовування стартової довготи
      lastLoggedLat = 0.0;                                                              // дозвіл негайного запису першої точки у файл
      lastLoggedLon = 0.0;                                                              // скидання контрольної довготи для першого збереження
      cumulativeDistance = 0.0;                                                         // початок відліку пройденого кілометражу з нуля
      filteredSpeedKmh = rawSpeedKmh;                                                   // присвоєння первинного значення швидкості без згладжування
      stationaryStartTime = now;                                                        // старт обліку тривалості перебування на старті
      prevActivity = MOTION_STATIONARY;                                                 // ініціалізація вихідного типу активності туриста
      isInitialized = true;                                                             // встановлення прапорця повної готовності моделей ШІ
    }                                                                                   // завершення блоку первинного запуску моделей
    double stepDistance = calculateHaversineMeters(                                     // початок обчислення довжини поточного кроку переміщення
      prevLat, prevLon, currentLat, currentLon);                                        // передача попередніх та нових координат положення
    if (stepDistance > GPS_NOISE_JITTER_METERS) {                                       // відсікання стаціонарного дрейфу антени коли мандрівник стоїть
      cumulativeDistance += stepDistance;                                               // додавання реального переміщення до загального експедиційного кілометражу
      prevLat = currentLat;                                                             // оновлення попередньої координати широти
      prevLon = currentLon;                                                             // оновлення попередньої координати довготи
    }                                                                                   // завершення блоку фільтрації шуму антени
    filteredSpeedKmh = rawSpeedKmh;                                                     // миттєве застосування поточної швидкості без затримок фільтрації
    if (filteredSpeedKmh < 0.2) filteredSpeedKmh = 0.0;                                 // примусове обнулення мінімальної залишкової швидкості при зупинці
    if (filteredSpeedKmh < STATIONARY_SPEED_THRESHOLD) {                                // класифікація активності як повної зупинки мандрівника
      result.activity = MOTION_STATIONARY;                                              // присвоєння стану нерухомості або відпочинку на маршруті
    } else if (filteredSpeedKmh <= FAST_MOTION_SPEED_THRESHOLD) {                       // перевірка діапазону нормальної пішої ходи гірською стежкою
      result.activity = MOTION_WALKING;                                                 // класифікація стану пішого походу з рюкзаком
    } else {                                                                            // якщо швидкість перевищує встановлений поріг пішої ходи
      result.activity = MOTION_FAST_MOVING;                                             // класифікація швидкого бігу або руху на транспортному засобі
    }                                                                                   // завершення класифікації фізичної активності туриста
    if (result.activity == MOTION_STATIONARY) {                                         // якщо поточний стан класифіковано як нерухомий спокій
      if (prevActivity != MOTION_STATIONARY) {                                          // детекція моменту переходу туриста до повної зупинки
        stationaryStartTime = now;                                                      // фіксація системного часу початку поточного привалу
      }                                                                                 // завершення фіксації моменту переходу до зупинки
    } else {                                                                            // якщо мандрівник здійснює активне переміщення стежкою
      stationaryStartTime = now;                                                        // скидання часу початку зупинки при виявленні ходи
    }                                                                                   // завершення синхронізації часу старту стоянки
    prevActivity = result.activity;                                                     // збереження поточного стану активності для наступної перевірки
    uint32_t stationaryDuration = 0;                                                    // змінна підрахунку секунд неперервного перебування у спокої
    if (result.activity == MOTION_STATIONARY) {                                         // якщо поточний стан відповідає перебуванню на місці
      stationaryDuration = (now - stationaryStartTime) / 1000;                          // обчислення секунд нерухомості від початку поточної зупинки
    }                                                                                   // завершення розрахунку тривалості стоянки
    result.stationaryDurationSec = stationaryDuration;                                  // збереження обчисленої тривалості нерухомості у результатах
    const char* matchedZoneTitle = "Wilderness Outpost";                                // назва зони за замовчуванням за межами контрольних точок
    float currentZoneRisk = 0.65f;                                                      // базовий помірний ризик відкритої дикої місцевості
    for (int i = 0; i < 3; i++) {                                                       // цикл перевірки входження координат у контрольні експедиційні сектори
      double distToCenter = calculateHaversineMeters(                                   // початок вимірювання відстані до центру контрольної геозони
        geozones[i].centerLat, geozones[i].centerLon, currentLat, currentLon);          // передача параметрів геозони та поточних супутникових координат
      geozones[i].inside = (distToCenter <= geozones[i].radiusMeters);                  // порівняння дистанції з радіусом контрольної геозони
      if (geozones[i].inside) {                                                         // якщо координати потрапляють у межі конкретного сектору
        matchedZoneTitle = geozones[i].title;                                           // присвоєння назви активного експедиційного сектору
        currentZoneRisk = geozones[i].inherentRisk;                                     // використання коефіцієнту небезпеки цієї ділянки
        break;                                                                          // зупинка пошуку після знаходження першого відповідного сектору
      }                                                                                 // завершення блоку виявлення приналежності до геозони
    }                                                                                   // завершення циклу аналізу секторів експедиції
    result.currentZoneName = matchedZoneTitle;                                          // збереження актуальної назви географічної зони
    bool traumaDetected = false;                                                        // початковий стан відсутності ознак надзвичайної ситуації
    if (currentZoneRisk >= 0.70f && stationaryDuration >= INACTIVITY_CRITICAL_SECONDS) {// критерій виявлення травми у небезпечній ущелині при довгій паузі
      traumaDetected = true;                                                            // фіксація підозри на падіння та втрату дієздатності мандрівника
    } else if (stationaryDuration >= (INACTIVITY_CRITICAL_SECONDS * 2)) {               // критерій критичної нерухомості у будь якій іншій зоні маршруту
      traumaDetected = true;                                                            // встановлення прапорця загрози життю через аномальний час спокою
    }                                                                                   // завершення евристичного аналізу ознак травмування
    result.traumaSuspected = traumaDetected;                                            // запис висновку моделі щодо травми у вихідну структуру
    float riskScore = currentZoneRisk * 45.0f;                                          // первинний внесок рельєфу та небезпеки зони у сукупний ризик
    if (result.activity == MOTION_FAST_MOVING) {                                        // врахування фактора високої швидкості руху на пересіченій місцевості
      float speedExcess = (float)(filteredSpeedKmh - FAST_MOTION_SPEED_THRESHOLD);      // обчислення перевищення порогу безпечної пішої швидкості
      float speedRisk = speedExcess * 0.5f;                                             // динамічний розрахунок додаткового швидкісного ризику
      if (speedRisk > 25.0f) speedRisk = 25.0f;                                         // обмеження максимальної надбавки за швидкість двадцятьма п'ятьма відсотками
      riskScore += speedRisk;                                                           // додавання швидкісної складової до загального балу небезпеки
    }                                                                                   // завершення блоку оцінки ризику від надмірної швидкості
    if (currentZoneRisk > 0.10f && stationaryDuration > INACTIVITY_WARNING_SECONDS) {   // якщо тривалість зупинки у гірській зоні перевищила поріг уваги
      uint32_t overtime = stationaryDuration - INACTIVITY_WARNING_SECONDS;              // розрахунок часу перевищення контрольного інтервалу спокою
      float addRisk = 20.0f + (float)overtime * 0.15f;                                  // базовий поріг підвищеної загрози та плавний приріст за час спокою
      if (addRisk > 38.0f) addRisk = 38.0f;                                             // обмеження максимального внеску тривалості спокою у ризик
      riskScore += addRisk;                                                             // додавання часової складової ризику до загального балу
    }                                                                                   // завершення оцінки часового фактора небезпеки
    if (traumaDetected) {                                                               // якщо модель зафіксувала ознаки отримання травми туристом
      riskScore = 95.0f;                                                                // підвищення показника ризику до дев'яноста п'яти відсотків при лиху
    }                                                                                   // завершення врахування прапорця травматизму
    if (sosTriggered) {                                                                 // безумовне підвищення рівня загрози при ручній активації тривоги
      riskScore = 95.0f;                                                                // встановлення максимального пріоритету небезпеки для рятувальників
    }                                                                                   // завершення обробки апаратного сигналу лиха
    if (riskScore > 100.0f) riskScore = 100.0f;                                         // обмеження максимального значення ризику сотнею відсотків
    result.riskScorePercent = riskScore;                                                // збереження нормованого відсотка небезпеки у структурі
    if (sosTriggered || traumaDetected || riskScore >= 75.0f) {                         // визначення найвищої критичної категорії загрози життю
      result.riskGrade = RISK_CRITICAL;                                                 // присвоєння критичного рівня небезпеки для рятувальників
      result.adaptiveIntervalMs = 2000;                                                 // аварійний інтервал збереження дві секунди при надзвичайній ситуації
    } else if (riskScore >= 50.0f) {                                                    // визначення межі підвищеної небезпеки для туриста
      result.riskGrade = RISK_HAZARDOUS;                                                // присвоєння високого рівня загрози
      result.adaptiveIntervalMs = 4000;                                                 // прискорений інтервал збереження чотири секунди при небезпеці
    } else if (riskScore >= 25.0f) {                                                    // перевірка помірного рівня пильності на маршруті
      result.riskGrade = RISK_ELEVATED;                                                 // присвоєння помірного рівня складності ділянки
      result.adaptiveIntervalMs = 8000;                                                 // базовий інтервал збереження вісім секунд при активній ході
    } else {                                                                            // якщо сукупний бал небезпеки менше двадцяти п'яти відсотків
      result.riskGrade = RISK_MINIMAL;                                                  // присвоєння спокійного безпечного рівня контролю
      result.adaptiveIntervalMs = 8000;                                                 // базовий інтервал збереження вісім секунд у стані спокою
    }                                                                                   // завершення категоризації рівня ризику
    result.smoothedSpeedKmh = filteredSpeedKmh;                                         // збереження згладженого показника швидкості туриста
    result.totalDistanceMeters = cumulativeDistance;                                    // збереження повної подоланої дистанції експедиційного маршруту
    return result;                                                                      // повернення наповненої структури комплексного аналізу
  }                                                                                     // завершення методу комплексної обробки телеметрії

  void buildLLMExplanation(const TrackerAnalytics& data, double currentLat,             // початок генератора мовного пояснення для диспетчера рятувальників
                           double currentLon, char* outBuffer, size_t maxLen) {         // аргументи буфера та його граничного розміру у байтах
    const char* actName = "Stationary";                                                 // назва стану спокою для формулювання словесного звіту
    if (data.activity == MOTION_WALKING) actName = "Trekking";                          // позначення пішої ходи гірською стежкою у звіті
    if (data.activity == MOTION_FAST_MOVING) actName = "Rapid Transit";                 // позначення швидкого переміщення у звіті диспетчера
    const char* gradeName = "Minimal Risk";                                             // словесний рівень безпеки за замовчуванням
    if (data.riskGrade == RISK_ELEVATED) gradeName = "Elevated Caution";                // словесний опис помірної небезпеки
    if (data.riskGrade == RISK_HAZARDOUS) gradeName = "Hazardous Warning";              // словесний опис високої загрози
    if (data.riskGrade == RISK_CRITICAL) gradeName = "Critical Emergency";              // словесний опис критичного стану для негайного реагування
    char extraInfo[96];                                                                 // допоміжний буфер формування стислих оперативних даних
    if (data.traumaSuspected) {                                                         // формування термінової директиви у разі виявлення підозри на травму
      snprintf(extraInfo, sizeof(extraInfo),                                            // початок формування рядка тривожного сповіщення рятувальників
        "Alert: Immobile in %s",                                                        // лаконічний шаблон повідомлення про нерухомість у зоні
        data.currentZoneName);                                                          // підстановка назви небезпечного експедиційного сектору
    } else {                                                                            // формування стандартного навігаційного повідомлення спостереження
      snprintf(extraInfo, sizeof(extraInfo),                                            // початок формування рядка штатного навігаційного статусу
        "Sector: %s | Dist: %.0f m",                                                    // лаконічний шаблон сектору та подоланої відстані
        data.currentZoneName, data.totalDistanceMeters);                                // підстановка назви сектору та загального пройденого кілометражу
    }                                                                                   // завершення формування текстового коментаря безпеки
    snprintf(outBuffer, maxLen,                                                         // початок фінального форматування повного дайджесту для мовної моделі
      "Status: %s | %s (%.1f km/h) | Risk: %.1f%% | %s",                                // компактний шаблон параметрів ситуації для одного рядка термінала
      gradeName, actName, data.smoothedSpeedKmh,                                        // підстановка словесної оцінки типу руху та швидкості
      data.riskScorePercent, extraInfo);                                                // підстановка числового ризику та оперативних даних сектору
  }                                                                                     // завершення методу формування мовного дайджесту

  const char* getActivityName(MotionActivity act) {                                     // перетворення коду фізичної активності у текстову назву
    switch (act) {                                                                      // вибір текстового найменування за числовим кодом переліку
      case MOTION_STATIONARY: return "RESTING / STATIONARY";                            // назва стану відпочинку або повної нерухомості туриста
      case MOTION_WALKING: return "WALKING / TREKKING";                                 // назва штатної пішої ходи пересіченою місцевістю
      case MOTION_FAST_MOVING: return "RUNNING / VEHICULAR";                            // назва швидкого бігу або руху на транспорті
      default: return "UNKNOWN";                                                        // повернення невідомого стану у разі непередбаченого коду
    }                                                                                   // завершення оператора вибору назви активності
  }                                                                                     // завершення методу отримання назви активності

  const char* getRiskGradeName(RiskGrade grade) {                                       // перетворення числового рівня небезпеки у вербальний опис
    switch (grade) {                                                                    // вибір вербальної оцінки за числовим рівнем небезпеки
      case RISK_MINIMAL: return "MINIMAL RISK";                                         // назва мінімального ризику базового сектору
      case RISK_ELEVATED: return "ELEVATED CAUTION";                                    // назва помірної уваги на ділянці переходу
      case RISK_HAZARDOUS: return "HAZARDOUS RISK";                                     // назва високої небезпеки складного рельєфу
      case RISK_CRITICAL: return "CRITICAL RISK";                                       // назва критичного рівня екстреної допомоги
      default: return "UNDEFINED";                                                      // повернення невизначеного ступеня загрози за замовчуванням
    }                                                                                   // завершення оператора вибору словесної оцінки
  }                                                                                     // завершення методу визначення найменування ризику
};                                                                                      // завершення оголошення класу інтелектуального рушія

#endif                                                                                  // завершення блоку умовної компіляції заголовкового файлу