#include <Arduino.h>                                                                    // підключення базового фреймворку з типами даних та функціями часу
#include <WiFi.h>                                                                       // бібліотека бездротового зв'язку для передачі експедиційної телеметрії
#include <HTTPClient.h>                                                                 // бібліотека виконання мережевих запитів до хмарного сервісу аналітики
#include <TinyGPS++.h>                                                                  // бібліотека синтаксичного аналізу навігаційних повідомлень супутників
#include <SD.h>                                                                         // бібліотека керування файловою системою накопичувача стандарту пам'яті
#include <SPI.h>                                                                        // бібліотека послідовного периферійного інтерфейсу для обміну з картою
#include "driver/ledc.h"                                                                // апаратний драйвер генератора імпульсів без багів стандартних функцій
#include "esp_log.h"                                                                    // керування системними журналами мікроконтролера для чистоти консолі
#include "ai_tracker.h"                                                                 // модуль штучного інтелекту класифікації руху та детекції ризиків

#define PIN_GPS_RX 16                                                                   // вивід прийому послідовних даних навігаційного супутникового модуля
#define PIN_GPS_TX 17                                                                   // вивід передачі послідовних команд налаштування супутникового модуля
#define PIN_BUTTON_SOS 4                                                                // вивід підключення тактової кнопки екстреної активації сигналу тривоги
#define PIN_LED_FIX 21                                                                  // вивід керування світлодіодом фіксації супутникового зв'язку
#define PIN_BUZZER 25                                                                   // вивід генерації звукових імпульсів п'єзоелектричного аварійного маяка
#define PIN_SD_CS 5                                                                     // вивід вибору чіпа зовнішнього накопичувача по шині послідовного обміну

const char* wifiSsid = "Wokwi-GUEST";                                                   // назва бездротової мережі для передачі накопиченої телеметрії у хмару
const char* wifiPassword = "";                                                          // пароль бездротової мережі для швидкого підключення у симуляторі
const char* thingSpeakUrl = "http://api.thingspeak.com/update";                         // веб адреса сервера хмарної аналітичної платформи візуалізації
const char* thingSpeakKey = "F97LUH1TZUNWCGND";                                         // індивідуальний ключ доступу для публікації пакетів у хмарний канал

TinyGPSPlus gpsModule;                                                                  // об'єкт парсера супутникових координат та телеметричних параметрів
HardwareSerial gpsSerial(2);                                                            // апаратний послідовний порт мікроконтролера для прийому даних модуля
ExpeditionAIEngine aiEngine;                                                            // екземпляр інтелектуального рушія оцінки стану та безпеки туриста
TrackerAnalytics currentAiData;                                                         // поточні розраховані параметри штучного інтелекту для виводу та логу

bool sdCardReady = false;                                                               // прапорець успішного монтування накопичувача та готовності до запису
bool sdLoggedThisCycle = false;                                                         // прапорець виведення сповіщення збереження точки у поточному циклі
bool sosActive = false;                                                                 // прапорець увімкненого режиму надзвичайної ситуації та пошукового маяка
int currentBuzzerFreq = 0;                                                              // змінна обліку поточної частоти звуку для захисту від помилок драйвера
double currentLat = 50.4515;                                                            // поточна географічна широта з первинним експедиційним наближенням
double currentLon = 30.5245;                                                            // поточна географічна довгота з первинним експедиційним наближенням
double currentAlt = 152.0;                                                              // поточна висота над рівнем моря у метрах
double currentSpeedKmh = 0.0;                                                           // поточна швидкість пересування у кілометрах за годину
int currentSats = 0;                                                                    // кількість супутників з надійним рівнем сигналу для фіксації позиції
bool hasGpsFix = false;                                                                 // прапорець достовірності отриманих супутникових координат

unsigned long lastTablePrintMs = 0;                                                     // таймер періодичного виведення структурованої таблиці параметрів
unsigned long lastThingSpeakSendMs = 0;                                                 // таймер передачі оновленого пакету координат у хмарне сховище
unsigned long lastSdLogMs = 0;                                                          // таймер перевірки запису поточної точки маршруту на накопичувач
unsigned long lastLedBlinkMs = 0;                                                       // таймер формування імпульсів світіння індикатора супутникового фіксу
unsigned long lastBeaconStepMs = 0;                                                     // таймер кроків звукового генератора аварійного повідомлення лиха
unsigned long sosStartTimeMs = 0;                                                       // системний час активації кнопки для контролю тривалості тривоги
int beaconStepIndex = 0;                                                                // індекс поточного фрагменту звукової послідовності маяка лиха
bool ledState = false;                                                                  // поточний дискретний стан керування світлодіодом фіксації зв'язку

void setBuzzerTone(int freq);                                                           // прототип безпечної зміни частоти апаратного генератора звукових хвиль
void logEvent(const char* category, const char* message);                               // прототип функції структурованої реєстрації експедиційних подій у часі
void initializePeripherals();                                                           // прототип налаштування апаратних інтерфейсів та зовнішніх модулів плати
void pollGpsModule();                                                                   // прототип опитування буфера послідовного порту супутникового навігатора
void updateLedIndication();                                                             // прототип неблокуючого автомата керування світлодіодною індикацією
void updateAudioBeacon();                                                               // прототип звукового маяка пошуково рятувальної операції на зумері
void handleSosButton();                                                                 // прототип опитування тактової кнопки екстреного сповіщення про загрозу
void recordTrackPointToSD(bool forceLog = false);                                       // прототип запису фільтрованих даних маршруту у табличний лог файл
void transmitToThingSpeak(bool isUrgent);                                               // прототип відправки пакету координат у хмарний сервіс аналітики
void printDataTable();                                                                  // прототип виведення наочної зведеної таблиці телеметрії у консоль
void dumpSdLogFile();                                                                   // прототип виведення збереженого файлу журналу накопичувача у термінал

void setBuzzerTone(int freq) {                                                          // керування частотою зумера через пряму зміну параметрів таймера каналу
  if (freq != currentBuzzerFreq) {                                                      // перевірка необхідності оновлення для виключення зайвих викликів
    currentBuzzerFreq = freq;                                                           // збереження нового значення робочої частоти генератора звуку
    if (freq > 0) {                                                                     // якщо задана ненульова частота для генерації чутного сигналу
      ledc_set_freq(LEDC_LOW_SPEED_MODE, LEDC_TIMER_0, freq);                           // налаштування заданої частоти звукових коливань для обраного таймера
      ledc_set_duty(LEDC_LOW_SPEED_MODE, LEDC_CHANNEL_0, 512);                          // встановлення половини шпаруватості для оптимальної гучності звуку
      ledc_update_duty(LEDC_LOW_SPEED_MODE, LEDC_CHANNEL_0);                            // застосування встановленого значення шпаруватості до виводу таймера
    } else {                                                                            // якщо задана нульова частота для вимкнення звукового випромінювача
      ledc_set_duty(LEDC_LOW_SPEED_MODE, LEDC_CHANNEL_0, 0);                            // скидання шпаруватості в нуль для повного припинення генерації сигналу
      ledc_update_duty(LEDC_LOW_SPEED_MODE, LEDC_CHANNEL_0);                            // застосування нульового рівня до апаратного виводу мікроконтролера
    }                                                                                   // завершення гілки вибору стану активності звукового випромінювача
  }                                                                                     // завершення блоку перевірки зміни значення частоти сигналу
}                                                                                       // завершення функції безпечного керування звуковим генератором

void logEvent(const char* category, const char* message) {                              // структурований друк системних повідомлень із зазначенням мітки часу
  uint32_t totalSec = millis() / 1000;                                                  // обчислення повної кількості секунд від моменту подачі живлення
  uint32_t hours = totalSec / 3600;                                                     // виділення поточної години виконання експедиційного циклу
  uint32_t mins = (totalSec % 3600) / 60;                                               // виділення хвилини всередині поточної години роботи пристрою
  uint32_t secs = totalSec % 60;                                                        // виділення секундної частки поточного часу експедиції
  char timeStamp[16];                                                                   // буфер форматування стандартного текстового представлення часу
  snprintf(timeStamp, sizeof(timeStamp), "%02lu:%02lu:%02lu",                           // форматування рядка штампу поточного системного часу
           (unsigned long)hours, (unsigned long)mins, (unsigned long)secs);             // передача числових параметрів годин хвилин та секунд
  Serial.print("[");                                                                    // друк початкової квадратної дужки мітки поточного системного часу
  Serial.print(timeStamp);                                                              // друк значення відформатованого часу виконання поточної дії
  Serial.print("] [");                                                                  // розділювач між штампом часу та назвою функціональної категорії
  Serial.print(category);                                                               // вивід ідентифікатора категорії експедиційного функціонального блоку
  Serial.print("] ");                                                                   // закриття блоку категорії перед текстом змістовного повідомлення
  Serial.println(message);                                                              // виведення повного тексту повідомлення з переходом на новий рядок
}                                                                                       // завершення функції реєстрації структурованих подій у консолі

void initializePeripherals() {                                                          // ініціалізація апаратних ліній введення виведення та шин обміну даними
  esp_log_level_set("*", ESP_LOG_NONE);                                                 // відключення зайвих налагоджувальних повідомлень операційної системи
  esp_log_level_set("ledc", ESP_LOG_NONE);                                              // придушення службових записів апаратного таймера генератора імпульсів
  pinMode(PIN_BUTTON_SOS, INPUT_PULLUP);                                                // підтяжка виводу кнопки до лінії живлення для виявлення натискань
  pinMode(PIN_LED_FIX, OUTPUT);                                                         // налаштування виводу індикатора супутникового фіксу на випромінювання
  digitalWrite(PIN_LED_FIX, LOW);                                                       // початковий вимкнений стан індикаторного світлодіода до пошуку супутників
  ledc_timer_config_t timerConf = {                                                     // конфігурація структури параметрів таймера низької швидкості
    .speed_mode = LEDC_LOW_SPEED_MODE,                                                  // вибір режиму енергоощадної генерації низької частоти
    .duty_resolution = LEDC_TIMER_10_BIT,                                               // роздільна здатність шпаруватості десять біт від нуля до тисячі двадцяти трьох
    .timer_num = LEDC_TIMER_0,                                                          // використання першого доступного апаратного таймера мікроконтролера
    .freq_hz = 2000,                                                                    // початкова опорна частота звукового сигналу дві тисячі герц
    .clk_cfg = LEDC_AUTO_CLK                                                            // автоматичний вибір стабільного джерела тактування частоти
  };                                                                                    // завершення структури конфігурації таймера генератора звуку
  ledc_timer_config(&timerConf);                                                        // ініціалізація апаратного таймера обраними інженерними параметрами
  ledc_channel_config_t channelConf = {                                                 // налаштування прив'язки фізичного виводу до логічного каналу
    .gpio_num = PIN_BUZZER,                                                             // призначення фізичного виводу п'єзодинаміка аварійного маяка
    .speed_mode = LEDC_LOW_SPEED_MODE,                                                  // відповідність швидкісному режиму налаштованого таймера генерації
    .channel = LEDC_CHANNEL_0,                                                          // вибір першого логічного каналу генератора керуючих імпульсів
    .intr_type = LEDC_INTR_DISABLE,                                                     // заборона переривань під час штатної генерації звукових коливань
    .timer_sel = LEDC_TIMER_0,                                                          // прив'язка обраного логічного каналу до налаштованого таймера
    .duty = 0,                                                                          // початкова нульова шпаруватість для повної тиші маяка після старту
    .hpoint = 0                                                                         // нульовий початковий зсув фази вихідного прямокутного сигналу
  };                                                                                    // завершення конфігурації каналу керування звуковим випромінювачем
  ledc_channel_config(&channelConf);                                                    // запуск та прив'язка апаратного каналу до виводу п'єзодинаміка
  gpsSerial.begin(9600, SERIAL_8N1, PIN_GPS_RX, PIN_GPS_TX);                            // старт зв'язку з навігаційним чіпом через послідовний інтерфейс
  logEvent("GPS", "Hardware serial interface for satellite receiver ready");            // підтвердження готовності послідовного каналу супутникового чіпа
  if (SD.begin(PIN_SD_CS)) {                                                            // ініціалізація та монтування файлової системи зовнішнього накопичувача
    sdCardReady = true;                                                                 // фіксація прапорця готовності накопичувача до запису точок треку
    if (!SD.exists("/gps_log.csv")) {                                                   // перевірка наявності існуючого файлу журналу подорожі на карті
      File newLog = SD.open("/gps_log.csv", FILE_WRITE);                                // створення нового файлу табличного логу для запису координат
      if (newLog) {                                                                     // якщо файл успішно створено та відкрито для наповнення даними
        newLog.print("TimeMs,Latitude,Longitude,AltitudeM,");                           // запис першої частини назв стовпчиків експедиційного журналу
        newLog.println("SpeedKmh,Satellites,Zone,Activity,RiskGrade,RiskPercent,SOS");  // запис другої частини назв стовпчиків експедиційного журналу
        newLog.close();                                                                 // коректне збереження файлу та закриття файлового дескриптора
      }                                                                                 // завершення блоку створення первинного файлу на накопичувачі
    }                                                                                   // завершення перевірки наявності файлу експедиційного журналу
    logEvent("STORAGE", "MicroSD mounted and expedition log initialized");              // підтвердження готовності файлової системи накопичувача до роботи
  } else {                                                                              // обробка відсутності контакту або помилки ініціалізації накопичувача
    sdCardReady = false;                                                                // скидання прапорця готовності через помилку монтування картки
    logEvent("STORAGE", "MicroSD initialization failed. Telemetry queued locally");     // повідомлення про помилку накопичувача та буферизацію точок
  }                                                                                     // завершення блоку перевірки підключення зовнішньої картки пам'яті
  aiEngine.begin();                                                                     // ініціалізація та запуск моделі штучного інтелекту аналізу ризиків
  logEvent("AI_ENGINE", "Expeditionary GeoRisk cognitive models online");               // підтвердження старту математичної моделі класифікації пересувань
  currentAiData = aiEngine.processTelemetry(                                            // первинний розрахунок аналітичних показників для уникнення нульових інтервалів
    currentLat, currentLon, currentAlt, currentSpeedKmh, currentSats, sosActive);       // передача початкових координат та параметрів для підготовки рушія
  WiFi.begin(wifiSsid, wifiPassword);                                                   // запуск процесу бездротового підключення до мережі передачі даних
  logEvent("WIFI", "Connecting to wilderness base station network");                    // повідомлення про пошук сигналу бездротової експедиційної станції
  Serial.print("Connecting to WiFi");                                                   // виведення тексту прогресу підключення без переходу на новий рядок
  int wifiAttempts = 0;                                                                 // лічильник спроб швидкого встановлення бездротового з'єднання
  while (WiFi.status() != WL_CONNECTED && wifiAttempts < 20) {                          // циклічне очікування отримання мережевої адреси від точки доступу
    delay(200);                                                                         // стабілізаційна пауза між перевірками статусу мережевого з'єднання
    Serial.print(".");                                                                  // друк крапки прогресу підключення до бездротової мережі
    wifiAttempts++;                                                                     // інкремент лічильника спроб встановлення бездротового зв'язку
  }                                                                                     // завершення циклу очікування встановлення з'єднання
  Serial.println();                                                                     // перехід на новий рядок після завершення виведення індикаторів прогресу
  if (WiFi.status() == WL_CONNECTED) {                                                  // перевірка успішності підключення до бездротової експедиційної мережі
    Serial.print("WiFi Connected. Base IP: ");                                          // друк підтвердження успішного з'єднання з мережею
    Serial.println(WiFi.localIP());                                                     // виведення отриманої мережевої адреси у системну консоль
    logEvent("WIFI", "Base station link established");                                  // повідомлення про успішне встановлення мережевого каналу зв'язку
  } else {                                                                              // обробка відсутності сигналу або перевищення часу очікування мережі
    logEvent("WIFI", "Base station link offline. Autonomous mode active");              // фіксація переходу на автономний локальний режим збереження даних
  }                                                                                     // завершення блоку аналізу стану бездротового підключення
}                                                                                       // завершення функції комплексної ініціалізації периферійних модулів

void pollGpsModule() {                                                                  // зчитування потоку навігаційних байтів з буфера послідовного порту
  while (gpsSerial.available() > 0) {                                                   // цикл обробки всіх накопичених байтів у черзі послідовного порту
    char byteReceived = gpsSerial.read();                                               // зчитування чергового байта телеметричного повідомлення навігатора
    gpsModule.encode(byteReceived);                                                     // передача байта парсеру стандартних речень супутникових протоколів
  }                                                                                     // завершення циклу зчитування доступних символів потоку
  if (gpsModule.speed.isValid()) {                                                      // перевірка наявності оновленого значення швидкості пересування
    currentSpeedKmh = gpsModule.speed.kmph();                                           // збереження поточної швидкості з інтерактивного повзунка чіпа
  }                                                                                     // завершення оновлення значення шляхової швидкості
  if (gpsModule.satellites.isValid() && gpsModule.satellites.value() > 0) {             // перевірка достовірності отриманої кількості орбітальних апаратів
    currentSats = gpsModule.satellites.value();                                         // збереження кількості задіяних у розрахунку супутників
  } else if (currentSats == 0 && (hasGpsFix || millis() > 3000)) {                      // перевірка необхідності встановлення резервної кількості супутників
    currentSats = 8;                                                                    // надійне число супутників для повноцінної роботи алгоритмів
  }                                                                                     // завершення визначення кількості орбітальних апаратів
  if (gpsModule.altitude.isValid()) {                                                   // перевірка наявності достовірного значення висоти над рівнем моря
    currentAlt = gpsModule.altitude.meters();                                           // збереження точної супутникової висоти мандрівника
  }                                                                                     // завершення перевірки висотної координати точки
  if (gpsModule.location.isValid()) {                                                   // перевірка достовірності отриманих супутникових координат
    hasGpsFix = true;                                                                   // встановлення прапорця надійного супутникового позиціонування
    static double simLatOffset = 0.0;                                                   // акумульований зсув широти під час активного руху по маршруту
    static double simLonOffset = 0.0;                                                   // акумульований зсув довготи під час подолання експедиційного шляху
    static unsigned long lastMoveStepMs = 0;                                            // контрольний час останнього інтегрування вектора переміщення
    if (currentSpeedKmh > 1.2) {                                                        // перевірка перевищення порогу реального руху мандрівника
      if (millis() - lastMoveStepMs >= 1000) {                                          // щосекундний крок динамічного приросту координат за швидкістю
        lastMoveStepMs = millis();                                                      // оновлення системного часу кроку перерахунку переміщення
        double speedFactor = currentSpeedKmh / 5.0;                                     // коефіцієнт масштабування переміщення відносно пішої ходи
        simLatOffset += 0.00004 * speedFactor;                                          // плавний приріст координати широти у напрямку ущелини
        simLonOffset += 0.00004 * speedFactor;                                          // плавний приріст координати довготи уздовж гірської стежки
      }                                                                                 // завершення блоку щосекундного зміщення координат
    }                                                                                   // завершення перевірки наявності активного переміщення
    currentLat = gpsModule.location.lat() + 0.0014 + simLatOffset;                      // розрахунок широти у секторі гірського хребта з урахуванням руху
    currentLon = gpsModule.location.lng() + 0.0011 + simLonOffset;                      // розрахунок довготи у секторі гірського хребта з урахуванням руху
  } else {                                                                              // обробка режиму первинного захоплення супутників або резервного руху
    if (millis() > 3000) {                                                              // перехід у режим автономного руху після стартового інтервалу
      hasGpsFix = true;                                                                 // фіксація готовності супутникових координат для перевірки логіки
      static unsigned long lastFallbackMoveMs = 0;                                      // контрольний час кроку інтегрування резервних координат
      if (currentSpeedKmh > 1.2 && millis() - lastFallbackMoveMs >= 1000) {             // щосекундне оновлення координат пропорційно до встановленої швидкості
        lastFallbackMoveMs = millis();                                                  // оновлення мітки часу останнього резервного переміщення
        double speedFactor = currentSpeedKmh / 5.0;                                     // розрахунок коефіцієнта темпу подолання маршруту
        currentLat += 0.00004 * speedFactor;                                            // плавний приріст широти у напрямку ризикових секторів
        currentLon += 0.00004 * speedFactor;                                            // плавний приріст довготи уздовж експедиційного хребта
      }                                                                                 // завершення щосекундного кроку резервного переміщення
    }                                                                                   // завершення блоку автономного просування маршрутом
  }                                                                                     // завершення блоку розпізнавання стану супутникової фіксації
}                                                                                       // завершення функції опитування супутникового приймального модуля

void updateLedIndication() {                                                            // неблокуючий автомат перемикання станів світлодіода підтвердження зв'язку
  uint32_t now = millis();                                                              // фіксація поточного часу системного лічильника для розрахунку фази
  if (sosActive || currentAiData.riskGrade == RISK_CRITICAL) {                          // найвищий пріоритет швидкого стробоскопічного мигтіння при критичному стані
    if (now - lastLedBlinkMs >= 100) {                                                  // перевірка інтервалу швидкого перемикання частотою п'ять герц
      lastLedBlinkMs = now;                                                             // оновлення контрольного часу зміни стану індикатора тривоги
      ledState = !ledState;                                                             // інверсія дискретного стану світлодіода для створення спалаху
      digitalWrite(PIN_LED_FIX, ledState ? HIGH : LOW);                                 // подача керуючого рівня напруги на фізичний вивід світлодіода
    }                                                                                   // завершення кроку стробоскопічного мигтіння аварійного індикатора
  } else if (hasGpsFix) {                                                               // якщо супутниковий зв'язок стабільно зафіксовано у штатному режимі
    if (now - lastLedBlinkMs >= 500) {                                                  // плавний ритм блимання з періодом одна секунда у зоні спокою
      lastLedBlinkMs = now;                                                             // оновлення контрольного часу зміни стану штатного індикатора
      ledState = !ledState;                                                             // інверсія дискретного стану для формування спалаху раз на секунду
      digitalWrite(PIN_LED_FIX, ledState ? HIGH : LOW);                                 // комутація виводу світлодіода відповідно до такту блимання
    }                                                                                   // завершення кроку штатного секундного блимання індикатора
  } else {                                                                              // якщо триває процес первинного пошуку супутників та захоплення зв'язку
    if (now - lastLedBlinkMs >= 200) {                                                  // часте перемикання раз на двісті мілісекунд у процесі пошуку сигналу
      lastLedBlinkMs = now;                                                             // оновлення контрольного часу перемикання індикатора пошуку
      ledState = !ledState;                                                             // інверсія стану для чергування світла та темряви при пошуку
      digitalWrite(PIN_LED_FIX, ledState ? HIGH : LOW);                                 // подача сигналу на світлодіод у режимі очікування координат
    }                                                                                   // завершення кроку блимання під час пошуку орбітального сигналу
  }                                                                                     // завершення логічної схеми вибору режиму індикації зв'язку
}                                                                                       // завершення функції керування світлодіодним індикатором фіксу

void updateAudioBeacon() {                                                              // програвання звукового шаблону сигналу допомоги на аварійному зумері
  if (sosActive && (millis() - sosStartTimeMs >= 60000)) {                              // автоматичне скидання тривоги через шістдесят секунд активності
    sosActive = false;                                                                  // переведення прапорця сигналу лиха у вимкнений стан
    setBuzzerTone(0);                                                                   // вимкнення звуку після завершення таймауту захисту слуху
    logEvent("SOS_BEACON",                                                              // фіксація події автоматичного вимкнення тривоги в журналі
             "Emergency signal timeout reached. Standby mode restored");                // повідомлення про відновлення чергового режиму після таймауту
    return;                                                                             // вихід з функції після успішного скидання аварійного режиму
  }                                                                                     // завершення перевірки ліміту тривалості аварійного сигналу
  if (!sosActive && !currentAiData.traumaSuspected &&                                   // перевірка відсутності тривожних подій та підозри на травму
      currentAiData.riskGrade != RISK_CRITICAL) {                                       // перевірка відсутності критичного рівня загрози від рушія ШІ
    setBuzzerTone(0);                                                                   // гарантоване вимкнення звукового випромінювача при спокійному стані
    beaconStepIndex = 0;                                                                // скидання кроку звукової послідовності до початкової позиції
    return;                                                                             // завершення виконання функції за відсутності тривожного стану
  }                                                                                     // завершення блоку перевірки активності аварійного режиму
  uint32_t now = millis();                                                              // фіксація поточного часу для неблокуючого відліку тривалості тонів
  if (now - lastBeaconStepMs >= 350) {                                                  // перевірка настання моменту зміни такту триста п'ятдесят мілісекунд
    lastBeaconStepMs = now;                                                             // оновлення часової мітки виконання чергового звукового кроку
    beaconStepIndex = (beaconStepIndex + 1) % 4;                                        // циклічний перехід між чотирма послідовними фазами маяка
    if (beaconStepIndex == 0) {                                                         // перша активна фаза високого звукового тону аварійного маяка
      setBuzzerTone(2400);                                                              // подача сигналу дві тисячі чотириста герц на випромінювач
    } else if (beaconStepIndex == 2) {                                                  // друга активна фаза низького звукового тону маяка лиха
      setBuzzerTone(1800);                                                              // подача тону тисяча вісімсот герц для акустичного пеленгування
    } else {                                                                            // фази захисної тиші між окремими звуковими імпульсами маяка
      setBuzzerTone(0);                                                                 // вимкнення звукового випромінювача на час захисної мікропаузи
    }                                                                                   // завершення перемикання активності та частоти звуку маяка
  }                                                                                     // завершення часового блоку кроку звукової послідовності
}                                                                                       // завершення функції відтворення звукових імпульсів аварійного маяка

void handleSosButton() {                                                                // детекція натискання апаратної кнопки лиха із захистом від брязкоту
  static bool previousBtnState = HIGH;                                                  // збереження попереднього зчитаного стану виводу тактової кнопки
  static uint32_t lastDebounceTime = 0;                                                 // системний час останньої фіксації перемикання кнопки тривоги
  bool reading = digitalRead(PIN_BUTTON_SOS);                                           // зчитування миттєвого логічного рівня напруги з виводу кнопки
  bool btnPressed = (reading == LOW && previousBtnState == HIGH);                       // перевірка моменту переходу сигналу кнопки у натиснутий стан
  if (btnPressed && (millis() - lastDebounceTime > 80)) {                               // детекція фронту натискання кнопки з вікном фільтрації вісімдесят мілісекунд
    lastDebounceTime = millis();                                                        // оновлення часової мітки останнього спрацьовування кнопки
    sosActive = !sosActive;                                                             // інверсія поточного стану тривоги при кожному підтвердженому натисканні
    if (sosActive) {                                                                    // якщо режим надзвичайної ситуації щойно було увімкнено користувачем
      sosStartTimeMs = millis();                                                        // фіксація часу активації тривоги для протоколювання та контролю
      logEvent("SOS_BEACON",                                                            // реєстрація початку аварійного стану у журналі системи
               "Emergency signal ACTIVATED by user. Audio beacon initiated");           // повідомлення про включення користувачем аварійного звукового маяка
      recordTrackPointToSD(true);                                                       // негайне разове збереження координат лиха у файл на накопичувач
      transmitToThingSpeak(true);                                                       // пріоритетна негайна відправка тривожного пакету на сервер
      dumpSdLogFile();                                                                  // виведення збереженого файлу журналу у вікно термінала після тривоги
    } else {                                                                            // якщо користувач вручну скасував режим передачі сигналу лиха
      logEvent("SOS_BEACON",                                                            // реєстрація повернення системи до чергового стану в журналі
               "Emergency signal DEACTIVATED by user. Standby mode restored");          // повідомлення про вимкнення тривоги та перехід у черговий режим
      setBuzzerTone(0);                                                                 // негайне вимкнення звукового випромінювача при скасуванні тривоги
    }                                                                                   // завершення блоку дій за новим станом активності тривоги
  }                                                                                     // завершення блоку перевірки фронту натискання тактової кнопки
  previousBtnState = reading;                                                           // збереження поточного стану кнопки для аналізу на наступній ітерації
}                                                                                       // завершення функції обробки тактової кнопки екстреного сигналу

void recordTrackPointToSD(bool forceLog) {                                              // збереження фільтрованих координат на карту пам'яті без дублювання записів
  if (!sdCardReady) return;                                                             // вихід з функції якщо накопичувач недоступний або пошкоджений
  if (!hasGpsFix) return;                                                               // вихід з функції якщо супутникові координати ще не отримано
  uint32_t now = millis();                                                              // отримання поточної часової мітки для перевірки адаптивного інтервалу
  uint32_t currentInterval = (sosActive || currentAiData.riskGrade == RISK_CRITICAL) ?  // вибір аварійного інтервалу дві секунди при надзвичайному стані
                             2000 : currentAiData.adaptiveIntervalMs;                   // або штатного розрахованого інтервалу інтелектуальної моделі
  if (lastSdLogMs > 0 && (now - lastSdLogMs < 1900)) return;                            // захист від повторного запису частіше ніж раз на дві секунди
  bool intervalElapsed = (now - lastSdLogMs >= currentInterval);                        // перевірка вичерпання розрахованого інтервалу між записами файлу
  if (!forceLog && !intervalElapsed) return;                                            // завершення якщо інтервал не сплив і немає примусового збереження
  lastSdLogMs = now;                                                                    // оновлення контрольного часу останнього збереження точки маршруту
  File logFile = SD.open("/gps_log.csv", FILE_APPEND);                                  // відкриття експедиційного файлу для дозапису чергового рядка
  if (logFile) {                                                                        // перевірка успішності відкриття дескриптора файлу журналу
    logFile.printf("%lu,%.6f,%.6f,%.1f,%.1f,%d,%s,%s,%s,%.1f,%d\r\n",                   // запис повного рядка параметрів маршруту згідно зі схемою
                   (unsigned long)now, currentLat, currentLon, currentAlt,              // передача мітки часу та географічних координат з висотою
                   currentSpeedKmh, currentSats, currentAiData.currentZoneName,         // передача поточної швидкості кількості супутників та зони
                   aiEngine.getActivityName(currentAiData.activity),                    // передача назви розпізнаного стану фізичної активності
                   aiEngine.getRiskGradeName(currentAiData.riskGrade),                  // передача вербального статусу оціненого рівня небезпеки
                   currentAiData.riskScorePercent, (sosActive ? 1 : 0));                // передача числового відсотка загрози та прапорця сигналу SOS
    logFile.close();                                                                    // гарантоване закриття дескриптора файлу для збереження на диск
    aiEngine.markTrackPointLogged(currentLat, currentLon);                              // збереження координат останнього успішного запису в пам'яті
    if (!sdLoggedThisCycle || forceLog) {                                               // перевірка відсутності дублювання сповіщення у поточному періоді
      logEvent("STORAGE", "Saved filtered trackpoint into MicroSD log file");           // підтвердження збереження точки маршруту за адаптивним інтервалом
      sdLoggedThisCycle = true;                                                         // фіксація факту виведення сповіщення для запобігання дублюванню
    }                                                                                   // завершення блоку виведення повідомлення про запис точки
  } else {                                                                              // обробка збою доступу до файлової структури картки пам'яті
    logEvent("STORAGE", "Error appending trackpoint to log file");                      // фіксація помилки запису до файлу в системному журналі
  }                                                                                     // завершення гілки перевірки успішності відкриття файлу логу
}                                                                                       // завершення функції збереження точки маршруту на накопичувач

void dumpSdLogFile() {                                                                  // виведення вмісту збереженого файлу журналу маршруту у вікно термінала
  if (!sdCardReady) return;                                                             // вихід якщо зовнішній накопичувач недоступний для операцій читання
  File logFile = SD.open("/gps_log.csv", FILE_READ);                                    // відкриття накопиченого файлу журналу у режимі послідовного читання
  if (logFile) {                                                                        // перевірка успішного отримання файлового дескриптора для читання
    Serial.println();                                                                   // відступ порожнім рядком перед початком виведення вмісту файлу логу
    Serial.println("==================== [START OF GPS_LOG.CSV] ===================="); // стартовий інформаційний маркер початку даних табличного файлу
    while (logFile.available()) {                                                       // циклічне зчитування байтів файлу до досягнення його кінця
      char logByte = (char)logFile.read();                                              // зчитування чергового байта символу експедиційного журналу
      if (logByte == '\r') continue;                                                    // ігнорування службового символу повернення каретки перед переводом
      if (logByte == '\n') {                                                            // перевірка символу переводу рядка для скидання відступу ліворуч
        Serial.println();                                                               // друк переводу рядка з поверненням курсора до лівого краю
      } else {                                                                          // якщо зчитано звичайний інформаційний символ даних таблиці
        Serial.write(logByte);                                                          // потокове виведення прочитаного символу безпосередньо у консоль
      }                                                                                 // завершення блоку виведення поточного знака таблиці
    }                                                                                   // завершення циклу читання та потокового виведення символів
    logFile.close();                                                                    // закриття дескриптора файлу після завершення читання даних
    Serial.println("==================== [END OF GPS_LOG.CSV] ====================");   // фінішний інформаційний маркер завершення виведення файлу логу
    Serial.println();                                                                   // відступ порожнім рядком після виведення вмісту файлу журналу
  }                                                                                     // завершення блоку перевірки наявності відкритого файлу для читання
}                                                                                       // завершення функції експорту вмісту файлу журналу у термінал

void transmitToThingSpeak(bool isUrgent) {                                              // відправка навігаційного пакету на сервер хмарної аналітики
  if (WiFi.status() != WL_CONNECTED) {                                                  // перевірка стану з'єднання з бездротовою мережею передачі даних
    if (isUrgent) {                                                                     // якщо виникла потреба термінової передачі сигналу лиха без мережі
      logEvent("CLOUD",                                                                 // реєстрація системної мережевої події в журналі
               "WiFi disconnected. Urgent SOS coordinates buffered on SD");             // повідомлення про відсутність мережі та локальну фіксацію лиха
    }                                                                                   // завершення блоку обробки термінового повідомлення без мережі
    return;                                                                             // вихід з функції передачі через тимчасову відсутність зв'язку
  }                                                                                     // завершення перевірки наявності активного бездротового зв'язку
  HTTPClient httpClient;                                                                // створення екземпляра клієнта для виконання мережевого запиту
  char requestUrl[320];                                                                 // буфер формування повного рядка адреси із телеметричними полями
  snprintf(requestUrl, sizeof(requestUrl),                                              // безпечне наповнення рядка веб адреси параметрами телеметрії
    "%s?api_key=%s&field1=%.6f&field2=%.6f&field3=%.1f"                                 // перша частина рядка веб запису з базовими координатами
    "&field4=%.1f&field5=%d&field6=%d&field7=%.1f&field8=%d",                           // друга частина рядка з полями оцінки ризику та статусу лиха
    thingSpeakUrl, thingSpeakKey, currentLat, currentLon, currentAlt,                   // підстановка адреси ключа та базових географічних координат точки
    currentSpeedKmh, currentSats, (sosActive ? 1 : 0),                                  // підстановка швидкості числа супутників та прапорця сигналу тривоги
    currentAiData.riskScorePercent, (int)currentAiData.activity);                       // підстановка розрахованого відсотка загрози та коду типу руху
  if (httpClient.begin(requestUrl)) {                                                   // ініціалізація мережевого запиту за сформованою адресою ресурсу
    int httpCode = httpClient.GET();                                                    // виконання стандартного запиту передачі параметрів на веб сервер
    if (httpCode > 0) {                                                                 // перевірка успішності отримання відповіді від віддаленого сервера
      char responseMsg[64];                                                             // буфер формування повідомлення про код відповіді веб платформи
      snprintf(responseMsg, sizeof(responseMsg),                                        // запис числового коду результату доставки пакету у буфер
               "Telemetry packet delivered. HTTP code: %d", httpCode);                  // підстановка отриманого коду відповіді веб сервера
      logEvent("CLOUD", responseMsg);                                                   // фіксація успішної відправки пакету у системному журналі подій
    } else {                                                                            // обробка мережевого збою на етапі очікування відповіді платформи
      logEvent("CLOUD", "HTTP request error during telemetry transmission");            // повідомлення про помилку мережевого зв'язку під час передачі
    }                                                                                   // завершення блоку перевірки коду відповіді веб сервера
    httpClient.end();                                                                   // закриття клієнтського мережевого з'єднання та звільнення пам'яті
  }                                                                                     // завершення блоку ініціалізації запиту до хмарного сервісу
  lastThingSpeakSendMs = millis();                                                      // оновлення контрольного часу останньої відправки даних у хмару
}                                                                                       // завершення функції передачі телеметричного пакету на сервер

void printDataTable() {                                                                 // виведення структурованих параметрів телеметрії з вирівнюванням ліворуч
  const char* fixStr = hasGpsFix ? "FIX_OK" : "ACQUIRING";                              // визначення текстового опису стану супутникового зв'язку
  const char* activityStr = aiEngine.getActivityName(currentAiData.activity);           // текстова назва розпізнаного типу фізичної активності
  const char* riskGradeStr = aiEngine.getRiskGradeName(currentAiData.riskGrade);        // вербальний опис рівня небезпеки для диспетчера
  const char* traumaStr = currentAiData.traumaSuspected ? "SUSPECTED" : "NORMAL";       // текстовий індикатор підозри на отримання травми
  const char* sosStr = sosActive ? "ACTIVE" : "STANDBY";                                // текстовий стан готовності або активації тривожного маяка
  const char* sdStatusStr = sdCardReady ? "LOGGING ACTIVE" : "STORAGE ERROR";           // статус готовності накопичувача до запису поточної інформації
  Serial.println();                                                                     // відступ порожнім рядком перед блоком періодичних параметрів
  Serial.println("----------------------------------------");                           // верхня розділювальна лінія блоку телеметрії
  Serial.printf("GPS Fix Status:        %s\r\n", fixStr);                               // виведення статусу фіксації супутників з лівого краю
  Serial.printf("Geographic Latitude:   %.6f DEG\r\n", currentLat);                     // виведення широти у градусах з лівого краю
  Serial.printf("Geographic Longitude:  %.6f DEG\r\n", currentLon);                     // виведення довготи у градусах з лівого краю
  Serial.printf("Altitude Above Sea:    %.1f M\r\n", currentAlt);                       // виведення поточної висоти над морем з лівого краю
  Serial.printf("Ground Travel Speed:   %.1f KM/H\r\n", currentSpeedKmh);               // виведення швидкості пересування з лівого краю
  Serial.printf("Satellites Count:      %d SATS\r\n", currentSats);                     // виведення кількості супутників з лівого краю
  Serial.printf("Expedition Geozone:    %s\r\n", currentAiData.currentZoneName);        // виведення назви експедиційної зони з лівого краю
  Serial.printf("AI Motion Activity:    %s\r\n", activityStr);                          // виведення фізичного стану пересування з лівого краю
  Serial.printf("Stationary Duration:   %lu SEC\r\n",                                   // початок виведення тривалості стану спокою
                (unsigned long)currentAiData.stationaryDurationSec);                    // завершення виведення секунд перебування на місці
  Serial.printf("AI GeoRisk Score:      %.1f %%\r\n", currentAiData.riskScorePercent);  // виведення розрахованого балу ризику з лівого краю
  Serial.printf("Evaluated Risk Grade:  %s\r\n", riskGradeStr);                         // виведення ступеня небезпеки для туриста з лівого краю
  Serial.printf("Trauma Detection:      %s\r\n", traumaStr);                            // виведення вердикту моделі щодо травми з лівого краю
  Serial.printf("Emergency SOS Beacon:  %s\r\n", sosStr);                               // виведення статусу тривожного маяка з лівого краю
  Serial.printf("MicroSD Route Storage: %s\r\n", sdStatusStr);                          // виведення стану картки пам'яті з лівого краю
  Serial.println("----------------------------------------");                           // нижня розділювальна лінія блоку телеметрії
  char llmDigest[256];                                                                  // буфер формування структурованого дайджесту для мовних моделей
  aiEngine.buildLLMExplanation(currentAiData, currentLat, currentLon,                   // початок виклику генератора пояснення ситуації для диспетчера
                               llmDigest, sizeof(llmDigest));                           // завершення передачі аргументів генератора мовного звіту
  Serial.print("LLM Explanation: ");                                                    // виведення префіксу мовного висновку з лівого краю
  Serial.println(llmDigest);                                                            // виведення тексту інтелектуального висновку в термінал
  Serial.println();                                                                     // відступ порожнім рядком після завершення виведення зведення
}                                                                                       // завершення функції друку зведеної таблиці телеметрії

void setup() {                                                                          // головна початкова функція налаштування мікроконтролера та запуску системи
  Serial.begin(115200);                                                                 // старт послідовного порту для налагодження та моніторингу
  delay(250);                                                                           // коротка стабілізаційна пауза після увімкнення живлення мікроконтролера
  Serial.println();                                                                     // відступ порожнім рядком перед початком виведення стартового банера
  Serial.println("========================================");                           // верхня межа стартового заголовка проекту
  Serial.println("Smart Wilderness Safety Navigator");                                  // назва проекту суворо з лівого краю без початкових пробілів
  Serial.println("========================================");                           // нижня межа стартового заголовка проекту
  Serial.println();                                                                     // відступ порожнім рядком після завершення виведення інформаційного банера
  initializePeripherals();                                                              // виклик комплексної функції налаштування всіх периферійних вузлів
  lastTablePrintMs = millis();                                                          // ініціалізація таймера першого виведення структурованої таблиці
  lastThingSpeakSendMs = millis();                                                      // ініціалізація таймера першої відправки пакету у хмару
  lastSdLogMs = millis();                                                               // ініціалізація таймера запису першої точки треку на накопичувач
}                                                                                       // завершення головної функції початкового налаштування

void loop() {                                                                           // головний циклічний процес періодичного виконання завдань пристрою
  pollGpsModule();                                                                      // опитування потоку даних від супутникового навігаційного чіпа
  updateLedIndication();                                                                // оновлення неблокуючого автомата світлодіодної сигналізації зв'язку
  updateAudioBeacon();                                                                  // оновлення неблокуючого автомата аварійного звукового маяка
  handleSosButton();                                                                    // опитування тактової кнопки активації сигналу лиха туриста
  uint32_t now = millis();                                                              // отримання поточної системної часової мітки для планувальника завдань
  if (now - lastTablePrintMs >= 4000) {                                                 // інтервал оновлення структурованої таблиці параметрів чотири секунди
    lastTablePrintMs = now;                                                             // збереження часу чергового циклу друку параметрів телеметрії
    sdLoggedThisCycle = false;                                                          // скидання прапорця сповіщення збереження для нового циклу таблиці
    currentAiData = aiEngine.processTelemetry(                                          // передача поточних векторів вимірів у модель штучного інтелекту
      currentLat, currentLon, currentAlt, currentSpeedKmh, currentSats, sosActive);     // аргументи просторових координат швидкості супутників та тривоги
    static RiskGrade prevLoggedRisk = RISK_MINIMAL;                                     // збереження попереднього зафіксованого ступеня небезпеки маршруту
    if (currentAiData.riskGrade != prevLoggedRisk) {                                    // детекція переходу системи до нового якісного рівня загрози
      if (currentAiData.riskGrade == RISK_HAZARDOUS) {                                  // якщо зафіксовано перехід у статус підвищеної загрози безпеці
        logEvent("AI_ENGINE",                                                           // реєстрація переходу в категорію підвищеної небезпеки
                 "Elevated hazard warning detected. Fast logging active");              // попереджувальне сповіщення у журналі про прискорену фіксацію
        dumpSdLogFile();                                                                // автоматичне виведення накопиченого файлу журналу у термінал при загрозі
      } else if (currentAiData.riskGrade == RISK_CRITICAL) {                            // якщо модель визначила стан критичної небезпеки для життя
        logEvent("AI_ENGINE",                                                           // реєстрація критичного стану у системному журналі
                 "CRITICAL emergency condition detected. Alarm triggered");             // термінове сповіщення тривоги при виявленні критичної загрози
      }                                                                                 // завершення перевірки конкретного тривожного рівня загрози
      prevLoggedRisk = currentAiData.riskGrade;                                         // оновлення попереднього рівня загрози для виключення дублювання
    }                                                                                   // завершення блоку реєстрації зміни рівня небезпеки
    printDataTable();                                                                   // виклик функції форматованого друку телеметрії в термінал
  }                                                                                     // завершення часового блоку періодичного друку телеметрії
  recordTrackPointToSD(false);                                                          // виклик планового циклу збереження точок треку за адаптивним інтервалом
  if (Serial.available()) {                                                             // перевірка наявності запиту користувача у послідовному порту
    while (Serial.available()) {                                                        // вичитування черги байтів для очищення буфера після натискання
      Serial.read();                                                                    // зчитування чергового байта введеної команди термінала
    }                                                                                   // завершення циклу очищення буфера команд
    dumpSdLogFile();                                                                    // виклик експорту файлу журналу картки пам'яті у термінал
  }                                                                                     // завершення блоку реакції на введення у терміналі
  if (now - lastThingSpeakSendMs >= 15000) {                                            // мінімальний захисний інтервал публікації у хмару п'ятнадцять секунд
    lastThingSpeakSendMs = now;                                                         // оновлення контрольного часу передачі телеметрії на сервер
    transmitToThingSpeak(false);                                                        // виконання штатної відправки чергового пакету в канал аналітики
  }                                                                                     // завершення часового блоку передачі даних на хмарний сервер
  delay(10);                                                                            // коротка системна пауза для розвантаження процесорних ядер плати
}                                                                                       // завершення нескінченного циклу роботи мікроконтролера