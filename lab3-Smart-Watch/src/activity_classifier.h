#ifndef ACTIVITY_CLASSIFIER_H                     // Перевірка відсутності повторного підключення заголовного файлу
#define ACTIVITY_CLASSIFIER_H                     // Оголошення макросу захисту заголовного файлу від дублювання

#include <Arduino.h>                              // Підключення базової бібліотеки фреймворку Arduino
#include <math.h>                                 // Підключення математичної бібліотеки для розрахунку коренів та модулів

enum ActivityType                                 // Оголошення переліку типів рухової активності
{                                                 // Перелік категорій станів рухової активності користувача
  ACTIVITY_IDLE = 0,                              // Стан спокою без вираженого руху
  ACTIVITY_WALKING = 1,                           // Стан помірного переміщення або спокійної ходьби
  ACTIVITY_RUNNING = 2,                           // Стан інтенсивного динамічного руху або бігу
  ACTIVITY_FALL = 3                               // Аварійний стан раптового падіння
};                                                // Завершення переліку станів рухової активності

#define ML_WINDOW_SIZE 40                         // Розмір ковзного буфера вибірок для аналізу патернів
#define GRAVITY_MS2 9.81f                         // Базова величина прискорення вільного падіння

#define THRESH_FALL_DEVIATION 20.0f               // Поріг відхилення прискорення для детекції падіння
#define THRESH_FALL_P2P 25.0f                     // Поріг розмаху амплітуди сигналів під час удару
#define THRESH_IDLE_DEVIATION 1.5f                // Допустиме відхилення прискорення у стані спокою
#define THRESH_IDLE_GYRO 0.3f                     // Максимальний поріг кутової швидкості для нерухомості
#define THRESH_RUN_DEVIATION 5.0f                 // Мінімальне відхилення сили прискорення для режиму бігу
#define THRESH_RUN_GYRO 1.5f                      // Мінімальна кутова швидкість обертань під час бігу
#define THRESH_RUN_VARIANCE 10.0f                 // Поріг дисперсії сигналу для підтвердження інтенсивного руху

class ActivityClassifier                          // Оголошення класу класифікатора активності
{                                                 // Клас класифікатора активності на основі дерев рішень
public:                                           // Секція публічних методів для взаємодії з програмою
  ActivityClassifier()                            // Конструктор об'єкта класифікатора активності
  {                                               // Конструктор об'єкта обчислення класифікації
    reset();                                      // Виклик початкового очищення всіх буферів та показників
  }                                               // Завершення конструктора класу

  void addSample(float ax, float ay, float az,    // Заголовок методу додавання нової вибірки прискорень
                 float gx, float gy, float gz)    // Отримання значень кутової швидкості трьох просторових осей
  {                                               // Початок тіла методу запису нового зрізу даних
    _buf[_idx] = {ax, ay, az, gx, gy, gz};        // Запис отриманого вектора вимірювань у поточну позицію кільцевого буфера
    _idx = (_idx + 1) % ML_WINDOW_SIZE;           // Циклічний інкремент покажчика для перезапису найстаріших зразків
    if (_count < ML_WINDOW_SIZE)                  // Перевірка неповного заповнення кільцевого буфера
      _count++;                                   // Збільшення лічильника наповнення буфера до досягнення ліміту
    _dirty = true;                                // Встановлення прапорця необхідності перерахунку статистичних ознак
  }                                               // Завершення процедури додавання вибірки

  ActivityType classify()                             // Метод визначення поточного типу активності
  {                                                   // Метод розпізнавання поточного класу руху користувача
    if (_count < 5)                                   // Перевірка достатньої кількості вибірок для аналізу
      return ACTIVITY_IDLE;                           // Повернення стану спокою за недостатньої кількості зібраних даних

    _computeFeatures();                               // Виклик процедури виділення статистичних ознак із наявного вікна

    float deviation = fabs(_meanMag - GRAVITY_MS2);   // Розрахунок абсолютної різниці між середнім прискоренням та гравітацією

    if (deviation > THRESH_FALL_DEVIATION ||          // Перевірка перевищення порогу миттєвого відхилення при падінні
        _peakToPeak > THRESH_FALL_P2P)                // Перевірка розмаху сигналу під час падіння
    {                                                 // Перевірка перевищення критичного розмаху пікових перевантажень
      return ACTIVITY_FALL;                           // Ідентифікація аварійної ситуації падіння
    }                                                 // Завершення перевірки гілки детекції падіння

    if (deviation < THRESH_IDLE_DEVIATION &&          // Перевірка знаходження прискорення поблизу значення гравітації
        _gyroMag < THRESH_IDLE_GYRO)                  // Перевірка малої кутової швидкості у стані спокою
    {                                                 // Перевірка відсутності значних обертань тіла у просторі
      return ACTIVITY_IDLE;                           // Ідентифікація перебування користувача у стані нерухомості
    }                                                 // Завершення перевірки гілки стану спокою

    if (deviation > THRESH_RUN_DEVIATION ||           // Перевірка перевищення динамічного розгону притаманного бігу
        _gyroMag > THRESH_RUN_GYRO ||                 // Перевірка активного маху кінцівок за кутовою швидкістю
        _variance > THRESH_RUN_VARIANCE)              // Перевірка дисперсії сигналу під час інтенсивного руху
    {                                                 // Перевірка високої дисперсії амплітуди коливань сигналу
      return ACTIVITY_RUNNING;                        // Ідентифікація режиму високої рухової активності та бігу
    }                                                 // Завершення перевірки критеріїв інтенсивного руху

    return ACTIVITY_WALKING;                          // Визначення помірної активності та ходьби для проміжних значень
  }                                                   // Завершення алгоритму класифікації рухів

  float getMeanMagnitude()                            // Метод отримання середньої магнітуди прискорення
  {                                                   // Метод отримання середньої магнітуди прискорення
    _computeFeatures();                               // Оновлення розрахункових ознак за потреби
    return _meanMag;                                  // Повернення середнього значення магнітуди прискорення
  }                                                   // Завершення методу отримання середньої магнітуди
  float getDeviation()                                // Метод отримання відхилення від сили тяжіння
  {                                                   // Метод отримання відхилення від сили тяжіння
    _computeFeatures();                               // Оновлення розрахункових ознак за потреби
    return fabs(_meanMag - GRAVITY_MS2);              // Обчислення абсолютного відхилення від гравітації
  }                                                   // Повернення величини відхилення від сили тяжіння
  float getVariance()                                 // Метод отримання дисперсії прискорення
  {                                                   // Метод отримання дисперсії прискорення
    _computeFeatures();                               // Оновлення розрахункових ознак за потреби
    return _variance;                                 // Повернення розрахованої дисперсії прискорення
  }                                                   // Завершення методу отримання дисперсії
  float getPeakToPeak()                               // Метод отримання амплітудного розмаху сигналу
  {                                                   // Метод отримання амплітудного розмаху сигналу
    _computeFeatures();                               // Оновлення розрахункових ознак за потреби
    return _peakToPeak;                               // Повернення різниці між максимумом та мінімумом
  }                                                   // Завершення методу отримання амплітудного розмаху
  float getGyroMagnitude()                            // Метод отримання магнітуди кутової швидкості
  {                                                   // Метод отримання магнітуди кутової швидкості
    _computeFeatures();                               // Оновлення розрахункових ознак за потреби
    return _gyroMag;                                  // Повернення повної магнітуди кутової швидкості
  }                                                   // Завершення методу отримання магнітуди гіроскопа
  int getSampleCount() { return _count; }             // Повернення поточної кількості накопичених вибірок

  void reset()                                        // Метод повного скидання стану класифікатора
  {                                                   // Процедура повного скидання внутрішніх буферів та показників
    memset(_buf, 0, sizeof(_buf));                    // Заповнення пам'яті масиву вибірок нульовими значеннями
    _idx = 0;                                         // Скидання покажчика поточної комірки запису на початок буфера
    _count = 0;                                       // Скидання лічильника збережених вимірювань
    _dirty = true;                                    // Встановлення вимоги оновлення розрахункових величин
    _meanMag = GRAVITY_MS2;                           // Встановлення початкового середнього значення на рівень гравітації
    _variance = 0;                                    // Онулення дисперсії вибірки
    _peakToPeak = 0;                                  // Онулення амплітудного розмаху
    _gyroMag = 0;                                     // Онулення результуючої кутової швидкості
  }                                                   // Завершення процедури скидання стану класифікатора

private:                                                            // Секція закритих внутрішніх структур та полів класу
  struct Sample                                                     // Оголошення структури одного вимірювання
  {                                                                 // Опис внутрішньої структури для зберігання одного вимірювання
    float ax, ay, az;                                               // Компоненти лінійного прискорення по трьох осях
    float gx, gy, gz;                                               // Компоненти просторової кутової швидкості по трьох осях
  };                                                                // Завершення опису структури окремого зрізу

  Sample _buf[ML_WINDOW_SIZE];                                      // Кільцевий масив структур для збереження ковзного вікна даних
  int _idx = 0;                                                     // Індекс наступної вільної комірки кільцевого буфера
  int _count = 0;                                                   // Поточна кількість валідних записів у накопичувачі
  bool _dirty = true;                                               // Прапорець застарілості попередньо обчислених характеристик

  float _meanMag = GRAVITY_MS2;                                     // Змінна збереження середньої магнітуди лінійного вектора
  float _variance = 0;                                              // Змінна збереження дисперсії значень прискорення
  float _peakToPeak = 0;                                            // Змінна збереження різниці між піковими відліками у вікні
  float _gyroMag = 0;                                               // Змінна збереження усередненої величини кутової швидкості

  void _computeFeatures()                                           // Метод обчислення статистичних ознак вибірок
  {                                                                 // Процедура вилучення математичних ознак із набору відліків
    if (!_dirty)                                                    // Перевірка актуальності вже обчислених ознак
      return;                                                       // Пропуск розрахунків за відсутності надходження нових значень
    _dirty = false;                                                 // Скидання ознаки потреби перерахунку ознак

    int n = _count;                                                 // Локальна фіксація актуального обсягу заповнених вибірок
    float sumMag = 0, sumGMag = 0;                                  // Змінні накопичення сум для знаходження середніх значень
    float minMag = 1e6, maxMag = 0;                                 // Граничні змінні для пошуку мінімуму та максимуму сигналу
    float mags[ML_WINDOW_SIZE];                                     // Проміжний масив скалярних норм прискорення для обчислення дисперсії

    for (int i = 0; i < n; i++)                                     // Перебір усіх накопичених вимірювань
    {                                                               // Цикл первинного проходу по всіх наявних точках вимірювання
      const Sample &s = _buf[i];                                    // Отримання посилання на черговий збережений зразок даних

      float m = sqrtf(s.ax * s.ax + s.ay * s.ay + s.az * s.az);     // Розрахунок евклідової довжини вектора лінійного прискорення
      mags[i] = m;                                                  // Збереження знайденої норми вектора у проміжний масив
      sumMag += m;                                                  // Додавання величини повної сили до загальної суми
      if (m < minMag)                                               // Перевірка нового мінімального значення магнітуди
        minMag = m;                                                 // Фіксація нового мінімального екстремуму сигналу
      if (m > maxMag)                                               // Перевірка нового максимального значення магнітуди
        maxMag = m;                                                 // Фіксація нового максимального сплеску сигналу

      sumGMag += sqrtf(s.gx * s.gx + s.gy * s.gy + s.gz * s.gz);    // Розрахунок та додавання повної норми кутової швидкості
    }                                                               // Завершення циклу розрахунку норм та екстремумів

    _meanMag = sumMag / n;                                          // Обчислення середньої величини лінійного прискорення у вікні
    _gyroMag = sumGMag / n;                                         // Обчислення середньої величини кутової швидкості у вікні
    _peakToPeak = maxMag - minMag;                                  // Розрахунок різниці амплітуд між максимальним і мінімальним піком

    float sumVar = 0;                                               // Змінна для підсумовування квадратичних відхилень від середнього
    for (int i = 0; i < n; i++)                                     // Повторний перебір вибірок для обчислення дисперсії
    {                                                               // Цикл проходу по вибірках для визначення розсіювання даних
      float d = mags[i] - _meanMag;                                 // Знаходження відхилення окремої точки від середнього рівня
      sumVar += d * d;                                              // Додавання квадрата відхилення до загальної суми дисперсії
    }                                                               // Завершення циклу накопичення квадратичних відхилень
    _variance = sumVar / n;                                         // Отримання підсумкової статистичної дисперсії прискорень у вікні
  }                                                                 // Завершення процедури математичної екстракції ознак
};                                                                  // Завершення опису класу класифікатора
#endif                                                              // Завершення блоку умовної компіляції заголовного файлу