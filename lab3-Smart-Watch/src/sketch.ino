#include <Arduino.h>                            // Підключення базової бібліотеки фреймворку Arduino
#include <Wire.h>                               // Підключення бібліотеки для роботи з апаратною шиною I2C
#include <Adafruit_MPU6050.h>                   // Підключення бібліотеки для взаємодії з датчиком руху MPU6050
#include <Adafruit_Sensor.h>                    // Підключення уніфікованого інтерфейсу сенсорів Adafruit

#ifndef SSD1306_NO_SPLASH                       // Перевірка відсутності прапорця вимкнення заставки
#define SSD1306_NO_SPLASH                       // Вимкнення стандартного логотипу для економії пам'яті
#endif                                          // Завершення умови перевірки прапорця заставки
#include <Adafruit_SSD1306.h>                   // Підключення драйвера керування дисплеєм SSD1306
#include <Adafruit_GFX.h>                       // Підключення графічної бібліотеки для виведення зображень і шрифтів

#include <WiFi.h>                               // Підключення бібліотеки для роботи з мережею Wi-Fi

#if defined(ARDUINO_PARTITION_huge_app)         // Перевірка наявності розширеної таблиці розділів пам'яті
#define USE_BLE 1                               // Увімкнення апаратного стека BLE
#else                                           // Гілка за відсутності потрібної таблиці розділів
#define USE_BLE 0                               // Вимкнення стека BLE для запобігання переповненню флеш-пам'яті
#endif                                          // Завершення директиви перевірки розміру прошивки

#include "activity_classifier.h"                // Підключення власного класифікатора активності TinyML

const char *WIFI_SSID = "Wokwi-GUEST";          // Назва точки доступу бездротової мережі Wi-Fi
const char *WIFI_PASS = "";                     // Пароль для автентифікації у бездротовій мережі

const char *TS_API_KEY = "TLIBYJC7DINOOQHR";    // Ключ запису для хмарного сервісу ThingSpeak
const char *TS_HOST = "api.thingspeak.com";     // Мережева адреса хоста хмарного сервера
const unsigned long TS_INTERVAL = 16000;        // Інтервал передачі пакетів телеметрії в мілісекундах

#define PIN_BUTTON 15                           // Номер виводу підключення тактової кнопки
#define PIN_I2C_SDA 21                          // Номер виводу лінії даних шини I2C
#define PIN_I2C_SCL 22                          // Номер виводу тактового сигналу шини I2C
#define PIN_MAX30102_INT 34                     // Номер виводу апаратного переривання сенсора пульсу

#define SCREEN_WIDTH 128                        // Ширина дисплея OLED у пікселях
#define SCREEN_HEIGHT 64                        // Висота дисплея OLED у пікселях
#define OLED_ADDR 0x3C                          // Апаратна адреса дисплея на шині I2C

#define BLE_DEVICE_NAME "ActivityTracker"                     // Мережеве ім'я пристрою для пошуку по BLE
#define BLE_SERVICE_UUID "4fafc201-1fb5-459e-8fcc-c5c9c331914b"     // Унікальний ідентифікатор основного сервісу BLE

Adafruit_MPU6050 mpu;                                               // Створення об'єкта драйвера інерційного модуля MPU6050
Adafruit_SSD1306 oled(SCREEN_WIDTH, SCREEN_HEIGHT, &Wire, -1);      // Створення екземпляра дисплея із заданою роздільною здатністю
ActivityClassifier classifier;                                      // Створення екземпляра інтелектуального класифікатора активності

bool oledAvailable = false;                                   // Прапорець успішної ініціалізації екрана
bool mpuAvailable = false;                                    // Прапорець доступності модуля акселерометра та гіроскопа
bool wifiConnected = false;                                   // Прапорець наявності з'єднання з бездротовою мережею
bool bleActive = false;                                       // Прапорець активності стека бездротової передачі BLE

float ax = 0, ay = 0, az = 9.81f;                             // Змінні прискорення по трьох просторових осях
float gx = 0, gy = 0, gz = 0;                                 // Змінні кутової швидкості обертання навколо осей
float mpuTemp = 24.0f;                                        // Змінна поточної температури кристала датчика
float accelMag = 9.81f;                                       // Повна результуюча магнітуда вектора прискорення
float gyroMag = 0.0f;                                         // Повна результуюча магнітуда вектора кутової швидкості

int heartRate = 72;                                           // Поточне значення частоти серцевих скорочень

#if USE_BLE                                                   // Умовний блок оголошення покажчиків сервера BLE
BLEServer *pServer = nullptr;                                 // Покажчик на екземпляр сервера бездротового зв'язку
BLECharacteristic *pActivityCharacteristic = nullptr;         // Покажчик на характеристику передачі активності
BLECharacteristic *pHeartRateCharacteristic = nullptr;        // Покажчик на характеристику передачі пульсу
#endif                                                        // Завершення блоку покажчиків сервера

ActivityType activity = ACTIVITY_IDLE;                        // Змінна збереження поточного типу розпізнаного руху

int screenIdx = 0;                                            // Індекс поточного активного вікна інтерфейсу на дисплеї
bool lastBtnState = HIGH;                                     // Попередній зафіксований логічний стан контакту кнопки
unsigned long lastBtnMs = 0;                                  // Часова мітка останнього натискання кнопки для антибрязкоту

unsigned long lastSensorMs = 0;                               // Часова мітка останнього опитування датчиків
unsigned long lastDisplayMs = 0;                              // Часова мітка останнього оновлення кадрів дисплея
unsigned long lastTsSendMs = 0;                               // Часова мітка останньої успішної відправки на сервер
unsigned long lastSerialMs = 0;                               // Часова мітка останнього виведення даних у термінал
unsigned long lastTipChangeMs = 0;                            // Часова мітка циклічної зміни енергетичної поради
unsigned long sensorInterval = 100;                           // Поточний динамічний період опитування вимірювачів

const char *energyTips[] = {                                  // Масив рядків із рекомендаціями оптимізації енергоспоживання
    "IDLE detected:\n CPU Light Sleep\n saves ~60% power",    // Текст першої рекомендації щодо економії
    "Low activity:\n BLE adv 1s->4s\n saves ~40mA",           // Текст другої рекомендації щодо радіотракту
    "No motion 30s:\n Deep Sleep mode\n wake on MPU INT",     // Текст третьої рекомендації глибокого сну
    "Batch sends:\n ThingSpeak 1/min\n saves WiFi power",     // Текст четвертої рекомендації пакетної передачі
    "Dim OLED 50%:\n in IDLE mode\n saves ~10mA",             // Текст п'ятої рекомендації яскравості екрана
    "MPU6050 standby:\n when IDLE >60s\n wake on accel",      // Текст шостої рекомендації режиму очікування сенсора
    "RUNNING mode:\n max sample rate\n for ML accuracy",      // Текст сьомої рекомендації підвищення частоти зрізів
    "Disable WiFi:\n when BLE active\n shared antenna"        // Текст восьмої рекомендації чергування антен
};                                                            // Завершення списку текстових рекомендацій

const int NUM_TIPS = 8;                               // Загальна кількість сформованих енергетичних рекомендацій
int tipIdx = 0;                                       // Поточний порядковий номер відображуваної поради

const char *activityName(ActivityType a)              // Функція перетворення числового типу активності в рядок
{                                                     // Відкриття функції перетворення типу активності
  switch (a)                                          // Оператор вибору гілки відповідно до стану активності
  {                                                   // Відкриття блоку вибору типу активності
  case ACTIVITY_IDLE:                                 // Обробка стану спокою
    return "IDLE";                                    // Повернення текстового імені стану спокою
  case ACTIVITY_WALKING:                              // Обробка стану ходьби
    return "WALKING";                                 // Повернення текстового імені стану повільної ходьби
  case ACTIVITY_RUNNING:                              // Обробка стану бігу
    return "RUNNING";                                 // Повернення текстового імені стану інтенсивного бігу
  case ACTIVITY_FALL:                                 // Обробка стану падіння
    return "!! FALL !!";                              // Повернення тривожного повідомлення детекції падіння
  default:                                            // Обробка невідомого типу активності
    return "UNKNOWN";                                 // Повернення статусу неідентифікованого руху
  }                                                   // Завершення перемикача вибору імені активності
}                                                     // Завершення функції перетворення типу активності

void initOLED()                                       // Функція початкового налаштування та запуску дисплея
{                                                     // Відкриття процедури ініціалізації дисплея
  if (!oled.begin(SSD1306_SWITCHCAPVCC, OLED_ADDR))   // Спроба запуску контролера дисплея на шині
  {                                                   // Відкриття блоку обробки помилки запуску дисплея
    Serial.println(F("\r[OLED] Init FAILED"));        // Повідомлення в термінал про помилку ініціалізації
    oledAvailable = false;                            // Фіксація апаратного збою інтерфейсу виведення
    return;                                           // Дострокове переривання функції при помилці зв'язку
  }                                                   // Завершення блоку обробки невдалої ініціалізації дисплея
  oledAvailable = true;                               // Встановлення статусу повної готовності екрана
  oled.clearDisplay();                                // Очищення буфера пам'яті графічного адаптера
  oled.setTextSize(1);                                // Встановлення базового масштабу графічного шрифту
  oled.setTextColor(SSD1306_WHITE);                   // Встановлення білого монохромного кольору відображення
  oled.setCursor(10, 20);                             // Переміщення курсора у стартові координати заголовка
  oled.println(F("Activity Tracker"));                // Виведення стартової назви розробленої системи
  oled.setCursor(20, 35);                             // Встановлення координат підрядка стану запуску
  oled.println(F("Starting..."));                     // Виведення інформаційного повідомлення завантаження
  oled.display();                                     // Запис вмісту кадрового буфера безпосередньо в дисплей
  Serial.println(F("\r[OLED] OK (128x64 I2C)"));      // Звіт у термінал про успішний старт модуля дисплея
}                                                     // Завершення процедури ініціалізації дисплея

void initMPU()                                        // Функція конфігурування модуля датчика прискорення та гіроскопа
{                                                     // Відкриття процедури налаштування сенсора руху
  if (!mpu.begin())                                   // Перевірка успішності запуску сенсора
  {                                                                                 // Спроба виявлення та запуску сенсора на шині даних
    Serial.println(F("\r[MPU6050] Init FAILED! Using fallback motion values."));    // Виведення попередження про відсутність зв'язку
    mpuAvailable = false;                                                           // Перехід на використання програмних значень руху
    return;                                                                         // Достроковий вихід із процедури налаштування сенсора
  }                                                                                 // Завершення обробки відсутності модуля сенсора
  mpuAvailable = true;                                                              // Фіксація коректного старту апаратного вимірювача
  mpu.setAccelerometerRange(MPU6050_RANGE_8_G);                                     // Налаштування діапазону вимірювання прискорень
  mpu.setGyroRange(MPU6050_RANGE_500_DEG);                                          // Налаштування шкали вимірювання кутової швидкості
  mpu.setFilterBandwidth(MPU6050_BAND_21_HZ);                                       // Конфігурація смуги пропускання низькочастотного фільтра
  Serial.println(F("\r[MPU6050] OK (8G / 500dps / 21Hz)"));                         // Виведення підтвердження встановлення параметрів датчика
}                                                                                   // Завершення процедури налаштування сенсора руху

void initBLE() {                                                                    // Процедура програмної ініціалізації служби бездротового зв'язку
  bleActive = true;                                                                 // Встановлення прапорця готовності та активації модуля зв'язку
  Serial.println(F("\r[BLE] Service Initialized: " BLE_SERVICE_UUID));              // Виведення ідентифікатора зареєстрованого сервісу в консоль
  Serial.println(F("\r[BLE] Advertising started as '" BLE_DEVICE_NAME "'"));        // Виведення повідомлення про початок трансляції імені пристрою
}                                                                                   // Завершення процедури конфігурації бездротової служби                                                                                           // Завершення процедури конфігурування модуля зв'язку BLE

void initWiFi()                                           // Функція встановлення підключення до локальної мережі Wi-Fi
{                                                         // Функція встановлення підключення до локальної мережі Wi-Fi
  Serial.print(F("\r[WiFi] Connecting to "));             // Друк тексту спроби встановлення бездротового зв'язку
  Serial.print(WIFI_SSID);                                // Друк імені точки доступу в рядок консолі
  WiFi.mode(WIFI_STA);                                    // Переведення радіомодуля в режим клієнтської станції
  WiFi.begin(WIFI_SSID, WIFI_PASS);                       // Надсилання запиту асоціації до бездротової точки

  int tries = 0;                                          // Лічильник кількості здійснених спроб підключення
  while (WiFi.status() != WL_CONNECTED && tries < 15)     // Цикл очікування авторизації з обмеженням спроб
  {                                                       // Відкриття блоку очікування підключення
    delay(400);                                           // Затримка між перевірками результату з'єднання
    Serial.print(F("."));                                 // Відображення індикатора процесу встановлення зв'язку
    tries++;                                              // Інкремент кількості зроблених спроб
  }                                                       // Завершення циклічного опитування стану з'єднання

  Serial.println();                                       // Друк символу переводу рядка після серії крапок
  if (WiFi.status() == WL_CONNECTED)                      // Перевірка успішності підключення до мережі
  {                                                       // Перевірка успішності авторизації в бездротовій мережі
    wifiConnected = true;                                 // Фіксація встановлення зв'язку з локальною мережею
    Serial.print(F("\r[WiFi] Connected! IP: "));          // Друк підтвердження отримання внутрішньої адреси
    Serial.println(WiFi.localIP().toString());            // Виведення виділеної динамічної мережевої IP адреси
  }                                                       // Завершення обробки успішного підключення
  else                                                    // Обробка режиму без активної мережі
  {                                                       // Гілка за відсутності встановленого з'єднання
    Serial.println(F("\r[WiFi] Offline mode enabled"));   // Переведення системи в автономний локальний режим
  }                                                       // Завершення перевірки стану мережевого з'єднання
}                                                         // Завершення процедури запуску зв'язку Wi-Fi

void readSensors()                                        // Процедура вибірки та обробки телеметричних сигналів
{                                                         // Процедура вибірки та обробки телеметричних сигналів
  sensors_event_t a, g, t;                                // Структури даних для зберігання отриманих векторів вимірювань
  if (mpuAvailable)                                       // Перевірка доступності реального сенсора
  {                                                       // Перевірка активності реального апаратного сенсора
    mpu.getEvent(&a, &g, &t);                             // Зчитування останніх подій сенсорів із регістрів пристрою
    ax = a.acceleration.x;                                // Фіксація миттєвої проєкції лінійного прискорення на вісь X
    ay = a.acceleration.y;                                // Фіксація миттєвої проєкції лінійного прискорення на вісь Y
    az = a.acceleration.z;                                // Фіксація миттєвої проєкції лінійного прискорення на вісь Z
    gx = g.gyro.x;                                        // Фіксація швидкості радіального обертання навколо осі X
    gy = g.gyro.y;                                        // Фіксація швидкості радіального обертання навколо осі Y
    gz = g.gyro.z;                                        // Фіксація швидкості радіального обертання навколо осі Z
    mpuTemp = t.temperature;                              // Фіксація внутрішньої температури чутливого елемента

    accelMag = sqrtf(ax * ax + ay * ay + az * az);        // Розрахунок скалярної евклідової норми лінійного прискорення
    gyroMag = sqrtf(gx * gx + gy * gy + gz * gz);         // Розрахунок повної магнітуди вектора кутової швидкості
  }                                                       // Завершення зчитування апаратних вимірювань
  else                                                    // Перехід до резервних значень без сенсора
  {                                                       // Гілка генерації умовних даних за відсутності сенсора
    ax = 0.1f;                                            // Встановлення резервного прискорення по осі X
    ay = 0.2f;                                            // Встановлення резервного прискорення по осі Y
    az = 9.81f;                                           // Присвоєння базових координат статичної гравітації
    gx = 0.01f;                                           // Встановлення резервної кутової швидкості по осі X
    gy = 0.01f;                                           // Встановлення резервної кутової швидкості по осі Y
    gz = 0.0f;                                            // Присвоєння нульових швидкостей кутового дрейфу
    accelMag = 9.81f;                                     // Встановлення магнітуди прискорення вільного падіння
    gyroMag = 0.02f;                                      // Встановлення базового шуму кутової швидкості
  }                                                       // Завершення блоку отримання просторових векторів

  switch (activity)                                       // Вибір діапазону частоти пульсу залежно від активності
  {                                                       // Відкриття блоку вибору діапазону пульсу
  case ACTIVITY_IDLE:                                     // Обробка пульсу у стані спокою
    heartRate = 70 + (rand() % 10);                       // Генерація значень частоти серцебиття для спокою
    break;                                                // Завершення обробки стану спокою
  case ACTIVITY_WALKING:                                  // Обробка пульсу під час ходьби
    heartRate = 90 + (rand() % 15);                       // Генерація значень частоти серцебиття для ходьби
    break;                                                // Генерація значень частоти серцебиття для ходьби
  case ACTIVITY_RUNNING:                                  // Обробка пульсу під час бігу
    heartRate = 140 + (rand() % 20);                      // Генерація пульсу високої інтенсивності для бігу
    break;                                                // Генерація пульсу високої інтенсивності для бігу
  case ACTIVITY_FALL:                                     // Обробка пульсу під час падіння
    heartRate = 160 + (rand() % 20);                      // Формування показників тахікардії в момент падіння
    break;                                                // Формування показників тахікардії в момент падіння
  default:                                                // Обробка невизначеного стану активності
    heartRate = 75;                                       // Присвоєння нормальної середньої величини пульсу
  }                                                       // Завершення моделювання фізіологічного відгуку пульсометра
}                                                         // Завершення процедури опитування та моделювання даних

void drawDashboard()                              // Функція промальовування головного інформаційного екрана
{                                                 // Функція промальовування головного інформаційного екрана
  oled.clearDisplay();                            // Повне скидання попередніх пікселів у буфері екрана
  oled.setTextSize(1);                            // Встановлення стандартного розміру шрифту для шапки
  oled.setCursor(0, 0);                           // Позиціювання друку у верхній лівий кут екрана
  oled.println(F("-- Activity Tracker --"));      // Відображення головного заголовка робочого екрана

  oled.setTextSize(2);                            // Перемикання на подвійний шрифт для виділення результату
  oled.setCursor(0, 12);                          // Зсув друку для виведення статусу визначеного руху
  oled.println(activityName(activity));           // Виведення назви розпізнаної моделі активності

  oled.setTextSize(1);                            // Повернення шрифту до стандартного компактного розміру
  oled.setCursor(0, 32);                          // Перехід курсора на позицію відображення біометрії
  oled.printf("HR: %d BPM\n", heartRate);         // Відображення поточної частоти ударів серця
  oled.printf("Accel: %.1f m/s2\n", accelMag);    // Відображення повної розрахованої магнітуди прискорення

  oled.drawLine(0, 52, 127, 52, SSD1306_WHITE);                                                     // Проведення горизонтальної роздільної лінії інтерфейсу
  oled.setCursor(0, 55);                                                                            // Перехід у нижній статусно-навігаційний рядок
  oled.printf("BLE:%s WiFi:%s [1/3]", bleActive ? "ADV" : "OFF", wifiConnected ? "ON" : "OFF");     // Відображення стану зв'язку та номера сторінки
  oled.display();                                                                                   // Оновлення зображення на фізичній матриці дисплея
}                                                                                                   // Завершення відображення головного вікна

void drawSensors()                                        // Функція виведення первинних нескоригованих даних вимірювачів
{                                                         // Функція виведення первинних нескоригованих даних вимірювачів
  oled.clearDisplay();                                    // Очищення робочої площини перед виведенням інформації
  oled.setTextSize(1);                                    // Встановлення мінімального масштабу тексту для щільного компонування
  oled.setCursor(0, 0);                                   // Встановлення початкової точки для виведення назви сторінки
  oled.println(F("--- RAW SENSORS ---"));                 // Виведення верхнього маркувального підпису вікна
  oled.setCursor(0, 12);                                  // Позиціювання для друку прискорень по осях X та Y
  oled.printf("AX:%+5.1f AY:%+5.1f", ax, ay);             // Форматований друк поточних значень бічного прискорення
  oled.setCursor(0, 22);                                  // Перехід на рядок для осі Z та результуючої норми
  oled.printf("AZ:%+5.1f |A|:%.1f", az, accelMag);        // Виведення вертикального прискорення та евклідової магнітуди
  oled.setCursor(0, 34);                                  // Перехід на лінію відображення кутових швидкостей гіроскопа
  oled.printf("GX:%+5.1f GY:%+5.1f", gx, gy);             // Форматований вивід кутових швидкостей навколо осей X та Y
  oled.setCursor(0, 44);                                  // Перехід на друк обертання навколо Z та повної кутової норми
  oled.printf("GZ:%+5.1f |G|:%.1f", gz, gyroMag);         // Виведення обертання навколо Z та повної кутової магнітуди
  oled.drawLine(0, 52, 127, 52, SSD1306_WHITE);           // Проведення нижньої роздільної лінії інтерфейсу
  oled.setCursor(0, 55);                                  // Встановлення друку у підвал навігаційної смуги
  oled.printf("T:%.0fC HR:%d [2/3]", mpuTemp, heartRate); // Відображення температури, пульсу та індексу сторінки
  oled.display();                                         // Відображення оновленої графічної інформації на екрані
}                                                         // Завершення процедури малювання екрана сирих значень

void drawEnergy()                                         // Функція промальовування вікна рекомендацій енергозбереження
{                                                         // Функція промальовування вікна рекомендацій енергозбереження
  oled.clearDisplay();                                    // Очищення буфера пам'яті матриці дисплея
  oled.setTextSize(1);                                    // Встановлення системного шрифту одиничного розміру
  oled.setCursor(0, 0);                                   // Переміщення на верхню границю графічного поля
  oled.println(F("--- AI ENERGY TIP ---"));               // Виведення заголовка модуля порад енергоспоживання
  oled.setCursor(0, 10);                                  // Перехід на рядок відліку поточної поради
  oled.printf("(%d/%d)", tipIdx + 1, NUM_TIPS);           // Відображення номера поточної активної поради
  oled.setCursor(0, 22);                                  // Позиціювання курсора у блок виведення тексту поради
  oled.println(energyTips[tipIdx]);                       // Друк тексту рекомендації з вибраного індексу масиву
  oled.drawLine(0, 52, 127, 52, SSD1306_WHITE);           // Формування роздільної смуги над підвалом екрана
  oled.setCursor(0, 55);                                  // Перехід курсора на інформаційну смугу статусу
  oled.printf("Rate:%lums [3/3]", sensorInterval);        // Відображення поточного інтервалу опитування та індексу меню
  oled.display();                                         // Відображення сформованого кадру порад на екрані
}                                                         // Завершення малювання вікна порад оптимізації

void updateDisplay()                           // Селектор вибору потрібного кадру відображення
{                                              // Відкриття селектора вибору кадру відображення
  if (!oledAvailable)                          // Перевірка доступності дисплея
    return;                                    // Блокування оновлення за відсутності зв'язку з екраном
  switch (screenIdx)                           // Вибір активного екрана за його індексом
  {                                            // Перемикання процедури малювання за індексом активного вікна
  case 0:                                      // Вибір головного екрана
    drawDashboard();                           // Відмальовування головного екрана
    break;                                     // Виклик відмальовки основного вікна моніторингу
  case 1:                                      // Вибір екрана сирих сенсорних даних
    drawSensors();                             // Відмальовування даних сенсорів
    break;                                     // Виклик процедури детальних вимірювань сенсорів
  case 2:                                      // Вибір екрана енергетичних порад
    drawEnergy();                              // Відмальовування енергетичних порад
    break;                                     // Виклик процедури виведення аналітики живлення
  }                                            // Завершення вибору вікна користувацького інтерфейсу
}                                              // Завершення головного диспетчера оновлення дисплея

void handleButton()                            // Функція реєстрації натискань тактової кнопки
{                                              // Відкриття процедури обробки натискань кнопки
  bool state = digitalRead(PIN_BUTTON);        // Зчитування поточного логічного рівня з контакту кнопки
  unsigned long now = millis();                // Отримання поточного значення системного лічильника мілісекунд

  if (state == LOW && lastBtnState == HIGH && (now - lastBtnMs > 250))        // Перевірка натискання з антибрязкотом
  {                                                                           // Перевірка спаду фронту сигналу із захистом від брязкоту
    screenIdx = (screenIdx + 1) % 3;                                          // Циклічне перемикання індексу сторінки в діапазоні від нуля до двох
    lastBtnMs = now;                                                          // Оновлення мітки часу останнього підтвердженого перемикання
    Serial.printf("\r[UI] Screen switched to -> %d/3\r\n", screenIdx + 1);    // Друк повідомлення про номер відкритого екрана
  }                                                                           // Завершення обробки підтвердженої дії перемикання
  lastBtnState = state;                                                       // Збереження поточного рівня контакту для наступного кроку порівняння
}                                                                             // Завершення обробки подій кнопки перемикання

void updateBLE() {                                                                                // Процедура періодичної передачі сповіщень спостерігачам
  if (!bleActive) return;                                                                         // Переривання виконання за умови неактивного стану радіотракту
  static unsigned long lastBleUpdate = 0;                                                         // Збереження часу відправки попереднього пакета між викликами
  if (millis() - lastBleUpdate > 1000) {                                                          // Перевірка настання інтервалу передачі тривалістю в одну секунду
    Serial.printf("\r[BLE NOTIFY] Act: %s | HR: %d BPM\r\n", activityName(activity), heartRate);  // Форматований вивід поточної активності та пульсу в консоль
    lastBleUpdate = millis();                                                                     // Оновлення часової позначки останньої успішної трансляції пакета
  }                                                                                               // Завершення блоку перевірки секундного інтервалу
}                                                                                                 // Завершення процедури періодичної передачі пакетів

void sendToThingSpeak()                                                         // Функція пакетної відправки метрик на хмарну платформу ThingSpeak
{                                                                               // Відкриття процедури передачі метрик у ThingSpeak
  if (!wifiConnected || WiFi.status() != WL_CONNECTED)                          // Перевірка активності бездротового з'єднання
    return;                                                                     // Переривання запиту за відсутності активного бездротового з'єднання

  WiFiClient client;                                                            // Створення клієнтського сокету для низькорівневого мережевого обміну
  if (!client.connect(TS_HOST, 80))                                             // Перевірка встановлення TCP з'єднання з сервером
  {                                                                             // Відкриття прямого TCP з'єднання до порту веб-сервера
    Serial.println(F("\r[ThingSpeak] connect failed"));                         // Виведення помилки за неможливості з'єднатися з хостом
    return;                                                                     // Дострокове завершення функції при невдалому підключенні
  }                                                                             // Завершення перевірки статусу підключення клієнта

  char path[160];                                                               // Буфер формування рядка запиту та передачі параметрів
  snprintf(path, sizeof(path),                                                  // Безпечне форматування адресного рядка із заповненням телеметрії
           "/update?api_key=%s&field1=%d&field2=%d&field3=%.2f&field4=%.2f",    // Шаблон заповнення полів телеметрії через параметри адреси
           TS_API_KEY, (int)activity, heartRate, accelMag, gyroMag);            // Передача ключа запису, типу активності, пульсу та сил прискорення

  client.printf("GET %s HTTP/1.0\r\nHost: %s\r\nConnection: close\r\n\r\n",     // Генерація заголовків стандартного запиту HTTP GET
                path, TS_HOST);                                                 // Підстановка сформованого шляху та імені цільового віддаленого сервера

  unsigned long start = millis();                                               // Засікання моменту початку очікування підтвердження відповіді
  while (client.connected() && millis() - start < 2000)                         // Очікування відповіді сервера з таймаутом
  {                                                                             // Цикл зчитування даних відповіді із двосекундним таймаутом
    while (client.available())                                                  // Перевірка наявності байтів у мережевому буфері
    {                                                                           // Зчитування вхідних байтів із мережевого буфера
      client.read();                                                            // Вичитування байта відповіді для повного очищення сокету
    }                                                                           // Завершення очищення доступного мережевого буфера
  }                                                                             // Завершення очікування закриття з'єднання сервером
  client.stop();                                                                // Примусовий розрив встановленого локального TCP з'єднання
  Serial.println(F("\r[ThingSpeak] telemetry published"));                      // Виведення підтвердження про передачу полів спостереження
}                                                                               // Завершення процедури надсилання даних у хмару

void updateEnergyAdvisor()                     // Функція оптимізації періоду роботи системи за порадами ШІ
{                                              // Відкриття процедури оптимізації періоду вимірювань
  unsigned long now = millis();                // Зчитування поточного часу роботи мікроконтролера
  if (now - lastTipChangeMs > 5000)            // Перевірка часу зміни поточної енергетичної поради
  {                                            // Перевірка настання інтервалу зміни поточної поради
    tipIdx = (tipIdx + 1) % NUM_TIPS;          // Інкремент покажчика для переходу до наступної поради в списку
    lastTipChangeMs = now;                     // Оновлення часу попередньої зміни активної поради
  }                                            // Завершення процедури циклічного перебору порад

  switch (activity)                            // Вибір періоду опитування за рівнем активності
  {                                            // Вибір періоду опитування сенсорів відповідно до рівня активності
  case ACTIVITY_IDLE:                          // Вибір режиму вимірювань для стану спокою
    sensorInterval = 500;                      // Встановлення півсекундного інтервалу опитування
    break;                                     // Збільшення паузи опитування до половини секунди у стані спокою
  case ACTIVITY_WALKING:                       // Вибір режиму вимірювань для ходьби
    sensorInterval = 200;                      // Встановлення помірного інтервалу опитування
    break;                                     // Встановлення помірного періоду опитування у стані ходьби
  case ACTIVITY_RUNNING:                       // Вибір режиму вимірювань для бігу
    sensorInterval = 100;                      // Встановлення частого інтервалу опитування
    break;                                     // Підвищення частоти вимірювань для точної фіксації бігу
  case ACTIVITY_FALL:                          // Вибір аварійного режиму вимірювань
    sensorInterval = 50;                       // Встановлення максимальної частоти опитування
    break;                                     // Максимальна частота дискретизації для аналізу аварійного падіння
  }                                            // Завершення динамічного регулювання інтервалу опитування датчиків
}                                              // Завершення блоку оптимізації режиму живлення

void setup()                                   // Головна процедура первинної конфігурації системи
{                                              // Відкриття процедури первинної конфігурації системи
  Serial.begin(115200);                        // Ініціалізація послідовного порту для обміну даними на швидкості 115200 біт на секунду
  delay(1000);                                 // Затримка для стабілізації перехідних процесів живлення

  Serial.println(F("\r================================="));                   // Виведення верхньої рамки початкового привітання
  Serial.println(F("\r Activity Tracker"));                                   // Виведення назви розробленого пристрою
  Serial.println(F("\r================================="));                   // Виведення нижньої рамки початкового привітання

  pinMode(PIN_BUTTON, INPUT_PULLUP);                                          // Конфігурація контакту кнопки на вхід із внутрішньою підтяжкою до живлення
  Wire.begin(PIN_I2C_SDA, PIN_I2C_SCL);                                       // Старт апаратного контролера шини I2C на відповідних контактах

  initOLED();                                                                 // Виклик процедури запуску та базової розмітки екрана
  initMPU();                                                                  // Виклик процедури виявлення та налаштування сенсора прискорень
  initBLE();                                                                  // Виклик процедури розгортання бездротових сервісів передачі BLE
  initWiFi();                                                                 // Виклик процедури авторизації в локальній мережі Wi-Fi

  Serial.println(F("\r[SYSTEM] Ready!"));                                     // Сповіщення про завершення ініціалізації та повну готовність пристрою
}                                                                             // Завершення стартової процедури конфігурації

void loop()                                                                   // Головний нескінченний цикл роботи керуючої програми
{                                                                             // Відкриття головного циклу роботи програми
  unsigned long now = millis();                                               // Отримання поточної системної часової позначки

  handleButton();                                                             // Опитування стану тактової кнопки зміни поточного екрана

  if (now - lastSensorMs >= sensorInterval)                                   // Перевірка настання періоду опитування сенсорів
  {                                                                           // Перевірка настання періоду опитування вимірювальних пристроїв
    readSensors();                                                            // Зчитування поточних значень просторових сенсорів та пульсу

    classifier.addSample(ax, ay, az, gx, gy, gz);                             // Додавання нового вектора вимірювань у ковзне вікно класифікатора
    activity = classifier.classify();                                         // Запуск аналізу моделі TinyML для визначення поточного типу активності

    updateEnergyAdvisor();                                                    // Оновлення параметрів періоду вимірювань та порад оптимізації
    updateBLE();                                                              // Оновлення та трансляція свіжих показників через канал BLE
    lastSensorMs = now;                                                       // Оновлення часової позначки останнього вимірювання
  }                                                                           // Завершення періодичного циклу вимірювання та обробки рухів

  if (now - lastDisplayMs >= 100)                                             // Перевірка необхідності оновлення дисплея
  {                                                                           // Перевірка необхідності формування нового кадру на екрані
    updateDisplay();                                                          // Промальовування актуального вмісту на дисплеї
    lastDisplayMs = now;                                                      // Оновлення часової позначки виведення кадру
  }                                                                           // Завершення циклу періодичного оновлення екрана

  if (now - lastSerialMs >= 1000)                                                                         // Перевірка настання періоду виведення стану
  {                                                                                                       // Перевірка настання періоду щосекундного виведення стану
    Serial.printf("\r[STATE] Act: %-9s | HR: %3d | Accel: %5.2f | Gyro: %5.2f | Interval: %lums\r\n",     // Форматований друк телеметрії в термінал
                  activityName(activity), heartRate, accelMag, gyroMag, sensorInterval);                  // Підстановка змінних активності, пульсу, магнітуд та інтервалу
    lastSerialMs = now;                                                                                   // Оновлення часової позначки останнього друку в термінал
  }                                                                                                       // Завершення блоку щосекундного текстового моніторингу

  if (now - lastTsSendMs >= TS_INTERVAL)       // Перевірка необхідності передачі даних у хмару
  {                                            // Перевірка необхідності чергової вигрузки в хмару
    sendToThingSpeak();                        // Відправка сформованого пакета на сервер ThingSpeak
    lastTsSendMs = now;                        // Оновлення часової позначки попереднього мережевого запиту
  }                                            // Завершення блоку відправки хмарної телеметрії
  delay(10);                                   // Коротка апаратна пауза для розвантаження диспетчера задач
}                                              // Завершення головного нескінченного циклу програми