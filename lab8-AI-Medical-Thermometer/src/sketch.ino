#include <OneWire.h>                                        // Підключення бібліотеки для роботи з протоколом один дріт
#include <DallasTemperature.h>                              // Підключення бібліотеки для цифрового термометра
#include <Wire.h>                                           // Підключення бібліотеки апаратного інтерфейсу дві лінії
#include <LiquidCrystal_I2C.h>                              // Підключення бібліотеки текстового рідкокристалічного дисплея
#include <WiFi.h>                                           // Підключення бібліотеки бездротової мережі мікроконтролера
#include <HTTPClient.h>                                     // Підключення бібліотеки клієнта мережевих запитів
#include "ai_logic.h"                                       // Підключення власного модуля алгоритмів штучного інтелекту

const char *SSID = "Wokwi-GUEST";                           // Назва бездротової мережі для симулятора
const char *PASSWORD = "";                                  // Пароль бездротової мережі симулятора
const char *API_KEY = "38FGN9WBRCZHWHQK";                   // Ключ доступу до каналу хмарного сховища
const char *SERVER = "http://api.thingspeak.com/update";    // Адреса сервера оновлення показників у хмарі
const unsigned long THINGSPEAK_INTERVAL = 20000;            // Інтервал передачі пакетів у хмару двадцять секунд

#define ONE_WIRE_BUS 14                                     // Номер виводу підключення шини передачі даних сенсора
#define RELAY_PIN 25                                        // Номер виводу керування модулем силового реле
#define LED_PIN 2                                           // Номер виводу вбудованого світлодіода сигналізації
#define SDA_PIN 21                                          // Номер виводу лінії даних шини екрана
#define SCL_PIN 22                                          // Номер виводу лінії тактування шини екрана
#define MEASUREMENT_INTERVAL 1000                           // Інтервал опитування сенсора одна секунда
#define BAUD_RATE 115200                                    // Швидкість передачі даних через послідовний порт

OneWire oneWire(ONE_WIRE_BUS);                              // Створення екземпляра керування шиною один дріт
DallasTemperature sensors(&oneWire);                        // Створення об'єкта сенсора на основі шини
LiquidCrystal_I2C lcd(0x27, 16, 2);                         // Створення об'єкта дисплея за адресою шини
AIAnomalyDetector aiDetector;                               // Створення об'єкта аналізатора аномалій штучного інтелекту
unsigned long lastMeasurementTime = 0;                      // Часова мітка попереднього вимірювання температури
float currentTemperature = 36.6;                            // Поточне розрахункове значення температури
float rawTemperature = 36.6;                                // Сире значення температури безпосередньо з сенсора
bool relayState = false;                                    // Логічна змінна поточного стану реле
unsigned long measurementCount = 0;                         // Лічильник загальної кількості проведених замірів
unsigned long last_cloud = 0;                               // Часова мітка попередньої відправки даних у хмару
bool wifi_ok = false;                                       // Прапорець успішного встановлення мережевого з'єднання
bool manualMode = false;                                    // Прапорець активації ручного режиму керування

void connectWiFi();                                         // Оголошення функції встановлення з'єднання з мережею
void displayDataOnLCD();                                    // Оголошення функції відображення інформації на дисплеї
void handleSerialCommand(const String &input);              // Оголошення функції обробки вхідних команд користувача
void printStatistics();                                     // Оголошення функції виведення статистичних показників системи
void printHelp();                                           // Оголошення функції виведення довідкової інформації про команди
void printWiFiInfo();                                       // Оголошення функції виведення параметрів мережевого з'єднання
void printAIDiagnostics();                                  // Оголошення функції виведення діагностики моделі інтелекту
void sendToCloud();                                         // Оголошення функції відправки сформованого пакета в хмару

void setup()                                                // Головна функція налаштування периферії та модулів
{                                                           // Головна функція початкового налаштування системи
  Serial.begin(BAUD_RATE);                                  // Ініціалізація послідовного порту на заданій швидкості
  Serial.setTimeout(50);                                    // Встановлення короткого ліміту очікування читання порту
  delay(1000);                                              // Затримка одна секунда для стабілізації інтерфейсу передачі
  Serial.println("\r\n\r\n===========================");    // Виведення верхньої межі заголовка
  Serial.println("   AI Medical Thermometer     ");         // Виведення назви медичного пристрою
  Serial.println("===========================\r\n");        // Виведення нижньої межі заголовка
  pinMode(RELAY_PIN, OUTPUT);                               // Налаштування виводу реле як цифрового виходу
  pinMode(LED_PIN, OUTPUT);                                 // Налаштування виводу світлодіода як цифрового виходу
  digitalWrite(RELAY_PIN, LOW);                             // Початкове вимкнення силового реле охолодження
  digitalWrite(LED_PIN, LOW);                               // Початкове вимкнення індикаторного світлодіода
  Wire.begin(SDA_PIN, SCL_PIN);                             // Ініціалізація шини екрана з призначеними виводами
  lcd.init();                                               // Апаратна ініціалізація контролера рідкокристалічного дисплея
  lcd.backlight();                                          // Увімкнення підсвічування дисплея для видимості тексту
  lcd.clear();                                              // Очищення пам'яті екрана від попередніх символів
  lcd.setCursor(0, 0);                                      // Встановлення позиції курсора на початок першого рядка
  lcd.print("AI Thermometer");                              // Виведення скороченої назви проєкту на першому рядку
  lcd.setCursor(0, 1);                                      // Встановлення позиції курсора на початок другого рядка
  lcd.print("Init Edge-AI...");                             // Повідомлення про запуск аналітики штучного інтелекту
  sensors.begin();                                          // Ініціалізація бібліотеки опитування цифрових сенсорів
  delay(400);                                               // Затримка для завершення ініціалізації датчиків
  int deviceCount = sensors.getDeviceCount();               // Отримання кількості виявлених датчиків на шині
  Serial.print("DS18B20 sensors found: ");                  // Виведення текстового повідомлення про пошук
  Serial.println(deviceCount);                              // Друк кількості знайдених датчиків у консоль
  if (deviceCount == 0)                                     // Перевірка умови відсутності підключених датчиків
  {                                                         // Перевірка умови відсутності датчиків на шині
    Serial.println("ERROR: No DS18B20 detected!");          // Повідомлення про помилку відсутності сенсора
    lcd.clear();                                            // Очищення символів з екрана при помилці
    lcd.setCursor(0, 0);                                    // Встановлення курсора на перший рядок дисплея
    lcd.print("SENSOR ERROR!");                             // Виведення повідомлення про апаратну помилку сенсора
    lcd.setCursor(0, 1);                                    // Встановлення курсора на другий рядок дисплея
    lcd.print("No DS18B20 lead");                           // Повідомлення про відсутність підключеного дроту
    while (1)                                               // Нескінченний цикл блокування при критичній помилці
    {                                                       // Нескінченний цикл аварійної зупинки програми
      digitalWrite(LED_PIN, !digitalRead(LED_PIN));         // Перемикання стану світлодіода для сигналізації
      delay(200);                                           // Інтервал миготіння світлодіода аварії
    }                                                       // Завершення аварійного циклу
  }                                                         // Завершення перевірки наявності сенсора
  sensors.setResolution(12);                                                                              // Встановлення максимальної точності вимірювання дванадцять біт
  connectWiFi();                                                                                          // Виклик процедури підключення до бездротової мережі
  delay(1500);                                                                                            // Затримка для перегляду вітального екрана
  Serial.println("System ready. Enter 'h' for command list.");                                            // Повідомлення про готовність системи до команд
  Serial.println("Time(s)   Raw T    AI-Filter   AI State   Anomaly%  Relay  Sample#");                   // Друк колонок таблиці показників
}                                                                                                         // Завершення функції початкового налаштування

void loop()                                                                                               // Основний нескінченний цикл роботи програми
{                                                                                                         // Головний циклічний процес виконання програми
  unsigned long now = millis();                                                                           // Отримання поточного часу роботи мікроконтролера
  if (now - lastMeasurementTime >= MEASUREMENT_INTERVAL)                                                  // Перевірка настання часу чергового вимірювання
  {                                                                                                       // Перевірка настання інтервалу заміру
    lastMeasurementTime = now;                                                                            // Оновлення часової мітки останнього вимірювання
    measurementCount++;                                                                                   // Збільшення лічильника проведених замірів на одиницю
    sensors.requestTemperatures();                                                                        // Відправка команди сенсору для перетворення температури
    rawTemperature = sensors.getTempCByIndex(0);                                                          // Зчитування температури першого сенсора
    bool sensorDisconnected = (rawTemperature == DEVICE_DISCONNECTED_C || rawTemperature <= -126.0f);     // Перевірка чи не від'єднано сенсор фізично
    if (sensorDisconnected)                                                                               // Перевірка прапорця відключення сенсора
    {                                                                                                     // Обробка випадку відключення сенсора від шини
      Serial.println("WARNING: Sensor Disconnected (-127 C)!");                                           // Попередження в консоль про втрату зв'язку
      lcd.setCursor(0, 0);                                                                                // Встановлення курсора на перший рядок екрана
      lcd.print("DISCONNECTED!   ");                                                                      // Виведення напису про втрату сигналу на екрані
      lcd.setCursor(0, 1);                                                                                // Встановлення курсора на другий рядок екрана
      lcd.print("Check DS18B20   ");                                                                      // Порада користувачу перевірити контакти сенсора
    }                                                                                                     // Завершення гілки обробки помилки підключення
    else                                                                                                  // Гілка виконання за умови справного сенсора
    {                                                                                                     // Блок дій при валідному підключенні сенсора
      currentTemperature = aiDetector.processSample(rawTemperature, now);                                 // Обробка сигналу модулем штучного інтелекту
      if (!manualMode)                                                                                    // Перевірка чи не активовано ручний режим
      {                                                                                                   // Перевірка чи активний автоматичний режим керування
        if (aiDetector.shouldTriggerActuator())                                                           // Перевірка команди алгоритму на активацію охолодження
        {                                                                                                 // Перевірка потреби ввімкнення охолодження за рішенням інтелекту
          if (!relayState)                                                                                // Перевірка чи не було реле вже активоване
          {                                                                                               // Перевірка чи реле ще не було увімкнене
            relayState = true;                                                                            // Зміна логічного стану реле на увімкнено
            digitalWrite(RELAY_PIN, HIGH);                                                                // Подача високого рівня на пін реле
            digitalWrite(LED_PIN, HIGH);                                                                  // Увімкнення світлодіода сигналізації тривоги
            Serial.println("\r\n>>> [AI ALERT] COOLING/ALARM ON <<<");                                    // Повідомлення в консоль про активацію охолодження
          }                                                                                               // Завершення блоку увімкнення реле
        }                                                                                                 // Завершення блоку перевірки потреби охолодження
        else if (currentTemperature < 37.2 && aiDetector.getState() != AI_STATE_ARTIFACT)                 // Перевірка умов деактивації навантаження
        {                                                                                                 // Перевірка умов безпечного вимкнення реле
          if (relayState)                                                                                 // Перевірка чи активне реле на даний момент
          {                                                                                               // Перевірка чи реле наразі увімкнене
            relayState = false;                                                                           // Зміна логічного стану реле на вимкнено
            digitalWrite(RELAY_PIN, LOW);                                                                 // Подача низького рівня на пін реле
            digitalWrite(LED_PIN, LOW);                                                                   // Вимкнення світлодіода індикації тривоги
            Serial.println("\r\n>>> [AI NORMAL] COOLING/ALARM OFF <<<");                                  // Повідомлення в консоль про нормалізацію температури
          }                                                                                               // Завершення блоку вимкнення реле
        }                                                                                                 // Завершення перевірки гістерезису
      }                                                                                                   // Завершення автоматичного режиму керування
      displayDataOnLCD();                                                                                 // Виклик функції оновлення інформації на дисплеї
      char timeStr[12];                                                                                   // Буфер для збереження рядка часу заміру
      char aiStr[12];                                                                                     // Буфер для рядка відфільтрованої температури
      char anomStr[12];                                                                                   // Буфер для текстового відсотка аномалії
      snprintf(timeStr, sizeof(timeStr), "%.1f s", (float)now / 1000.0f);                                 // Запис текстового часу вимірювання у буфер
      snprintf(aiStr, sizeof(aiStr), "%.2f C", currentTemperature);                                       // Запис показника температури у текстовий буфер
      snprintf(anomStr, sizeof(anomStr), "%.1f %%", aiDetector.getAnomalyScorePercent());                 // Запис текстового відсотка аномалії у буфер
      Serial.printf("%-9s %-8.2f %-11s %-10s %-9s %-6s #%lu\r\n",                                         // Лівовирівняний друк рядка таблиці в консоль
                    timeStr,                                                                              // Передача рядка відліку часу на друк
                    rawTemperature,                                                                       // Первинне значення температури з датчика
                    aiStr,                                                                                // Передача рядка фільтрованої температури
                    aiDetector.getStateStr(),                                                             // Текстова назва поточного стану пацієнта
                    anomStr,                                                                              // Передача відсотка аномалії вимірювання
                    relayState ? "ON" : "OFF",                                                            // Поточний стан контактів силового реле
                    measurementCount);                                                                    // Порядковий номер проведеного вимірювання
    }                                                                                                     // Завершення обробки валідних вимірювань
  }                                                             // Завершення блоку періодичного опитування
  if (now - last_cloud >= THINGSPEAK_INTERVAL && wifi_ok)       // Перевірка часу відправки пакетів у хмарний сервіс
  {                                                             // Перевірка настання інтервалу передачі в хмару
    sendToCloud();                                              // Виклик процедури відправки даних у сховище
    last_cloud = now;                                           // Оновлення часової мітки відправки в хмару
  }                                                             // Завершення блоку хмарної передачі
  if (Serial.available() > 0)                                   // Перевірка надходження символів у послідовний порт
  {                                                             // Перевірка наявності байтів у буфері порту
    String input = Serial.readStringUntil('\n');                // Зчитування рядка команди з послідовного порту
    input.trim();                                               // Видалення зайвих службових символів та пробілів
    if (input.length() > 0)                                     // Перевірка наявності непорожнього тексту команди
    {                                                           // Виконання непорожньої введеної команди
      handleSerialCommand(input);                               // Передача отриманого тексту на розпізнавання
    }                                                           // Завершення перевірки непорожнього рядка
  }                                                             // Завершення блоку читання команд
  delay(10);                                                    // Коротка пауза десять мілісекунд для стабільності
}                                                               // Завершення головного циклу програми

void connectWiFi()                                              // Функція підключення мікроконтролера до мережі
{                                                               // Функція організації з'єднання з мережею
  Serial.print("Connecting to WiFi: ");                         // Друк повідомлення про початок з'єднання
  Serial.println(SSID);                                         // Виведення імені цільової бездротової мережі
  WiFi.mode(WIFI_STA);                                          // Встановлення режиму роботи як клієнтської станції
  WiFi.begin(SSID, PASSWORD);                                   // Початок процедури авторизації в мережі
  int attempts = 0;                                             // Лічильник кількості здійснених спроб підключення
  while (WiFi.status() != WL_CONNECTED && attempts < 20)        // Очікування встановлення зв'язку з обмеженням спроб
  {                                                             // Цикл очікування встановлення з'єднання
    delay(400);                                                 // Затримка чотириста мілісекунд між опитуваннями статусу
    Serial.print(".");                                          // Друк крапки для візуалізації прогресу спроб
    attempts++;                                                 // Збільшення кількості спроб на одиницю
  }                                                             // Завершення циклу очікування
  Serial.println();                                             // Перехід на новий рядок у консолі
  if (WiFi.status() == WL_CONNECTED)                            // Перевірка успішного отримання мережевого статусу
  {                                                             // Перевірка успішності підключення до мережі
    wifi_ok = true;                                             // Встановлення прапорця наявності зв'язку в істину
    Serial.println("WiFi connected!");                          // Друк підтвердження успішного з'єднання
    Serial.print("IP: ");                                       // Друк префіксу мережевої адреси пристрою
    Serial.println(WiFi.localIP());                             // Виведення призначеної адреси мікроконтролера
  }                                                             // Завершення блоку успішного підключення до мережі
  else                                                          // Альтернативна гілка при відсутності з'єднання
  {                                                             // Блок дій у разі невдалого підключення
    wifi_ok = false;                                            // Скидання прапорця зв'язку в хибність
    Serial.println("WiFi disconnected. Operating offline.");    // Повідомлення про перехід у автономний режим
  }                                                             // Завершення перевірки статусу мережі
}                                                               // Завершення функції підключення до мережі

void displayDataOnLCD()                                         // Процедура оновлення текстової інформації на екрані
{                                                               // Функція виведення показників на дисплей
  lcd.setCursor(0, 0);                                          // Встановлення курсора у нульову колонку нульового рядка
  lcd.print("T:");                                              // Виведення префіксу температури на дисплеї
  lcd.print(currentTemperature, 1);                             // Друк значення температури з одним знаком
  lcd.print((char)223);                                         // Виведення спеціального знака градуса Цельсія
  lcd.print("C AI:");                                           // Друк префіксу стану штучного інтелекту
  lcd.print(aiDetector.getStateShortStr());                     // Виведення скороченого позначення стану пацієнта
  lcd.print("  ");                                              // Друк пробілів для затирання залишкових символів
  lcd.setCursor(0, 1);                                          // Встановлення курсора у нульову колонку першого рядка
  if (manualMode)                                               // Перевірка чи увімкнено ручний режим оператора
  {                                                             // Перевірка активації ручного режиму
    lcd.print("M:");                                            // Виведення мітки ручного режиму
    lcd.print(relayState ? "ON " : "OFF");                      // Виведення поточного стану реле в ручному режимі
  }                                                             // Завершення відображення для ручного режиму
  else                                                          // Гілка відображення даних автоматичного аналізу
  {                                                                                           // Автоматичний режим роботи системи
    lcd.print("A:");                                                                          // Виведення мітки автоматичного аналізу
    lcd.print(aiDetector.getAnomalyScorePercent() < 10.0 ? "0" : "");                         // Додавання нуля для однозначних відсотків
    lcd.print((int)aiDetector.getAnomalyScorePercent());                                      // Виведення цілої частини відсотка аномалії
    lcd.print("% ");                                                                          // Друк знака відсотка та розділового пробілу
  }                                                                                           // Завершення блоку вибору мітки режиму
  lcd.print(relayState ? "R:ON " : "R:OFF ");                                                 // Виведення фізичного стану реле на екрані
  lcd.setCursor(12, 1);                                                                       // Переміщення курсора у дванадцяту позицію першого рядка
  lcd.print("#");                                                                             // Друк знака номера вимірювання
  lcd.print(measurementCount % 1000);                                                         // Друк номера вимірювання за модулем тисяча
}                                                                                             // Завершення функції роботи з екраном

char parseCommand(const String &input)                                                        // Функція нормалізації та розпізнавання команди
{                                                                                             // Функція приведення команди до єдиного символу
  if (input.length() == 0)                                                                    // Перевірка порожнього вхідного тексту
  {                                                                                           // Перевірка наявності тексту
    return 0;                                                                                 // Повернення нуля для порожнього введення
  }                                                                                           // Завершення перевірки
  String lower = input;                                                                       // Створення копії рядка для приведення регістру
  lower.toLowerCase();                                                                        // Переведення введеного тексту у нижній регістр
  if (lower == "help" || lower == "?") return 'h';                                            // Розпізнавання текстової команди довідки
  if (lower == "wifi") return 'w';                                                            // Розпізнавання текстової команди стану мережі
  if (lower == "stat" || lower == "stats") return 's';                                        // Розпізнавання текстової команди статистики
  if (lower == "prompt") return 'p';                                                          // Розпізнавання текстової команди генерації промпта
  if (lower == "consent") return 'c';                                                         // Розпізнавання текстової команди згоди
  if (lower == "diag" || lower == "diagnostics") return 'i';                                  // Розпізнавання текстової команди діагностики
  if (lower == "mode" || lower == "manual") return 'm';                                       // Розпізнавання текстової команди ручного режиму
  if (lower == "auto") return 'a';                                                            // Розпізнавання текстової команди авторежиму
  if (lower == "restart" || lower == "reboot") return 'r';                                    // Розпізнавання текстової команди перезавантаження
  if (lower == "test") return 't';                                                            // Розпізнавання текстової команди тесту хмари
  unsigned char b0 = (unsigned char)input[0];                                                 // Зчитування першого байта введеної команди
  if (b0 < 128)                                                                               // Перевірка належності до стандартної таблиці
  {                                                                                           // Обробка однобайтового латинського символу
    return (char)tolower(b0);                                                                 // Повернення латинської літери у нижньому регістрі
  }                                                                                           // Завершення перевірки однобайтового коду
  if (input.length() >= 2)                                                                    // Перевірка наявності двобайтового коду розкладки
  {                                                                                           // Обробка символу національної розкладки
    unsigned char b1 = (unsigned char)input[1];                                               // Зчитування другого байта символу
    uint16_t u = ((uint16_t)b0 << 8) | b1;                                                    // Формування шістнадцятибітного коду літери
    if (u == 0xD186 || u == 0xD0A6) return 'w';                                               // Літера ц відповідає клавіші мережі
    if (u == 0xD0B7 || u == 0xD097) return 'p';                                               // Літера з відповідає клавіші промпта
    if (u == 0xD188 || u == 0xD0A8) return 'i';                                               // Літера ш відповідає клавіші діагностики
    if (u == 0xD196 || u == 0xD086) return 's';                                               // Літера і відповідає клавіші статистики
    if (u == 0xD18B || u == 0xD0AB) return 's';                                               // Літера ы відповідає клавіші статистики
    if (u == 0xD18C || u == 0xD0AC) return 'm';                                               // Літера ь відповідає клавіші ручного режиму
    if (u == 0xD184 || u == 0xD0A4) return 'a';                                               // Літера ф відповідає клавіші авторежиму
    if (u == 0xD0B5 || u == 0xD095) return 't';                                               // Літера е відповідає клавіші тесту
    if (u == 0xD0BA || u == 0xD09A) return 'r';                                               // Літера к відповідає клавіші перезапуску
    if (u == 0xD181 || u == 0xD0A1) return 'c';                                               // Літера с відповідає клавіші згоди
    if (u == 0xD180 || u == 0xD0A0) return 'h';                                               // Літера р відповідає клавіші довідки
    if (u == 0xD185 || u == 0xD0A5) return 'h';                                               // Літера х відповідає клавіші довідки
    if (u == 0xD0B0 || u == 0xD090) return 'a';                                               // Літера а відповідає авторежиму
    if (u == 0xD182 || u == 0xD0A2) return 't';                                               // Літера т відповідає тестуванню
    if (u == 0xD0BC || u == 0xD09C) return 'm';                                               // Літера м відповідає ручному режиму
  }                                                                                           // Завершення перевірки двобайтового символу
  return (char)tolower(b0);                                                                   // Повернення першого байта у нижньому регістрі
}                                                                                             // Завершення функції розпізнавання команди

void handleSerialCommand(const String &input)                                                 // Обробник отриманих символьних команд користувача
{                                                                                             // Функція розпізнавання команд користувача
  char cmd = parseCommand(input);                                                             // Отримання нормалізованого символу команди
  Serial.print("\r\nCommand: '");                                                             // Друк префіксу отриманої команди
  Serial.print(input);                                                                        // Виведення введеного тексту команди
  Serial.println("'");                                                                        // Друк закриваючої одинарної лапки
  switch (cmd)                                                                                // Перемикач вибору відповідної дії за кодом команди
  {                                                                                           // Селектор вибору дії за символом
  case 'c':                                                                                   // Обробка команди запиту згоди
    Serial.println(getLLMConsentTemplate());                                                  // Друк офіційного юридичного тексту згоди пацієнта
    break;                                                                                    // Завершення гілки виконання команди
  case 'p':                                                                                   // Обробка команди запиту клінічного промпта
    Serial.println(generateLLMClinicalPrompt(currentTemperature, rawTemperature, aiDetector.getAnomalyScore(), aiDetector.getState(), measurementCount));     // Генерація та друк промпта для лікаря
    break;                                                                                    // Завершення гілки генерації промпта
  case 'i':                                                                                   // Обробка команди запиту діагностики
    printAIDiagnostics();                                                                     // Виклик функції діагностики показників моделі
    break;                                                                                    // Завершення гілки виклику діагностики
  case 'r':                                                                                   // Обробка команди перезапуску
    Serial.println("Restarting ESP32...");                                                    // Друк попередження про перезавантаження плати
    delay(300);                                                                               // Коротка пауза триста мілісекунд перед скиданням
    ESP.restart();                                                                            // Програмне перезавантаження процесора мікроконтролера
    break;                                                                                    // Завершення гілки перезапуску
  case 's':                                                                                   // Обробка команди статистики
    printStatistics();                                                                        // Виклик функції друку загальної статистики роботи
    break;                                                                                    // Завершення гілки статистики
  case 'm':                                                                                   // Обробка команди ручного режиму
    manualMode = !manualMode;                                                                 // Інверсія прапорця ручного керування актуатором
    if (manualMode)                                                                           // Перевірка активації прапорця ручного режиму
    {                                                                                         // Перевірка переходу в ручний режим
      Serial.println(">>> MANUAL MODE ACTIVE <<<");                                           // Повідомлення про активацію ручного керування
      relayState = !relayState;                                                               // Зміна поточного стану реле
      digitalWrite(RELAY_PIN, relayState ? HIGH : LOW);                                       // Запис нового логічного рівня на пін реле
      digitalWrite(LED_PIN, relayState ? HIGH : LOW);                                         // Синхронізація рівня світлодіода зі станом реле
    }                                                                                         // Завершення гілки налаштування ручного режиму
    else                                                                                      // Гілка переходу до автоматичного регулювання
    {                                                                                         // Повернення в автоматичний режим керування
      Serial.println(">>> AUTO (AI) MODE ACTIVE <<<");                                        // Повідомлення про повернення під контроль інтелекту
    }                                                                                         // Завершення аналізу режиму
    displayDataOnLCD();                                                                       // Оновлення зображення на дисплеї після зміни режиму
    break;                                                                                    // Завершення гілки перемикання режимів
  case 'a':                                                                                   // Обробка команди повернення в авторежим
    manualMode = false;                                                                       // Примусове вимкнення ручного режиму
    Serial.println(">>> AUTO (AI) MODE ACTIVE <<<");                                          // Підтвердження активації автоматичного контролю
    displayDataOnLCD();                                                                       // Відображення оновленого статусу на дисплеї
    break;                                                                                    // Завершення гілки увімкнення авторежиму
  case 't':                                                                                   // Обробка команди тестової передачі
    Serial.println("Sending test telemetry to ThingSpeak...");                                // Повідомлення про запуск тестової передачі
    sendToCloud();                                                                            // Виклик процедури відправки даних у хмару
    break;                                                                                    // Завершення гілки тестової відправки
  case 'w':                                                                                   // Обробка команди інформації про мережу
    printWiFiInfo();                                                                          // Виклик процедури друку параметрів мережі
    break;                                                                                    // Завершення гілки інформації про зв'язок
  case 'h':                                                                                   // Обробка команди виклику довідки
    printHelp();                                                                              // Виклик функції відображення довідки
    break;                                                                                    // Завершення гілки допомоги
  default:                                                                                    // Обробка всіх інших неочікуваних символів
    Serial.println("Unknown command. Enter 'h' for help.");                                   // Повідомлення про невідому вхідну команду
    break;                                                                                    // Завершення гілки за замовчуванням
  }                                                                                           // Завершення перемикача команд
}                                                                                             // Завершення функції обробки команд

void printAIDiagnostics()                                                   // Функція виведення розширеної діагностики моделі
{                                                                           // Функція друку діагностики параметрів інтелекту
  Serial.println("\r\n AI DIAGNOSTICS ");                                   // Друк шапки діагностичного вікна
  Serial.print("AI State: ");                                               // Префікс поточного стану пацієнта
  Serial.println(aiDetector.getStateStr());                                 // Виведення текстового опису стану
  Serial.print("Anomaly Score: ");                                          // Префікс числового показника аномальності
  Serial.print(aiDetector.getAnomalyScorePercent(), 2);                     // Виведення відсотка аномалії з двома знаками
  Serial.println(" %");                                                     // Друк знака відсотка з переходом рядка
  Serial.print("Rolling Mean (mu): ");                                      // Префікс математичного середнього вибірки
  Serial.print(aiDetector.getRollingMean(), 3);                             // Друк ковзного середнього значення
  Serial.println(" C");                                                     // Друк позначення градусів Цельсія
  Serial.print("Rolling StdDev (sigma): ");                                 // Префікс стандартного відхилення вибірки
  Serial.print(aiDetector.getRollingStdDev(), 3);                           // Друк середньоквадратичного відхилення
  Serial.println(" C");                                                     // Друк позначення градусів Цельсія
  Serial.print("Z-Score Threshold: ");                                      // Префікс порогу статистичного викиду
  Serial.println(AIAnomalyDetector::Z_SCORE_THRESHOLD, 1);                  // Друк граничного числа статистичного порогу
  Serial.print("Physiological dT/dt Limit: ");                              // Префікс фізичного ліміту зміни температури
  Serial.print(AIAnomalyDetector::PHYSIOLOGICAL_MAX_RATE, 2);               // Друк значення граничної швидкості нагріву
  Serial.println(" C/s");                                                   // Друк розмірності градусів за секунду
  Serial.print("Alert Active: ");                                           // Префікс ознаки активної тривоги
  Serial.println(aiDetector.isAlertActive() ? "YES" : "NO");                // Виведення підтвердження тривоги текстом
}                                                                           // Завершення функції діагностики інтелекту

void printStatistics()                                                      // Функція формування звіту статистики роботи системи
{                                                                           // Функція виведення системної статистики роботи
  Serial.println("\r\n SYSTEM STATISTICS ");                                // Друк шапки інформаційного блоку статистики
  Serial.print("Sample Count: ");                                           // Префікс лічильника кількості вимірів
  Serial.println(measurementCount);                                         // Виведення числа проведених замірів
  Serial.print("AI Filtered Temp: ");                                       // Префікс відфільтрованої температури
  Serial.print(currentTemperature, 2);                                      // Виведення значення фільтрованої температури
  Serial.println(" C");                                                     // Друк позначення градусів Цельсія
  Serial.print("Raw Temp: ");                                               // Префікс значення первинної температури
  Serial.print(rawTemperature, 2);                                          // Виведення первинного показника сенсора
  Serial.println(" C");                                                     // Друк одиниці вимірювання температури
  Serial.print("Delta (Raw - AI): ");                                       // Префікс різниці між сирим і чистим сигналом
  Serial.print(rawTemperature - currentTemperature, 3);                     // Виведення різниці фільтрації
  Serial.println(" C");                                                     // Друк позначення градусів Цельсія
  Serial.print("Relay: ");                                                  // Префікс стану підключеного силового реле
  Serial.println(relayState ? "ON" : "OFF");                                // Друк стану реле увімкнено чи вимкнено
  Serial.print("Mode: ");                                                   // Префікс поточного режиму керування
  Serial.println(manualMode ? "MANUAL" : "AUTO (AI)");                      // Друк назви активного режиму роботи
  Serial.print("WiFi: ");                                                   // Префікс стану бездротового мережевого з'єднання
  Serial.println(wifi_ok ? "Connected" : "Disconnected");                   // Друк статусу наявності зв'язку
  Serial.print("Uptime: ");                                                 // Префікс часу безперервної роботи системи
  Serial.print(millis() / 1000);                                            // Виведення кількості секунд з моменту старту
  Serial.println(" seconds");                                               // Друк одиниці вимірювання секунд
}                                                                           // Завершення функції друку статистики

void printHelp()                                                                      // Функція відображення списку підтримуваних команд
{                                                                                     // Функція виведення списку доступних команд
  Serial.println("\r\n================= COMMAND HELP =================");             // Друк шапки списку доступних команд
  Serial.println("  c / C - Print Informed Consent Template (GDPR / EU AI Act)");     // Опис команди перегляду згоди
  Serial.println("  p / P - Generate Clinical LLM Prompt with live data");            // Опис команди формування клінічного промпта
  Serial.println("  i / I - Print AI Model Diagnostics (Z-score, sigma)");            // Опис команди виклику діагностики моделі
  Serial.println("  s / S - Print system statistics");                                // Опис команди перегляду статистики системи
  Serial.println("  m / M - Toggle manual actuator mode");                            // Опис команди перемикання ручного режиму
  Serial.println("  a / A - Switch to automatic AI control mode");                    // Опис команди активації автоматики
  Serial.println("  t / T - Test send to ThingSpeak");                                // Опис команди примусової відправки в хмару
  Serial.println("  w / W - WiFi status info");                                       // Опис команди отримання інформації про мережу
  Serial.println("  r / R - Restart ESP32");                                          // Опис команди апаратного перезапуску плати
  Serial.println("  h / H - Print this help");                                        // Опис команди повторного виклику довідки
  Serial.println("================================================\r\n");             // Друк нижньої межі блоку довідки
}                                                                                     // Завершення функції виведення довідки

void printWiFiInfo()                                                        // Функція виведення параметрів поточного з'єднання
{                                                                           // Функція відображення параметрів мережі
  Serial.println("\r\n WIFI INFO ");                                        // Друк шапки інформації про мережу
  if (wifi_ok)                                                              // Перевірка прапорця активності мережевого з'єднання
  {                                                                         // Перевірка наявності активного мережевого з'єднання
    Serial.println("Status: Connected");                                    // Друк підтвердження встановленого зв'язку
    Serial.print("SSID: ");                                                 // Префікс назви бездротової точки доступу
    Serial.println(WiFi.SSID());                                            // Виведення імені поточної підключеної мережі
    Serial.print("IP: ");                                                   // Префікс локальної мережевої адреси плати
    Serial.println(WiFi.localIP());                                         // Виведення локальної адреси мікроконтролера
    Serial.print("RSSI: ");                                                 // Префікс рівня потужності радіосигналу
    Serial.print(WiFi.RSSI());                                              // Виведення значення рівня сигналу
    Serial.println(" dBm");                                                 // Друк одиниці виміру потужності сигналу
    Serial.print("MAC: ");                                                  // Префікс унікальної апаратної адреси модуля
    Serial.println(WiFi.macAddress());                                      // Виведення апаратної адреси бездротового адаптера
  }                                                                         // Завершення блоку виведення даних підключеної мережі
  else                                                                      // Гілка виведення статусу за відсутності мережі
  {                                                                         // Блок дій у разі відсутності зв'язку
    Serial.println("Status: Disconnected");                                 // Друк повідомлення про розірване з'єднання
  }                                                                         // Завершення перевірки статусу зв'язку
}                                                                           // Завершення функції друку інформації про мережу

void sendToCloud()                                                          // Функція передачі телеметричних даних у хмару
{                                                                           // Функція передачі сформованого пакета в хмарне сховище
  if (!wifi_ok)                                                             // Перевірка готовності мережі перед формуванням запиту
  {                                                                         // Перевірка наявності підключення перед відправкою
    Serial.println("[ThingSpeak] Skipped: WiFi offline");                   // Повідомлення про скасування відправки без мережі
    return;                                                                 // Достроковий вихід за відсутності мережевого з'єднання
  }                                                                         // Завершення блоку перевірки
  HTTPClient http;                                                          // Створення об'єкта виконання запитів клієнта
  String url = String(SERVER);                                              // Формування базової частини інтернет адреси
  url += "?api_key=" + String(API_KEY);                                     // Додавання секретного ключа доступу каналу
  url += "&field1=" + String(rawTemperature, 2);                            // Додавання першого поля первинної температури
  url += "&field2=" + String(currentTemperature, 2);                        // Додавання другого поля очищеної температури
  url += "&field3=" + String(relayState ? 1 : 0);                           // Додавання третього поля стану реле
  url += "&field4=" + String(aiDetector.getAnomalyScorePercent(), 1);       // Додавання четвертого поля оцінки аномалії
  url += "&field5=" + String(measurementCount);                             // Додавання п'ятого поля номера виміру
  url += "&field6=" + String((int)aiDetector.getState());                   // Додавання шостого поля коду стану пацієнта
  Serial.println("Sending data to ThingSpeak...");                          // Повідомлення в консоль про початок відправки
  http.begin(url);                                                          // Ініціалізація інтернет з'єднання за сформованою адресою
  http.setTimeout(5000);                                                    // Встановлення ліміту очікування відповіді п'ять секунд
  int code = http.GET();                                                    // Виконання запиту отримання відповіді від сервера
  if (code == 200)                                                          // Перевірка отримання коду успішної відповіді сервера
  {                                                                         // Перевірка успішності отримання відповіді
    String response = http.getString();                                     // Зчитування рядка відповіді сервера
    Serial.print("Success! Entry ID: ");                                    // Друк підтвердження успішного збереження запису
    Serial.println(response);                                               // Виведення ідентифікатора створеного запису в хмарі
  }                                                                         // Завершення обробки позитивної відповіді сервера
  else                                                                      // Гілка обробки помилки мережевого протоколу
  {                                                                         // Обробка ситуації виникнення мережевої помилки
    Serial.print("HTTP Error: ");                                           // Друк префіксу помилки мережевого протоколу
    Serial.println(code);                                                   // Виведення числового коду помилки сервера
  }                                                                         // Завершення аналізу відповіді сервера
  http.end();                                                               // Закриття мережевого з'єднання та звільнення пам'яті
  Serial.println();                                                         // Друк порожнього рядка для візуального відступу
}                                                                           // Завершення функції відправки даних у хмару