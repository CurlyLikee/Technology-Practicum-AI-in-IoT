#ifndef AI_DIAGNOSTIC_H                                                                 // Захист від повторного включення файлу заголовка
#define AI_DIAGNOSTIC_H                                                                 // Оголошення ідентифікатора модуля діагностики

#include <Arduino.h>                                                                    // Базові системні типи та математичні функції
#include <math.h>                                                                       // Стандартна бібліотека для обчислення кореня та ступеня

const int DIAG_WINDOW_SIZE = 16;                                                        // Розмір вікна вибірки для ковзного аналізу коливань
const float GRAVITY_EARTH = 9.80665f;                                                   // Гравітаційне прискорення для компенсації ваги
const float THRESHOLD_WARN_RMS = 2.50f;                                                 // Межа переходу вібрації у стан підвищеної уваги
const float THRESHOLD_CRIT_RMS = 5.20f;                                                 // Критичний поріг вібрації для аварійної зупинки
const float THRESHOLD_WARN_TEMP = 65.0f;                                                // Поріг попереджувального нагріву підшипникового щита
const float THRESHOLD_CRIT_TEMP = 82.0f;                                                // Аварійна температура під загрозою теплового заклинювання
const float THRESHOLD_WARN_WEAR = 35.0f;                                                // Поріг зносу для планування поточного сервісу
const float THRESHOLD_CRIT_WEAR = 75.0f;                                                // Критичний знос вузла з негайним відключенням

enum MachineHealthState {                                                               // Перелік технічних станів дизельного генератора
    HEALTH_NORMAL = 0,                                                                  // Штатний робочий стан без дефектів
    HEALTH_WARNING = 1,                                                                 // Стан підвищеного зносу з мікровібраціями
    HEALTH_CRITICAL = 2                                                                 // Аварійний стан з ризиком миттєвої поломки
};                                                                                      // Завершення блоку переліку станів

struct DiagnosticOutput {                                                               // Структура результатів інтелектуального аналізу
    float vibrationRms;                                                                 // Середньоквадратичне прискорення вібраційного фону
    float variance;                                                                     // Дисперсія розкиду амплітуди коливань вузла
    float peakAccel;                                                                    // Максимальний піковий сплеск ударного навантаження
    float harmonicEnergy;                                                               // Енергія високих гармонік та мікротріщин металу
    float temperature;                                                                  // Температура корпусу генератора у градусах Цельсія
    float bearingWearIndex;                                                             // Розрахований індекс зносу від нуля до ста відсотків
    float remainingUsefulLife;                                                          // Залишковий ресурс вузла у відсотках
    MachineHealthState healthState;                                                     // Поточний класифікований статус справності
    const char* stateLabel;                                                             // Текстова назва технічного стану обладнання
    bool emergencyAlert;                                                                // Прапорець негайної активації тривожного сповіщення
};                                                                                      // Завершення опису структури результатів аналізу

class VibrationAiEngine {                                                               // Клас алгоритму крайової діагностики TinyML
private:                                                                                // Секція внутрішніх змінних та буферів пам'яті
    float accelBuffer[DIAG_WINDOW_SIZE];                                                // Кільцевий буфер значень динамічного прискорення
    float diffBuffer[DIAG_WINDOW_SIZE];                                                 // Кільцевий буфер різниць сусідніх відліків сигналу
    int sampleIndex;                                                                    // Поточний покажчик позиції у кільцевому буфері
    int sampleCount;                                                                    // Кількість накопичених вимірів у поточному вікні
    float lastMagnitude;                                                                // Попередня амплітуда для оцінки високочастотних змін
    float currentTemp;                                                                  // Останній зареєстрований температурний показник

public:                                                                                 // Секція відкритих методів діагностичного модуля
    VibrationAiEngine() {                                                               // Конструктор діагностичного процесора
        reset();                                                                        // Початкове обнулення внутрішніх буферів
    }                                                                                   // Завершення конструктора

    void reset() {                                                                      // Скидання пам'яті та накопичувальних буферів
        sampleIndex = 0;                                                                // Скидання покажчика комірки буфера на початок
        sampleCount = 0;                                                                // Обнулення лічильника прийнятих вимірів
        lastMagnitude = GRAVITY_EARTH;                                                  // Ініціалізація базовою силою земного тяжіння
        currentTemp = 25.0f;                                                            // Базова температура навколишнього середовища
        for (int i = 0; i < DIAG_WINDOW_SIZE; ++i) {                                    // Цикл очищення пам'яті масивів
            accelBuffer[i] = 0.0f;                                                      // Очищення комірки буфера прискорення
            diffBuffer[i] = 0.0f;                                                       // Очищення комірки буфера високочастотних різниць
        }                                                                               // Завершення циклу очищення буферів
    }                                                                                   // Завершення функції скидання стану

    void addSample(float ax, float ay, float az, float tempC) {                         // Додавання нового вектора прискорення та температури
        float rawMag = sqrtf(ax * ax + ay * ay + az * az);                              // Повна величина просторового вектора перевантаження
        float dynMag = fabsf(rawMag - GRAVITY_EARTH);                                   // Динамічна складова вібрації без постійної гравітації
        float highFreqDelta = fabsf(rawMag - lastMagnitude);                            // Виділення мікротріщин через різницю відліків
        lastMagnitude = rawMag;                                                         // Збереження поточної точки для наступного кроку
        currentTemp = tempC;                                                            // Оновлення значення робочої температури металу
        accelBuffer[sampleIndex] = dynMag;                                              // Запис динамічного імпульсу в робочий буфер
        diffBuffer[sampleIndex] = highFreqDelta;                                        // Запис високочастотної складової в буфер гармонік
        sampleIndex = (sampleIndex + 1) % DIAG_WINDOW_SIZE;                             // Інкремент кільцевого покажчика з переходом на нуль
        if (sampleCount < DIAG_WINDOW_SIZE) {                                           // Перевірка заповнення первинного вікна вибірки
            sampleCount++;                                                              // Збільшення кількості готових точок у вибірці
        }                                                                               // Завершення перевірки наповнення буфера
    }                                                                                   // Завершення обробки вхідного виміру

    DiagnosticOutput analyze() {                                                        // Комплексний розрахунок показників надійності вузла
        DiagnosticOutput out;                                                           // Створення структури для збереження результатів
        out.temperature = currentTemp;                                                  // Фіксація поточної температури підшипника
        if (sampleCount == 0) {                                                         // Перевірка наявності даних для математичного аналізу
            out.vibrationRms = 0.0f;                                                    // Нульове середньоквадратичне прискорення
            out.variance = 0.0f;                                                        // Нульова дисперсія коливального процесу
            out.peakAccel = 0.0f;                                                       // Нульовий піковий сплеск навантаження
            out.harmonicEnergy = 0.0f;                                                  // Відсутність гармонік мікротріщин
            out.bearingWearIndex = 0.0f;                                                // Нульовий рівень механічного зносу
            out.remainingUsefulLife = 100.0f;                                           // Сто відсотків залишкового ресурсу агрегата
            out.healthState = HEALTH_NORMAL;                                            // Присвоєння нормального технічного стану
            out.stateLabel = "STABLE";                                                  // Текстовий статус стабільної роботи
            out.emergencyAlert = false;                                                 // Вимкнення аварійного сигналізатора
            return out;                                                                 // Повернення базового результату
        }                                                                               // Завершення обробки порожнього буфера
        float sumAccel = 0.0f;                                                          // Сума амплітуд для обчислення середнього
        float sumSquareAccel = 0.0f;                                                    // Сума квадратів амплітуд для розрахунку енергії
        float sumSquareDiff = 0.0f;                                                     // Сума квадратів різниць для гармонік
        float peak = 0.0f;                                                              // Змінна пошуку максимального сплеску
        for (int i = 0; i < sampleCount; ++i) {                                         // Цикл обчислення статистичних параметрів вікна
            float val = accelBuffer[i];                                                 // Отримання значення вібрації з буфера
            float dval = diffBuffer[i];                                                 // Отримання високочастотної гармоніки
            sumAccel += val;                                                            // Накопичення суми амплітуд вибірки
            sumSquareAccel += val * val;                                                // Накопичення квадратичної енергії сигналу
            sumSquareDiff += dval * dval;                                               // Накопичення енергії високих гармонік
            if (val > peak) {                                                           // Пошук абсолютного пікового значення вібрації
                peak = val;                                                             // Фіксація нового пікового сплеску амплітуди
            }                                                                           // Завершення перевірки екстремуму
        }                                                                               // Завершення циклу розрахунку статистики
        float mean = sumAccel / (float)sampleCount;                                     // Математичне сподівання динамічного коливання
        float rms = sqrtf(sumSquareAccel / (float)sampleCount);                         // Середньоквадратичне віброприскорення вузла
        float harmonic = sqrtf(sumSquareDiff / (float)sampleCount);                     // Енергія високочастотних коливань підшипника
        float sumVar = 0.0f;                                                            // Змінна накопичення відхилень від середнього
        for (int i = 0; i < sampleCount; ++i) {                                         // Цикл розрахунку дисперсії амплітуди
            float diff = accelBuffer[i] - mean;                                         // Відхилення миттєвого значення від математичного
            sumVar += diff * diff;                                                      // Накопичення квадрата статистичного відхилення
        }                                                                               // Завершення циклу розрахунку дисперсії
        float varianceVal = sumVar / (float)sampleCount;                                // Статистична дисперсія вібраційного навантаження
        out.vibrationRms = rms;                                                         // Збереження розрахованого середньоквадратичного фону
        out.variance = varianceVal;                                                     // Фіксація дисперсії у фінальному звіті
        out.peakAccel = peak;                                                           // Збереження максимального зареєстрованого піка
        out.harmonicEnergy = harmonic;                                                  // Фіксація гармонік мікровібрацій вузла
        float wearNormRms = (rms / 6.0f) * 45.0f;                                       // Внесок загальної амплітуди коливань у знос
        float wearNormVar = (varianceVal / 4.0f) * 35.0f;                               // Внесок нестабільності та дисперсії коливань
        float wearNormHarm = (harmonic / 3.0f) * 20.0f;                                 // Внесок високочастотного мікротріскотіння металу
        float computedWear = wearNormRms + wearNormVar + wearNormHarm;                  // Базовий інтегральний індекс деградації підшипника
        if (currentTemp > 50.0f) {                                                      // Додатковий тепловий коефіцієнт втоми механізму
            computedWear += (currentTemp - 50.0f) * 0.9f;                               // Нарощування зносу через перегрів мастильного шару
        }                                                                               // Завершення обліку теплового перевантаження
        if (computedWear < 0.0f) {                                                      // Захист від від'ємного значення розрахунку
            computedWear = 0.0f;                                                        // Обмеження мінімального значення зносу
        }                                                                               // Завершення нижнього обрізання шкали
        if (computedWear > 100.0f) {                                                    // Захист від перевищення максимуму шкали
            computedWear = 100.0f;                                                      // Обмеження максимального значення зносу
        }                                                                               // Завершення верхнього обрізання шкали
        out.bearingWearIndex = computedWear;                                            // Збереження фінального індексу зносу підшипника
        float rulVal = 100.0f - computedWear;                                           // Розрахунок залишкового ресурсу обладнання
        if (rulVal < 0.0f) {                                                            // Перевірка нижньої межі ресурсу експлуатації
            rulVal = 0.0f;                                                              // Обнулення залишкового ресурсу при руйнуванні
        }                                                                               // Завершення калібрування залишкового часу
        out.remainingUsefulLife = rulVal;                                               // Збереження відсотка залишкового життя вузла
        bool isCrit = computedWear >= THRESHOLD_CRIT_WEAR;                              // Перевірка перевищення критичної межі зносу
        bool isCritRms = rms >= THRESHOLD_CRIT_RMS;                                     // Перевірка перевищення критичного прискорення
        bool isCritTemp = currentTemp >= THRESHOLD_CRIT_TEMP;                           // Перевірка настання критичного перегріву вузла
        bool isWarn = computedWear >= THRESHOLD_WARN_WEAR;                              // Перевірка настання попереджувального порогу зносу
        bool isWarnRms = rms >= THRESHOLD_WARN_RMS;                                     // Перевірка настання підвищеної амплітуди вібрацій
        bool isWarnTemp = currentTemp >= THRESHOLD_WARN_TEMP;                           // Перевірка настання робочого перегріву підшипника
        if (isCrit || isCritRms || isCritTemp) {                                        // Умова настання невідкладної аварійної ситуації
            out.healthState = HEALTH_CRITICAL;                                          // Переведення обладнання в аварійний стан
            out.stateLabel = "CRITICAL";                                                // Мітка критичної небезпеки аварійного виходу
            out.emergencyAlert = true;                                                  // Активація аварійної тривоги для персоналу
        } else if (isWarn || isWarnRms || isWarnTemp) {                                 // Умова фіксації підвищеного зносу обладнання
            out.healthState = HEALTH_WARNING;                                           // Переведення в попереджувальний режим нагляду
            out.stateLabel = "WARNING";                                                 // Текстовий статус підвищеної уваги
            out.emergencyAlert = false;                                                 // Скасування негайної сирени для попередження
        } else {                                                                        // Умова збереження параметрів у безпечній нормі
            out.healthState = HEALTH_NORMAL;                                            // Підтвердження нормального робочого режиму
            out.stateLabel = "NORMAL";                                                  // Текстова мітка стабільного функціонування
            out.emergencyAlert = false;                                                 // Вимкнення аварійного режиму сповіщення
        }                                                                               // Завершення класифікації технічного стану
        return out;                                                                     // Повернення розрахованого діагностичного пакета
    }                                                                                   // Завершення аналізу телеметричних параметрів
};                                                                                      // Завершення оголошення діагностичного класу

#endif                                                                                  // Завершення умовної директиви заголовка